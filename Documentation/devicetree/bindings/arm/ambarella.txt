## arch/arm/mach-GM-Duo/platform-GM8210-S/Kconfig
```kconfig
#
# arch/arm/mach-GM/platform-GM8210/Kconfig

if PLATFORM_GM8210_S

#config SYS_CLK
config CLOCK_TICK_RATE
        int "AHB System Clock"
        default 33000000
        help
            Any fake value is ok. It is almost obsolete.

config GM8210_S_HZ
    int "HZ of GM8210_S (FA626)"
    range 100 1000
    default 1000
    help
      HZ defined in GM8210_S platform

config PLATFORM_AXIDMA
	bool "AXI DMA support"
	default y

config FTINTC030
	bool "FTINTC030 support"
	default y

config FTINTC010EX
	bool "FTINTC010EX supports 64 IRQs"
	default y

config FC7500
    bool "FC7500 support"
    default y

config GM8312
    bool "GM8312 support"
    default y

config GM8210_FPGA
	bool "FPGA Verify"
	default n

endif
```

## arch/arm/mach-GM-Duo/platform-GM8210/Kconfig
```kconfig
#
# arch/arm/mach-GM/platform-GM8210/Kconfig

if PLATFORM_GM8210

#config SYS_CLK
config CLOCK_TICK_RATE
        int "AHB System Clock"
        default 33000000
        help
            Any fake value is ok. It almost obsolete.

config GM8210_TIMER_HZ
    int "HZ of GM8210"
    range 100 1000
    default 1000
    help
      HZ defined in GM8210 platform

config PLATFORM_AXIDMA
	bool "AXI DMA support"
	default y

config FTINTC030
	bool "FTINTC030 support"
	default y

config FTINTC010EX
	bool "FTINTC010EX supports 64 IRQs"
	default y

config FA626
    bool "FA626 support"
    default y

config FC7500
    bool "FC7500 support"
    default y

config GM8312
	bool "GM8312 support"
	default y

config GM8210_EP_MODE
    bool "Dual GM8210 EP mode"
    default n

config GM8210_FPGA
	bool "FPGA Verify"
	default n

endif
```

## arch/arm/mach-GM-SMP/Kconfig
```kconfig
#
# arch/arm/mach-GM-SMP/Kconfig
#

#
# GM Platform Types Selection
#
choice
	prompt "Platform Selection"
	default PLATFORM_GM8220
	depends on ARCH_GM_SMP

config PLATFORM_GM8220
	bool "GM8220 series platform"
	select ARM_GIC if CPU_HAS_GIC
    help
      GM GM8220 is a platform based on ARM Cortex compatible processor

endchoice

config FORCE_MAX_ZONEORDER
    int
    depends on ARCH_GM_SMP
    default "12"

config FTDMAC020
    tristate "Supports DMAC020 controller"
    select DMA_ENGINE
    default y

config FTDMAC030
    tristate "Supports DMAC030 controller"
    select DMA_ENGINE
    depends on PLATFORM_AXIDMA
    default y

config FTAPBB020
    tristate "Supports APB DMA"
    select DMA_ENGINE
    default n

config CPU_HAS_GIC
	bool
	default y if CPU_FMP626 || CPU_CA9 || CPU_CA7
	help
	   Use ARM GIC

#
# Platform dependent options
#
menu "GM Platform Options"
    depends on ARCH_GM_SMP

source "arch/arm/mach-GM-SMP/platform-GM8220/Kconfig"
    
endmenu    
```

## arch/arm/mach-GM-SMP/platform-GM8220/Kconfig
```kconfig
#

#config SYS_CLK
config CLOCK_TICK_RATE	
        int "AHB System Clock"
        default 240000000
        help
          Manual setting of AHB clock, must match the jumper setting on
          the board, or the system time won't be correctly calculated.
          Notice that even when AUTO_SYS_CLK is ON, this value is still
          required for adjusting minor time offsets. However, the influence
          should be within micro-second to nano-second scale.

config PLATFORM_AXIDMA
	bool "AXI DMA support"
	default y

config FTINTC030
	bool "FTINTC030 support"
	default y if !CPU_HAS_GIC

config FTTMR010
	bool "FTTMR010 support"
	default n

config FPGA
	bool "FPGA Verify"
	default n
```

## arch/arm/mach-GM/Kconfig
```kconfig
#
# arch/arm/mach-GM/Kconfig
#

#
# GM Platform Types Selection
#
choice
	prompt "Platform Selection"
	default PLATFORM_GM8126
	depends on ARCH_GM


config PLATFORM_GM8126
	bool "GM8126 series platform"
    select FIQ
    help
      GM GM8126 is a platform based on GM's ARM9 compatible processor

config PLATFORM_GM8287
	bool "GM8287 series platform"
    help
      GM GM8287 is a platform based on GM's ARM9 compatible processor

config PLATFORM_GM8139
	bool "GM8139 series platform"
    help
      GM GM8139 is a platform based on GM's ARM9 compatible processor

config PLATFORM_GM8136
	bool "GM8136 series platform"
    help
      GM GM8136 is a platform based on GM's ARM9 compatible processor

endchoice

config FORCE_MAX_ZONEORDER
    int
    depends on ARCH_GM
    default "12"

config FTDMAC020
    tristate "Supports DMAC020 controller"
    select DMA_ENGINE
    default y

config FTAPBB020
    tristate "Supports APB DMA"
    select DMA_ENGINE
    default n


#
# Platform dependent options
#
menu "GM Platform Options"
    depends on ARCH_GM

source "arch/arm/mach-GM/platform-GM8126/Kconfig"
source "arch/arm/mach-GM/platform-GM8287/Kconfig"
source "arch/arm/mach-GM/platform-GM8139/Kconfig"
source "arch/arm/mach-GM/platform-GM8136/Kconfig"
    
endmenu    
```

## arch/arm/mach-GM/platform-GM8126/Kconfig
```kconfig
#
# arch/arm/mach-GM/platform-GM8126/Kconfig

if PLATFORM_GM8126

#config SYS_CLK
config CLOCK_TICK_RATE	
        int "AHB System Clock"
        default 240000000
        help
          Manual setting of AHB clock, must match the jumper setting on
          the board, or the system time won't be correctly calculated.
          Notice that even when AUTO_SYS_CLK is ON, this value is still
          required for adjusting minor time offsets. However, the influence
          should be within micro-second to nano-second scale.

config FTINTC010EX
	bool "FTINTC010EX supports 64 IRQs"
	default y

endif
```

## arch/arm/mach-GM/platform-GM8136/Kconfig
```kconfig
#
# arch/arm/mach-GM/platform-GM8136/Kconfig

if PLATFORM_GM8136

#config SYS_CLK
config CLOCK_TICK_RATE	
        int "AHB System Clock"
        default 240000000
        help
          Manual setting of AHB clock, must match the jumper setting on
          the board, or the system time won't be correctly calculated.
          Notice that even when AUTO_SYS_CLK is ON, this value is still
          required for adjusting minor time offsets. However, the influence
          should be within micro-second to nano-second scale.

config FTINTC030
	bool "FTINTC030 support"
	default y

config FPGA
	bool "FPGA Verify"
	default n

config VIDEO_FASTTHROUGH
	bool "Video Fast Through"
	default y
	help
	  When this function is on, video related drivers need to work in
	  atomic context for fast passing job to next stage.

endif
```

## arch/arm/mach-GM/platform-GM8287/Kconfig
```kconfig
#
# arch/arm/mach-GM/platform-GM8287/Kconfig

if PLATFORM_GM8287

#config SYS_CLK
config CLOCK_TICK_RATE	
        int "AHB System Clock"
        default 33000000
        help
            Any fake value is ok. It almost obsolete.

config FTINTC030
	bool "FTINTC030 support"
	default y

endif
```

## arch/arm/mach-ak39/Kconfig
```kconfig
# linux/arch/arm/mach-ak39/Kconfig
#
# Copyright 2013 Anaka Microelectronics
#
# Licensed under GPLv2
 
# define CPU TYPE FLAGS 
config CPU_AK3916
	bool
config CPU_AK3918
	bool
config CPU_AK3919
	bool

# Machine support
choice
	prompt "ANYKA AK39xx boards"
	depends on ARCH_AK39

config ARCH_CLOUD39EV3_AK3916E128PIN_COREBD
	bool "AK3916E V300 SVT Board"
	depends on ARCH_AK39
	select CPU_AK3916
	help
	  Support for AK3916E V300 SVT board
	  
config ARCH_CLOUD39EV3_AK3918E80PIN_COREBD
	bool "AK3918E V300 SVT board"
	depends on ARCH_AK39
	select CPU_AK3918
	help
	  Support for AK3918E V300

config ARCH_CLOUD39EV3_AK3916EV300_MAINBD
	bool "AK3916E V300 machine"
	depends on ARCH_AK39
	select CPU_AK3916
	help
	  Support for AK3916E V300
	  
config ARCH_CLOUD39EV3_SQ38X4_COREBD
	bool "AK3918E V300 SVT board"
	depends on ARCH_AK39
	select CPU_AK3918
	help
	  Support for AK3918E V300	  
	  
config ARCH_CLOUD39EV3_AK3918EV300_MAINBD
	bool "AK3918E V300 machine"
	depends on ARCH_AK39
	select CPU_AK3918
	help
	  Support for AK3918E V300

config ARCH_CLOUD39EV3_AK3918EV300_SDIO_WIFI_MAINBD
	bool "AK3918E V300 sdio wifi machine"
	depends on ARCH_AK39
	select CPU_AK3918
	help
		Support for AK3918E V300

config ARCH_CLOUD39EV3_AK3918EV300_YTJ_MAINBD
	bool "AK3918E V300 YTJ machine"
	depends on ARCH_AK39
	select CPU_AK3918
	help
	  Support for AK3918E V300
	  
config ARCH_CLOUD39EV3_AK3919EV300_MAINBD
	bool "AK3919E V300 machine"
	depends on ARCH_AK39
	select CPU_AK3919
	help
	  Support for AK3919E V300

config ARCH_CLOUD39EV3_CO38_SC2235
	bool "AK3918E 38module board"
	depends on ARCH_AK39
	select CPU_AK3918
	help
	  Support for AK3918E V300
	  
config ARCH_CLOUD39EV3_AK3919EV300_SQ38_SC2232_V1_0_0
	bool "AK3919E SQ38 module board_V1.0.0"
	depends on ARCH_AK39
	select CPU_AK3919
	help
	  Support for AK3918E V300
	  
config ARCH_CLOUD39EV3_AK3919EV300_SQ38_SC2232_V1_0_1
	bool "AK3919E SQ38 module board_V1.0.1"
	depends on ARCH_AK39
	select CPU_AK3919
	help
	  Support for AK3918E V300

config ARCH_CLOUD39EV3_SQ38_QFN64_F22_V100
	bool "AK3919E 38module board"
	depends on ARCH_AK39
	select CPU_AK3918
	help
	  Support for AK3919E V300

config ARCH_AK3918EV300_C80DX
	bool "AK3919E Tenda C80DX Board"
	depends on ARCH_AK39
	select CPU_AK3918
	help
	  Support for TD-C80DX Board

config ARCH_AK3918EV300_HL_XIAOFANG
	bool "AK3919E Tenda C80DX Board"
	depends on ARCH_AK39
	select CPU_AK3918
	help
	  Support for HL-XIAOFANG Board

config ARCH_CLOUD39EV3_AK3918EV300_YR_IPC100A_MAINBD
	bool "AK3918E V300 YTJ machine"
	depends on ARCH_AK39
	select CPU_AK3918
	help
	  Support for AK3918E V300

config ARCH_AK3918EV300_SC10008_V100
        bool "AK3918E V300 Board SC10008 V1.0.0"
        depends on ARCH_AK39
        select CPU_AK3918
        help
          Support for AK3918E V300 Board SC-10008.

config ARCH_AK3918EV300_JW_F37_V10
        bool "AK3918E V300 Board JW F37 V1.0"
        depends on ARCH_AK39
        select CPU_AK3918
        help
          Support for AK3918E V300 Board JW-F37.
      
endchoice

# aisc cpufreq set
#config ASIC_FREQ_VALUE
#	int "Config asic frequency(if asic>100MHz asic=vclk; else asic=vclk/2)"
#	range 45000000 120000000
#	default 90000000
#	depends on ARCH_AK39
#	help
#	  config ak39xx asic frequency when the kernel uncompress.
#	  note: vclk be equal to even asic.

#	because ADC2_clk_div_num is 6-bits register, so ASIC PLL should not too high
#		if set ADC samplerate 8000Hz.
choice
	prompt "Config asic frequency"
	default ASIC_CLK_120MHZ
	depends on ARCH_AK39

config ASIC_CLK_120MHZ
	bool "120MHz"
	depends on ARCH_AK39
	help
	  Then ASIC_PLL=480MHz, VCLK=240MHz, ASIC_CLK=120MHz.

endchoice

# power managerment
comment "Power management"
config AK39_PM
	bool "ak39 Power Management support"
	depends on PM && ARCH_AK39
	help
	Say Y here if you want support power management for AK39.

config AK39_CPUFREQ
	bool "ak39 Frequency scaling support"
	depends on CPU_FREQ && ARCH_AK39
	help
	  Say Y here, CPU Frequency scaling support for AK39 SoC CPUs.

# chip extra controller lib
config AK39_PWM_TIMER
	bool "ak39 PWM/Timer Control support"
	depends on ARCH_AK39
	help
	  Say Y here if you want support pwm control.
```
