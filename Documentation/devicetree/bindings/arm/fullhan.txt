## Documentation/devicetree/bindings/media/fullhan,fh8626v100-bgm.txt
```
Fullhan FH8626V100 background model engine
========================================

The BGM engine performs background modelling and foreground detection on
luminance frames in memory. It is independent of the CSI/ISP media graph.
The driver exposes V4L2 memory-to-memory GREY input and GREY foreground-mask
output, with mask pixels equal to 0 or 255.

Required properties:
- compatible: must be "fullhan,fh8626v100-bgm".
- reg: the BGM register window, <0xe8606000 0x120>.
- interrupts: the BGM interrupt, hardware IRQ 7 on FH8626V100.
- clocks: two clock specifiers, for the BGM processing and bus clocks.
- clock-names: must be "bgm", "hclk", in that order.

The processing clock shares its parent selection and divider with the ISP.
The driver uses the existing clock rate; no assigned-clock-rates or
assigned-clock-parents properties should change this shared configuration.
There is no documented PMU reset specifier in this binding.

Frame size is negotiated through V4L2.
The driver supports widths from 8 to 240 and heights from 8 to 512,
both in multiples of 8; its default input size is 160 by 96.

Example:

bgm: bgm@e8606000 {
	compatible = "fullhan,fh8626v100-bgm";
	reg = <0xe8606000 0x120>;
	interrupt-parent = <&intc>;
	interrupts = <7>;
	clocks = <&clk FH8626_CLK_BGM>, <&clk FH8626_CLK_BGM_HCLK>;
	clock-names = "bgm", "hclk";
};
```

## Documentation/devicetree/bindings/media/fullhan,fh8626v100-camera.txt
```
Fullhan FH8626V100 camera capture

The node is a capture device with one video port. It has no reg
property and no clocks.

Required properties:
- compatible: "fullhan,fh8626v100-camera"
- port: the input port, connected as described by
  Documentation/devicetree/bindings/media/video-interfaces.txt

Example:

	camera {
		compatible = "fullhan,fh8626v100-camera";

		port {
			endpoint {
				remote-endpoint = <&isp_out>;
			};
		};
	};
```

## Documentation/devicetree/bindings/media/fullhan,fh8626v100-csi.txt
```
Fullhan FH8626V100 CSI receiver
==============================

Required properties:
- compatible: "fullhan,fh8626v100-csi"
- reg: CSI controller and wrapper register ranges, in that order
- reg-names: "csi", "wrap"
- clocks: D-PHY, wrapper and CSI controller clock handles
- clock-names: "dphy", "wrap", "pclk"
- phys: phandle to the FH8626V100 MIPI input PHY
- phy-names: "dphy"
- ports: graph ports as described by video-interfaces.txt
  - port@0: sensor input, reg = <0>
  - port@1: ISP output, reg = <1>

The input endpoint requires clock-lanes = <0> and data-lanes = <1>.
Only single-lane RAW10 1280x720 is implemented;
lane inversion and alternative lane assignments are not supported.

The PHY establishes the SoC input route. The receiver enables bus clocks,
initializes its D-PHY test interface, then accepts input from the sensor.
Stopping a stream shuts down the receiver before releasing the PHY and
clocks. No pixel clock frequency is inferred from the PHY test code.

Example:

csi@f1100000 {
	compatible = "fullhan,fh8626v100-csi";
	reg = <0xf1100000 0x1000>, <0xf1000000 0x100>;
	reg-names = "csi", "wrap";
	clocks = <&clk FH8626_CLK_MIPI_DPHY>,
		 <&clk FH8626_CLK_MIPI_WRAP_PCLK>,
		 <&clk FH8626_CLK_MIPIC_PCLK>;
	clock-names = "dphy", "wrap", "pclk";
	phys = <&mipi_phy>;
	phy-names = "dphy";
	ports {
		#address-cells = <1>;
		#size-cells = <0>;
		port@0 {
			reg = <0>;
			endpoint {
				remote-endpoint = <&sensor_out>;
				clock-lanes = <0>;
				data-lanes = <1>;
			};
		};
		port@1 {
			reg = <1>;
			endpoint {
				remote-endpoint = <&isp_in>;
			};
		};
	};
};
```

## Documentation/devicetree/bindings/media/fullhan,fh8626v100-isp.txt
```
Fullhan FH8626V100 image signal processor

Required properties:
- compatible: "fullhan,fh8626v100-isp"
- reg: MMIO window of the ISP
- interrupts: ISP interrupt
- clocks: AXI and AHB clocks, in that order
- clock-names: "aclk", "hclk"
- ports: graph ports, as described by
  Documentation/devicetree/bindings/media/video-interfaces.txt
  - port@0: input from the CSI receiver, reg = <0>
  - port@1: output to the capture node, reg = <1>

Example:

	isp@e8400000 {
		compatible = "fullhan,fh8626v100-isp";
		reg = <0xe8400000 0x4000>;
		interrupts = <5>;
		clocks = <&clk FH8626_CLK_ISP_ACLK>,
			 <&clk FH8626_CLK_ISP_HCLK>;
		clock-names = "aclk", "hclk";

		ports {
			#address-cells = <1>;
			#size-cells = <0>;

			port@0 {
				reg = <0>;
				endpoint {
					remote-endpoint = <&csi_out>;
				};
			};

			port@1 {
				reg = <1>;
				endpoint {
					remote-endpoint = <&camera_in>;
				};
			};
		};
	};
```

## Documentation/devicetree/bindings/media/fullhan,fh8626v100-jpeg.txt
```
Fullhan FH8626V100 JPEG codec

Required properties:
- compatible: "fullhan,fh8626v100-jpeg" or
  "fullhan,fh8626-jpeg"
- reg: MMIO window of the codec
- interrupts: codec interrupt
- clocks: JPEG clock and bus clock, in that order
- clock-names: "jpeg", "hclk"

Example:

	jpeg@e8300000 {
		compatible = "fullhan,fh8626v100-jpeg";
		reg = <0xe8300000 0x600>;
		interrupts = <8>;
		clocks = <&clk FH8626_CLK_JPEG>,
			 <&clk FH8626_CLK_JPEG_HCLK>;
		clock-names = "jpeg", "hclk";
	};
```

## Documentation/devicetree/bindings/media/i2c/galaxycore,gc1054.txt
```
GalaxyCore GC1054 camera sensor

The sensor is the I2C device at address 0x21.

Required properties:
- compatible: "galaxycore,gc1054"
- reg: I2C address
- clocks: the sensor clock
- clock-names: "xvclk"
- reset-gpios: sensor reset GPIO
- port: one output port, as described by
  Documentation/devicetree/bindings/media/video-interfaces.txt

The endpoint contains clock-lanes = <0> and data-lanes = <1>.

Optional properties:
- assigned-clocks: the sensor clock
- assigned-clock-parents: parent of that clock
- pinctrl-names and pinctrl-0: pin configuration

Example:

	camera-sensor@21 {
		compatible = "galaxycore,gc1054";
		reg = <0x21>;
		clocks = <&clk FH8626_CLK_CIS_OUT>;
		clock-names = "xvclk";
		reset-gpios = <&gpio0 13 GPIO_ACTIVE_LOW>;

		port {
			endpoint {
				remote-endpoint = <&csi_in>;
				clock-lanes = <0>;
				data-lanes = <1>;
			};
		};
	};
```

## Documentation/devicetree/bindings/media/i2c/galaxycore,gc2053.txt
```
GalaxyCore GC2053 camera sensor

Required properties:
- compatible: "galaxycore,gc2053"
- reg: I2C address
- clocks: the 24 MHz sensor clock
- clock-names: "xvclk"
- reset-gpios: sensor reset GPIO
- port: one output port containing an endpoint, as described by
  Documentation/devicetree/bindings/media/video-interfaces.txt
- data-lanes: <1 2> in the endpoint

Optional properties:
- pwdn-gpios: sensor power-down GPIO
- clock-lanes: <0> in the endpoint; defaults to 0
- lane-polarities: <0 0 0> in the endpoint; defaults to normal polarity
- clock-noncontinuous: endpoint flag for a non-continuous CSI-2 clock;
  the default is a continuous clock
- bus-type: <0> in the endpoint; defaults to automatic bus detection

Example:

	camera-sensor@1b {
		compatible = "galaxycore,gc2053";
		reg = <0x1b>;
		clocks = <&sensor_clk>;
		clock-names = "xvclk";
		reset-gpios = <&gpio0 13 GPIO_ACTIVE_LOW>;

		port {
			endpoint {
				clock-lanes = <0>;
				data-lanes = <1 2>;
			};
		};
	};
```

## Documentation/devicetree/bindings/media/i2c/smartsens,sc2336.txt
```
SmartSens SC1345 and SC2336 camera sensors

The SC1345 is a 1280x720 sensor at I2C address 0x30 with one CSI-2 data
lane. The SC2336 is a 1920x1080 sensor at I2C address 0x30 or 0x32,
selected by its ID pin, with two CSI-2 data lanes.

Required properties:
- compatible: "smartsens,sc1345" or "smartsens,sc2336"
- reg: I2C address
- clocks: the 24 MHz sensor clock
- clock-names: "xvclk"
- reset-gpios: sensor reset GPIO
- port: one output port containing an endpoint, as described by
  Documentation/devicetree/bindings/media/video-interfaces.txt
- data-lanes: <1> in the endpoint for the SC1345, <1 2> for the SC2336

Optional properties:
- pwdn-gpios: sensor power-down GPIO
- clock-lanes: <0> in the endpoint; defaults to 0
- assigned-clocks: the sensor clock
- assigned-clock-parents: parent of that clock
- pinctrl-names and pinctrl-0: pin configuration

Example:

	camera-sensor@30 {
		compatible = "smartsens,sc2336";
		reg = <0x30>;
		clocks = <&clk FH8626_CLK_CIS_OUT>;
		clock-names = "xvclk";
		reset-gpios = <&gpio0 13 GPIO_ACTIVE_LOW>;

		port {
			endpoint {
				remote-endpoint = <&csi_in>;
				clock-lanes = <0>;
				data-lanes = <1 2>;
			};
		};
	};
```

## Documentation/devicetree/bindings/media/i2c/superpix,sp1405.txt
```
SuperPix SP1405 camera sensor

Required properties:
- compatible: "superpix,sp1405" or "ovti,ov9732"
- reg: I2C address
- clocks: the 24 MHz sensor clock
- clock-names: "xvclk"
- reset-gpios: sensor reset GPIO
- port: one output port containing an endpoint, as described by
  Documentation/devicetree/bindings/media/video-interfaces.txt
- data-lanes: <1> in the endpoint

Optional properties:
- pwdn-gpios: sensor power-down GPIO
- clock-lanes: <0> in the endpoint; defaults to 0
- lane-polarities: <0 0> in the endpoint; defaults to normal polarity
- clock-noncontinuous: endpoint flag for a non-continuous CSI-2 clock;
  the default is a continuous clock
- bus-type: <0> in the endpoint; defaults to automatic bus detection

Example:

	camera-sensor@36 {
		compatible = "superpix,sp1405";
		reg = <0x36>;
		clocks = <&sensor_clk>;
		clock-names = "xvclk";
		reset-gpios = <&gpio0 13 GPIO_ACTIVE_LOW>;

		port {
			endpoint {
				clock-lanes = <0>;
				data-lanes = <1>;
			};
		};
	};
```

## Documentation/devicetree/bindings/misc/fullhan,fh8626-ptz.txt
```
Fullhan FH8626 pan-tilt motors

Required properties:
- compatible: "fullhan,fh8626-ptz"
- h-gpios: four GPIO specifiers for the horizontal phases
- v-gpios: four GPIO specifiers for the vertical phases
- h-upbound: horizontal travel limit
- v-upbound: vertical travel limit
- max-pps: maximum step rate, in pulses per second

Optional properties:
- h-invert-dir: invert the horizontal direction
- sequential-axes: move one axis at a time

A board comment may name the wired GPIOs.

Example:

	ptz-motors {
		compatible = "fullhan,fh8626-ptz";
		h-gpios = <&gpio1 18 GPIO_ACTIVE_HIGH>,
			  <&gpio1 19 GPIO_ACTIVE_HIGH>,
			  <&gpio0 3 GPIO_ACTIVE_HIGH>,
			  <&gpio0 6 GPIO_ACTIVE_HIGH>;
		v-gpios = <&gpio1 29 GPIO_ACTIVE_HIGH>,
			  <&gpio0 5 GPIO_ACTIVE_HIGH>,
			  <&gpio0 24 GPIO_ACTIVE_HIGH>,
			  <&gpio0 19 GPIO_ACTIVE_HIGH>;
		h-upbound = <496>;
		v-upbound = <169>;
		max-pps = <500>;
		h-invert-dir;
		sequential-axes;
	};
```

## Documentation/devicetree/bindings/mmc/fullhan,fh8626v100-mmc.txt
```
Fullhan FH8626V100 MMC controller

Required properties:
- compatible: "fullhan,fh8626v100-mmc"
- reg: MMIO window of the controller
- interrupts: controller interrupt
- clocks: bus interface clock and card clock, in that order
- clock-names: "biu", "ciu"

The board may add the MMC properties from mmc.txt, including
bus-width, max-frequency, clock-freq-min-max, cap-sd-highspeed and
no-1-8-v. Pin configuration uses pinctrl-names and pinctrl-0.

Example:

	mmc@e2000000 {
		compatible = "fullhan,fh8626v100-mmc";
		reg = <0xe2000000 0x4000>;
		interrupts = <14>;
		clocks = <&clk FH8626_CLK_AHB>, <&clk FH8626_CLK_SDC0>;
		clock-names = "biu", "ciu";
	};
```

## Documentation/devicetree/bindings/net/fullhan,fh8626v100-gmac.txt
```
Fullhan FH8626V100 Ethernet MAC

Required properties:
- compatible: "fullhan,fh8626v100-gmac"
- reg: MMIO window of the MAC
- interrupts: MAC interrupt
- interrupt-names: "macirq"
- clocks: MAC clock and RMII clock, in that order
- clock-names: "stmmaceth", "rmii"

The MAC is integrated with the stmmac driver. The board device tree
describes the PHY connection.

Example:

	ethernet@e0600000 {
		compatible = "fullhan,fh8626v100-gmac";
		reg = <0xe0600000 0x4000>;
		interrupts = <13>;
		interrupt-names = "macirq";
		clocks = <&clk FH8626_CLK_ETH>, <&clk FH8626_CLK_ETH_RMII>;
		clock-names = "stmmaceth", "rmii";
	};
```
