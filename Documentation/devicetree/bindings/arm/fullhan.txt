## Documentation/devicetree/bindings/arm/fullhan.txt
```
Fullhan FH8626V100 board and SoC

The FH8626V100 is an ARM1176JZF-S SoC.

Required root node properties:
- compatible: "fullhan,fh8626v100", with fallback "fullhan,fh8626"

Example:

/ {
	model = "Fullhan FH8626V100";
	compatible = "fullhan,fh8626v100", "fullhan,fh8626";
};
```

## Documentation/devicetree/bindings/ata/hisilicon,hi3520dv200-ahci.yaml
```yaml
# SPDX-License-Identifier: (GPL-2.0-only OR BSD-2-Clause)
%YAML 1.2
---
$id: http://devicetree.org/schemas/ata/hisilicon,hi3520dv200-ahci.yaml#
$schema: http://devicetree.org/meta-schemas/core.yaml#

title: HiSilicon Hi3520DV200 AHCI SATA controller

maintainers:
  - Bjorn Stout <bjorn.stout@hotmail.com>

description:
  The two-port AHCI controller of the Hi3520D V100 and V200 (driven by the
  same glue; each revision has its own compatible, the V100 one is not a
  fallback of the V200 one). Its PHYs are clocked, taken
  out of reset and programmed by the driver through the SoC's SATA
  clock/reset register (PERI_CRG45) before the AHCI core is started.

properties:
  compatible:
    enum:
      - hisilicon,hi3520dv100-ahci
      - hisilicon,hi3520dv200-ahci

  reg:
    items:
      - description: AHCI registers, including the vendor PHY registers
      - description: PERI_CRG45, the SATA clock and reset register

  interrupts:
    maxItems: 1

  clocks:
    description:
      The three SATA block clock gates of PERI_CRG45. All of them have to be
      listed, because the driver sets all three bits and an unlisted gate
      would be switched off as unused after the probe.
    items:
      - description: Bus and PHY clock gate
      - description: Port 0 clock gate
      - description: Port 1 clock gate

  hisilicon,phy-config:
    $ref: /schemas/types.yaml#/definitions/uint32
    description:
      Value for the per-port PHY control register (port offset 0x74).
      HiSilicon's Hi3520D reference value, 0x0e276756, is the default.
      XiongMai boards need 0x0e262709, the value their vendor firmware
      writes; with the default their link keeps resetting.
    default: 0x0e276756

required:
  - compatible
  - reg
  - interrupts

additionalProperties: false

examples:
  - |
    #include <dt-bindings/clock/hi3520dv100-clock.h>
    #include <dt-bindings/interrupt-controller/arm-gic.h>

    sata@10080000 {
        compatible = "hisilicon,hi3520dv100-ahci";
        reg = <0x10080000 0x10000>, <0x200300b4 0x4>;
        interrupts = <GIC_SPI 20 IRQ_TYPE_LEVEL_HIGH>;
        clocks = <&crg HI3520DV100_SATA_CLK>, <&crg HI3520DV100_SATA0_CLK>,
                 <&crg HI3520DV100_SATA1_CLK>;
        hisilicon,phy-config = <0x0e262709>;
    };
```

## Documentation/devicetree/bindings/cache/hisilicon,hi3520dv200-l2cache.yaml
```yaml
# SPDX-License-Identifier: (GPL-2.0-only OR BSD-2-Clause)
%YAML 1.2
---
$id: http://devicetree.org/schemas/cache/hisilicon,hi3520dv200-l2cache.yaml#
$schema: http://devicetree.org/meta-schemas/core.yaml#

title: HiSilicon Hi3520DV200 L2 cache controller (hil2v200)

maintainers:
  - Bjorn Stout <bjorn.stout@hotmail.com>

description:
  HiSilicon's own outer cache controller in the Hi3520DV200, 128 KB with
  8 ways and 32-byte lines. It is not an ARM PL310 (its ID register reads 0)
  and is maintained by address, by way and set, or a whole way at a time.

allOf:
  - $ref: /schemas/cache-controller.yaml#

properties:
  compatible:
    const: hisilicon,hi3520dv200-l2cache

  reg:
    maxItems: 1

  interrupts:
    items:
      - description: check 0 (error) interrupt
      - description: check 1 (error) interrupt
      - description: combined interrupt

  cache-unified: true

  cache-level:
    const: 2

required:
  - compatible
  - reg
  - cache-unified
  - cache-level

unevaluatedProperties: false

examples:
  - |
    #include <dt-bindings/interrupt-controller/arm-gic.h>

    cache-controller@20700000 {
        compatible = "hisilicon,hi3520dv200-l2cache";
        reg = <0x20700000 0x10000>;
        interrupts = <GIC_SPI 29 IRQ_TYPE_LEVEL_HIGH>,
                     <GIC_SPI 30 IRQ_TYPE_LEVEL_HIGH>,
                     <GIC_SPI 31 IRQ_TYPE_LEVEL_HIGH>;
        cache-unified;
        cache-level = <2>;
    };
```

## Documentation/devicetree/bindings/clock/fullhan,fh8626v100-clk.txt
```
Fullhan FH8626V100 clock controller

The clock controller is a child of the "fullhan,fh8626v100-pmu",
"syscon", "simple-mfd" system controller. The parent supplies the PMU
register window in its reg property. The clock child has no reg property
or unit address; its registers are part of the shared PMU window.

Required properties:
- compatible: "fullhan,fh8626v100-clk"
- #clock-cells: must be <1>
- #reset-cells: must be <1>
- clocks: the oscillator input
- clock-names: "osc"

Clock index values are defined in
include/dt-bindings/clock/fh8626v100-clk.h, reset index values in
include/dt-bindings/reset/fh8626v100-reset.h.

Example:

	system-controller@f0000000 {
		compatible = "fullhan,fh8626v100-pmu", "syscon", "simple-mfd";
		reg = <0xf0000000 0x4000>;

		clock-controller {
			compatible = "fullhan,fh8626v100-clk";
			#clock-cells = <1>;
			#reset-cells = <1>;
			clocks = <&osc>;
			clock-names = "osc";
		};
	};
```

## Documentation/devicetree/bindings/clock/hisilicon,hi3520d-crg.yaml
```yaml
# SPDX-License-Identifier: (GPL-2.0-only OR BSD-2-Clause)
%YAML 1.2
---
$id: http://devicetree.org/schemas/clock/hisilicon,hi3520d-crg.yaml#
$schema: http://devicetree.org/meta-schemas/core.yaml#

title: HiSilicon Hi3520D Clock and Reset Generator (CRG) and system controller

maintainers:
  - Dylan Corrales <deathcamel58@gmail.com>

description: |
  The CRG of the Hi3520D/Hi3515A/Hi3515C family provides the PLLs, bus clock
  selection, peripheral clock gates and peripheral soft resets. The SP804
  timer and watchdog count clock selects live in the system controller, which
  is described by its own compatible and provides those clocks.

  Reset specifiers have two cells: the register offset from the CRG base and
  the bit number. A set bit holds the peripheral in reset.

  See include/dt-bindings/clock/hi3520d-clock.h for the clock identifiers.

properties:
  compatible:
    items:
      - enum:
          - hisilicon,hi3520d-crg
          - hisilicon,hi3520d-sysctrl
      - const: syscon
        description:
          Valid for hisilicon,hi3520d-sysctrl (USB PHY control) and for
          hisilicon,hi3520d-crg (the audio interface programs its master clock
          dividers through the register window).
      - const: simple-mfd
        description: Only valid for hisilicon,hi3520d-sysctrl (child devices, for example the USB PHY).
    minItems: 1

  reg:
    maxItems: 1

  '#clock-cells':
    const: 1

  '#reset-cells':
    const: 2

  '#address-cells':
    const: 1

  '#size-cells':
    const: 1

patternProperties:
  '^phy(@[0-9a-f]+)?$':
    type: object
    description:
      Child device of the system controller (only with simple-mfd), for example
      the USB PHY.

required:
  - compatible
  - reg
  - '#clock-cells'

allOf:
  - if:
      properties:
        compatible:
          contains:
            const: hisilicon,hi3520d-crg
    then:
      required:
        - '#reset-cells'
    else:
      properties:
        '#reset-cells': false

additionalProperties: false

examples:
  - |
    clock-controller@20030000 {
        compatible = "hisilicon,hi3520d-crg", "syscon";
        reg = <0x20030000 0x10000>;
        #clock-cells = <1>;
        #reset-cells = <2>;
    };

    clock-controller@20050000 {
        compatible = "hisilicon,hi3520d-sysctrl", "syscon", "simple-mfd";
        reg = <0x20050000 0x1000>;
        #clock-cells = <1>;
    };
```

## Documentation/devicetree/bindings/clock/hisilicon,hi3520dv100-crg.yaml
```yaml
# SPDX-License-Identifier: (GPL-2.0-only OR BSD-2-Clause)
%YAML 1.2
---
$id: http://devicetree.org/schemas/clock/hisilicon,hi3520dv100-crg.yaml#
$schema: http://devicetree.org/meta-schemas/core.yaml#

title: HiSilicon Hi3520DV100 Clock and Reset Generator (CRG) and system controller

maintainers:
  - Dylan Corrales <deathcamel58@gmail.com>

description: |
  The CRG of the Hi3520D V100 silicon (system ID 0x3520D100; the data sheet
  also covers Hi3515A and Hi3515C) provides the PLLs, bus clock
  selection, peripheral clock gates and peripheral soft resets. The SP804
  timer and watchdog count clock selects live in the system controller, which
  is described by its own compatible and provides those clocks.

  Reset specifiers have two cells: the register offset from the CRG base and
  the bit number. A set bit holds the peripheral in reset.

  This binding was written and tested on Hi3520D V100 only. Hi3520D V200 is
  a different silicon revision with its own data sheet and is not covered.

  See include/dt-bindings/clock/hi3520dv100-clock.h for the clock identifiers.

properties:
  compatible:
    items:
      - enum:
          - hisilicon,hi3520dv100-crg
          - hisilicon,hi3520dv100-sysctrl
      - const: syscon
        description:
          Valid for hisilicon,hi3520dv100-sysctrl (USB PHY control) and for
          hisilicon,hi3520dv100-crg (the audio interface programs its master clock
          dividers through the register window).
      - const: simple-mfd
        description: Only valid for hisilicon,hi3520dv100-sysctrl (child devices, for example the USB PHY).
    minItems: 1

  reg:
    maxItems: 1

  '#clock-cells':
    const: 1

  '#reset-cells':
    const: 2

  '#address-cells':
    const: 1

  '#size-cells':
    const: 1

patternProperties:
  '^phy(@[0-9a-f]+)?$':
    type: object
    description:
      Child device of the system controller (only with simple-mfd), for example
      the USB PHY.

required:
  - compatible
  - reg
  - '#clock-cells'

allOf:
  - if:
      properties:
        compatible:
          contains:
            const: hisilicon,hi3520dv100-crg
    then:
      properties:
        compatible:
          maxItems: 2
      patternProperties:
        '^phy(@[0-9a-f]+)?$': false
      required:
        - '#reset-cells'
    else:
      properties:
        '#reset-cells': false

additionalProperties: false

examples:
  - |
    clock-controller@20030000 {
        compatible = "hisilicon,hi3520dv100-crg", "syscon";
        reg = <0x20030000 0x10000>;
        #clock-cells = <1>;
        #reset-cells = <2>;
    };

    clock-controller@20050000 {
        compatible = "hisilicon,hi3520dv100-sysctrl", "syscon", "simple-mfd";
        reg = <0x20050000 0x1000>;
        #clock-cells = <1>;
    };
```

## Documentation/devicetree/bindings/crypto/fullhan,fh8626v100-aes.txt
```
Fullhan FH8626 Hardware AES Accelerator

Required properties:
- compatible : Should be "fullhan,fh8626v100-aes"
- reg : Should contain AES register location and length (e.g. 0xe8200000 0x4000)
- interrupts : Should contain the AES engine interrupt number (24)

- clocks : Clock specifier for the AES AHB clock gate
- clock-names : Must be "hclk"

Example:

	aes: aes@e8200000 {
		compatible = "fullhan,fh8626v100-aes";
		reg = <0xe8200000 0x4000>;
		interrupts = <24>;
		clocks = <&clk FH8626_CLK_AES_HCLK_GATE>;
		clock-names = "hclk";
		status = "okay";
	};
```

## Documentation/devicetree/bindings/dma/fullhan,fh8626v100-dma.txt
```
Fullhan FH8626V100 DMA controller

Required properties:
- compatible: "fullhan,fh8626v100-dma"
- reg: MMIO window of the controller
- interrupts: controller interrupt
- clocks: the bus clock
- clock-names: "hclk"
- #dma-cells: must be <3>

The three cells are the DMA request, the memory master and the
peripheral master. Clients use the format in dma.txt.

Example:

	dma: dma-controller@e0300000 {
		compatible = "fullhan,fh8626v100-dma";
		reg = <0xe0300000 0x4000>;
		interrupts = <21>;
		clocks = <&clk FH8626_CLK_DMAC0_HCLK_GATE>;
		clock-names = "hclk";
		#dma-cells = <3>;
	};
```

## Documentation/devicetree/bindings/gpio/fullhan,fh8626v100-gpio.txt
```
Fullhan FH8626V100 GPIO controller

Each bank contains 32 GPIO lines and one parent interrupt. GPIO offsets are
local to the bank; Linux GPIO numbers are allocated dynamically.

Required properties:
- compatible: "fullhan,fh8626v100-gpio"
- reg: MMIO window of the bank
- interrupts: parent interrupt for the bank
- gpio-controller
- #gpio-cells: must be <2>; line offset and standard GPIO flags
- interrupt-controller
- #interrupt-cells: must be <2>; line offset and standard IRQ type
- #address-cells: must be <0>

Optional properties:
- gpio-line-names: names for the lines in bank order

Hardware debounce configuration is not exposed: its clock is shared by
the bank. Consumers such as gpio-keys can provide software debounce.

Example:

	gpio0: gpio-controller@f0300000 {
		compatible = "fullhan,fh8626v100-gpio";
		reg = <0xf0300000 0x4000>;
		interrupts = <26>;
		gpio-controller;
		#gpio-cells = <2>;
		interrupt-controller;
		#interrupt-cells = <2>;
		#address-cells = <0>;
	};
```

## Documentation/devicetree/bindings/i2c/fullhan,fh8626v100-i2c.txt
```
Fullhan FH8626V100 I2C controller

Required properties:
- compatible: "fullhan,fh8626v100-i2c"
- reg: MMIO window of the controller
- interrupts: controller interrupt
- clocks: the I2C input clock
- clock-names: "i2c"
- clock-frequency: bus frequency in Hz
- #address-cells: must be <1>
- #size-cells: must be <0>

The driver also matches "snps,designware-i2c". The compatible for
this binding is "fullhan,fh8626v100-i2c".

Optional properties:
- assigned-clocks: the I2C input clock
- assigned-clock-rates: requested rate of that clock

Example:

	i2c@f0200000 {
		compatible = "fullhan,fh8626v100-i2c";
		reg = <0xf0200000 0x4000>;
		interrupts = <9>;
		clocks = <&clk FH8626_CLK_I2C0>;
		clock-names = "i2c";
		clock-frequency = <400000>;
		#address-cells = <1>;
		#size-cells = <0>;
	};
```

## Documentation/devicetree/bindings/iio/adc/fullhan,fh8626v100-adc.txt
```
Fullhan FH8626V100 SAR ADC

Required properties:
- compatible: "fullhan,fh8626v100-adc"
- reg: MMIO window of the converter
- interrupts: converter interrupt
- clocks: the ADC clock
- clock-names: "sadc"

Example:

	adc@f1200000 {
		compatible = "fullhan,fh8626v100-adc";
		reg = <0xf1200000 0x4000>;
		interrupts = <25>;
		clocks = <&clk FH8626_CLK_SADC>;
		clock-names = "sadc";
	};
```

## Documentation/devicetree/bindings/interrupt-controller/fullhan,fh8626v100-intc.txt
```
Fullhan FH8626V100 root interrupt controller

Required properties:
- compatible: "fullhan,fh8626v100-intc"
- reg: MMIO window of the controller
- interrupt-controller: marks the node as an interrupt controller
- #interrupt-cells: must be <1>
- fullhan,num-irqs: number of hardware interrupt sources

The single cell is the hardware interrupt number. On-chip devices use
this node as their interrupt parent.

Example:

	intc: interrupt-controller@e0200000 {
		compatible = "fullhan,fh8626v100-intc";
		reg = <0xe0200000 0x4000>;
		interrupt-controller;
		#interrupt-cells = <1>;
		fullhan,num-irqs = <64>;
	};
```

## Documentation/devicetree/bindings/media/fullhan,fh8626-pae.txt
```
Fullhan FH8626V100 video encoder

Required properties:
- compatible: "fullhan,fh8626-pae", "fullhan,fh8626v100-encoder"
- reg: three MMIO ranges, in the order of reg-names
- reg-names: "core", "buffer", "sram"
- interrupts: encoder interrupt
- clocks: four clocks, in the order of clock-names
- clock-names: "pae_clk", "pae_hclk_gate", "multi_pae_clk",
  "pae_adpt_clk"

The encoder is a child of a simple-bus. DMA addresses are
DDR-relative in a 512 MiB window at 1 KiB granularity, which is the
dma-ranges property already on that bus.

Example:

	encoder {
		compatible = "fullhan,fh8626-pae",
			     "fullhan,fh8626v100-encoder";
		reg-names = "core", "buffer", "sram";
		interrupts = <4>;
		clock-names = "pae_clk", "pae_hclk_gate",
			      "multi_pae_clk", "pae_adpt_clk";
	};
```
