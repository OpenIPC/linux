## Documentation/devicetree/bindings/crypto/hisilicon,hisi-cipher-mc.yaml
```yaml
# SPDX-License-Identifier: (GPL-2.0-only OR BSD-2-Clause)
%YAML 1.2
---
$id: http://devicetree.org/schemas/crypto/hisilicon,hisi-cipher-mc.yaml#
$schema: http://devicetree.org/meta-schemas/core.yaml#

title: HiSilicon multi-channel CIPHER engine

maintainers:
  - Dylan Corrales <deathcamel58@gmail.com>

description: |
  Symmetric cipher engine of the HiSilicon Hi35xx SoCs (AES, DES and 3DES in
  ECB, CBC, CFB, OFB and CTR modes). It has eight channels: channel 0 is a
  register mode channel and channels 1 to 7 are linked-list DMA channels with
  one key slot each. The data sheets of several SoCs describe the same
  register map, so the generic compatible names the programming model and the
  SoC compatible names the silicon revision.

  The single-channel CIPHER of the Hi3511, Hi3515 and Hi3520 V100, the SPACC
  of the Hi3516A V300 and the cipher blocks of the Hi3520D V300 and Hi3535 have
  a different register layout and are not described by this binding.

  SoC compatibles and the chips that carry the same silicon:
    hisilicon,hi3520dv100-cipher-mc - Hi3520D V100, Hi3515A V100, Hi3515C V100
    hisilicon,hi3518ev200-cipher-mc - Hi3518E V200, V201, V202, Hi3516C V200

properties:
  compatible:
    items:
      - enum:
          - hisilicon,hi3518ev200-cipher-mc
          - hisilicon,hi3520dv100-cipher-mc
      - const: hisilicon,hisi-cipher-mc

  reg:
    maxItems: 1

  interrupts:
    maxItems: 1

  clocks:
    description: Clock gate of the engine (cipher_cken in the clock controller).
    maxItems: 1

  resets:
    description:
      Soft reset line of the engine (cipher_srst_req). The driver resets the
      whole block at probe and at resume.
    maxItems: 1

required:
  - compatible
  - reg
  - interrupts
  - clocks
  - resets

additionalProperties: false

examples:
  - |
    #include <dt-bindings/clock/hi3520dv100-clock.h>
    #include <dt-bindings/interrupt-controller/arm-gic.h>

    crypto@100c0000 {
        compatible = "hisilicon,hi3520dv100-cipher-mc", "hisilicon,hisi-cipher-mc";
        reg = <0x100c0000 0x2000>;
        interrupts = <GIC_SPI 23 IRQ_TYPE_LEVEL_HIGH>;
        clocks = <&crg HI3520DV100_CIPHER_CLK>;
        resets = <&crg 0x7c 0>;
    };
```

## Documentation/devicetree/bindings/crypto/ingenic,t23-aes.yaml
```yaml
# SPDX-License-Identifier: (GPL-2.0-only OR BSD-2-Clause)
%YAML 1.2
---
$id: http://devicetree.org/schemas/crypto/ingenic,t23-aes.yaml#
$schema: http://devicetree.org/meta-schemas/core.yaml#

title: Ingenic T23 Hardware AES Engine

maintainers:
  - Paul Cercueil <paul@crapouillou.net>

properties:
  compatible:
    const: ingenic,t23-aes

  reg:
    maxItems: 1

  interrupts:
    maxItems: 1

  clocks:
    maxItems: 1

  clock-names:
    const: aes

required:
  - compatible
  - reg
  - interrupts
  - clocks

additionalProperties: false

examples:
  - |
    crypto@13430000 {
        compatible = "ingenic,t23-aes";
        reg = <0x13430000 0x1000>;
        interrupts = <23>;
        clocks = <&cgu 38>;
        clock-names = "aes";
    };
```

## Documentation/devicetree/bindings/media/hisilicon,hi3520dv100-jpgd.yaml
```yaml
# SPDX-License-Identifier: GPL-2.0-only OR BSD-2-Clause
%YAML 1.2
---
$id: http://devicetree.org/schemas/media/hisilicon,hi3520dv100-jpgd.yaml#
$schema: http://devicetree.org/meta-schemas/core.yaml#

title: HiSilicon JPEG decoder (JPGD)

maintainers:
  - Dylan Corrales <deathcamel58@gmail.com>

description: |
  Baseline JPEG decoder of the HiSilicon Hi3520D V100 and Hi3536D V100 SoCs.
  It reads the entropy-coded part of a JPEG file from memory, decodes it with
  the quantization and Huffman tables that software loads into it, and writes
  a semi-planar YCbCr picture, optionally reduced by 2, 4 or 8. It masters the
  bus with 32 bit physical addresses and has no IOMMU.

  The clock is the gate "jpgd_cken" and the reset the "jpgd_srst_req" bit (a
  set bit holds the block in reset) of the same CRG register (PERI_CRG25 of
  the Hi3520D V100, PERI_CRG40 of the Hi3536D V100). Both come out of reset
  with the clock enabled; the Hi3520D V100 holds the block in reset then
  (register value 0x3) while the Hi3536D V100 has released it (0x2). The
  register window must not be accessed while the clock is gated, and reads as
  zero while the reset is held.

properties:
  compatible:
    enum:
      - hisilicon,hi3520dv100-jpgd
      - hisilicon,hi3536dv100-jpgd

  reg:
    maxItems: 1

  interrupts:
    maxItems: 1

  clocks:
    maxItems: 1
    description: Gate of the block (jpgd_cken).

  resets:
    maxItems: 1
    description: Soft reset of the block (jpgd_srst_req).

required:
  - compatible
  - reg
  - interrupts
  - clocks
  - resets

additionalProperties: false

examples:
  - |
    #include <dt-bindings/clock/hi3536dv100-clock.h>
    #include <dt-bindings/interrupt-controller/arm-gic.h>

    video-codec@13110000 {
        compatible = "hisilicon,hi3536dv100-jpgd";
        reg = <0x13110000 0x10000>;
        interrupts = <GIC_SPI 31 IRQ_TYPE_LEVEL_HIGH>;
        clocks = <&crg HI3536DV100_JPGD_CLK>;
        resets = <&crg 0xa0 0>;
    };
```

## Documentation/devicetree/bindings/media/hisilicon,hi3520dv100-jpge.yaml
```yaml
# SPDX-License-Identifier: GPL-2.0-only OR BSD-2-Clause
%YAML 1.2
---
$id: http://devicetree.org/schemas/media/hisilicon,hi3520dv100-jpge.yaml#
$schema: http://devicetree.org/meta-schemas/core.yaml#

title: HiSilicon JPEG encoder (JPGE)

maintainers:
  - Dylan Corrales <deathcamel58@gmail.com>

description: |
  Baseline JPEG encoder of the HiSilicon Hi3520D V100 and Hi3536D V100 video
  SoCs. It reads semi-planar YCbCr pictures from memory (the Hi3520D V100 also
  planar and packed ones) and writes entropy-coded JPEG data with fixed
  Huffman tables; the JFIF header and the quantization tables are provided by
  software.

  The register layout is the one of the version register value 0x56325234,
  which both SoCs report. No data sheet has a register table for this block;
  the layout comes from vendor code and is confirmed on hardware for both
  SoCs. SoCs with another layout (for instance the Hi3516E V200 and V300) have
  no compatible.

  The block is in reset at power-on on some SoCs and its register window must
  not be accessed with the clock gated. The reset line is the "jpge_srst_req"
  bit of the CRG (a set bit holds the block in reset).

properties:
  compatible:
    enum:
      - hisilicon,hi3520dv100-jpge
      - hisilicon,hi3536dv100-jpge

  reg:
    maxItems: 1

  interrupts:
    maxItems: 1

  clocks:
    maxItems: 1
    description:
      Gate of the block (jpge_cken in the CRG).

  resets:
    maxItems: 1
    description:
      Soft reset of the block (jpge_srst_req in the CRG).

required:
  - compatible
  - reg
  - interrupts
  - clocks
  - resets

additionalProperties: false

examples:
  - |
    #include <dt-bindings/clock/hi3536dv100-clock.h>
    #include <dt-bindings/interrupt-controller/arm-gic.h>

    video-codec@13120000 {
        compatible = "hisilicon,hi3536dv100-jpge";
        reg = <0x13120000 0x10000>;
        interrupts = <GIC_SPI 30 IRQ_TYPE_LEVEL_HIGH>;
        clocks = <&crg HI3536DV100_JPGE_CLK>;
        resets = <&crg 0x9c 0>;
    };
```

## Documentation/devicetree/bindings/media/i2c/galaxycore,gc2053.yaml
```yaml
# SPDX-License-Identifier: (GPL-2.0-only OR BSD-2-Clause)
%YAML 1.2
---
$id: http://devicetree.org/schemas/media/i2c/galaxycore,gc2053.yaml#
$schema: http://devicetree.org/meta-schemas/core.yaml#

title: GalaxyCore GC2053 2MP 1080p MIPI CSI-2 Raw Bayer Image Sensor

maintainers:
  - Paul Cercueil <paul@crapouillou.net>

properties:
  compatible:
    const: galaxycore,gc2053

  reg:
    maxItems: 1

  clocks:
    maxItems: 1

  clock-names:
    const: xvclk

  avdd-supply:
    description: Analog 2.8V power supply regulator.

  dovdd-supply:
    description: Digital I/O 1.8V power supply regulator.

  dvdd-supply:
    description: Digital core 1.2V power supply regulator.

  reset-gpios:
    maxItems: 1

  pwdn-gpios:
    maxItems: 1

  port:
    $ref: /schemas/graph.yaml#/$defs/port-base
    additionalProperties: false

    properties:
      endpoint:
        $ref: /schemas/media/video-interfaces.yaml#
        unevaluatedProperties: false

        properties:
          data-lanes:
            items:
              - const: 1
              - const: 2

          link-frequencies:
            maxItems: 1
            items:
              const: 297000000

        required:
          - data-lanes
          - link-frequencies

    required:
      - endpoint

required:
  - compatible
  - reg
  - clocks
  - port

additionalProperties: false

examples:
  - |
    i2c {
        #address-cells = <1>;
        #size-cells = <0>;

        sensor@37 {
            compatible = "galaxycore,gc2053";
            reg = <0x37>;
            clocks = <&sensor_clk>;
            clock-names = "xvclk";

            port {
                gc2053_out: endpoint {
                    data-lanes = <1 2>;
                    link-frequencies = /bits/ 64 <297000000>;
                    remote-endpoint = <&csi_in>;
                };
            };
        };
    };
```

## Documentation/devicetree/bindings/media/i2c/galaxycore,gc2083.txt
```
GalaxyCore GC2083 camera sensor

The GC2083 is a 1920x1080 RAW10 sensor with a 2-lane MIPI CSI-2 output
and 16-bit register addresses.

Required properties:
- compatible: "galaxycore,gc2083"
- reg: I2C address
- clocks: the 24 MHz sensor clock
- clock-names: "xvclk"
- port: one output port containing an endpoint, as described by
  Documentation/devicetree/bindings/media/video-interfaces.txt
- data-lanes: <1 2> in the endpoint

Optional properties:
- reset-gpios: the sensor's active-low RESETB line
- avdd-supply: analogue supply
- dovdd-supply: digital I/O supply
- dvdd-supply: digital core supply
- clock-lanes: <0> in the endpoint; defaults to 0
- lane-polarities: <0 0 0> in the endpoint; defaults to normal polarity
- link-frequencies: <250000000> in the endpoint, the only supported rate

Example:

	camera-sensor@37 {
		compatible = "galaxycore,gc2083";
		reg = <0x37>;
		clocks = <&sensor_clk>;
		clock-names = "xvclk";
		reset-gpios = <&gpio0 13 GPIO_ACTIVE_LOW>;

		port {
			endpoint {
				clock-lanes = <0>;
				data-lanes = <1 2>;
				link-frequencies = /bits/ 64 <250000000>;
			};
		};
	};
```

## Documentation/devicetree/bindings/media/i2c/smartsens,sc2336.yaml
```yaml
# SPDX-License-Identifier: (GPL-2.0-only OR BSD-2-Clause)
%YAML 1.2
---
$id: http://devicetree.org/schemas/media/i2c/smartsens,sc2336.yaml#
$schema: http://devicetree.org/meta-schemas/core.yaml#

title: SmartSens MIPI CSI-2 image sensors

maintainers:
  - Paul Cercueil <paul@crapouillou.net>

properties:
  compatible:
    enum:
      - smartsens,sc1346
      - smartsens,sc1a4t
      - smartsens,sc200ai
      - smartsens,sc2310
      - smartsens,sc2331
      - smartsens,sc2336
      - smartsens,sc2336p
      - smartsens,sc2337p

  reg:
    maxItems: 1

  clocks:
    maxItems: 1

  clock-names:
    const: xvclk

  avdd-supply:
    description: Analog 2.8V power supply regulator.

  dovdd-supply:
    description: Digital I/O 1.8V power supply regulator.

  dvdd-supply:
    description: Digital core 1.2V power supply regulator.

  reset-gpios:
    maxItems: 1

  pwdn-gpios:
    maxItems: 1

  smartsens,frame-sync-slave:
    type: boolean
    description:
      Configure the sensor in external frame-synchronization slave mode for
      dual-sensor lockstep capture.

  smartsens,secondary-i2c-addr:
    $ref: /schemas/types.yaml#/definitions/uint32
    minimum: 0x08
    maximum: 0x77
    description:
      Remap a paired secondary sensor on the shared reset line to this 7-bit
      I2C address during primary sensor probe before releasing pwdn-gpios.

  port:
    $ref: /schemas/graph.yaml#/$defs/port-base
    additionalProperties: false

    properties:
      endpoint:
        $ref: /schemas/media/video-interfaces.yaml#
        unevaluatedProperties: false

        properties:
          data-lanes:
            minItems: 1
            items:
              - const: 1
              - const: 2

          link-frequencies:
            maxItems: 1
            items:
              enum:
                - 112500000
                - 180000000
                - 185625000
                - 198000000
                - 360000000
                - 371250000

        required:
          - data-lanes
          - link-frequencies

    required:
      - endpoint

allOf:
  - if:
      properties:
        compatible:
          enum:
            - smartsens,sc1346
    then:
      properties:
        port:
          properties:
            endpoint:
              properties:
                data-lanes:
                  maxItems: 1
                link-frequencies:
                  items:
                    const: 112500000
  - if:
      properties:
        compatible:
          enum:
            - smartsens,sc1a4t
    then:
      properties:
        port:
          properties:
            endpoint:
              properties:
                data-lanes:
                  maxItems: 1
                link-frequencies:
                  items:
                    const: 360000000
  - if:
      properties:
        compatible:
          enum:
            - smartsens,sc2331
    then:
      properties:
        port:
          properties:
            endpoint:
              properties:
                data-lanes:
                  minItems: 2
                link-frequencies:
                  items:
                    const: 180000000
  - if:
      properties:
        compatible:
          enum:
            - smartsens,sc2310
    then:
      properties:
        port:
          properties:
            endpoint:
              properties:
                data-lanes:
                  minItems: 2
                link-frequencies:
                  items:
                    const: 185625000
  - if:
      properties:
        compatible:
          enum:
            - smartsens,sc2336
            - smartsens,sc2336p
            - smartsens,sc2337p
    then:
      properties:
        port:
          properties:
            endpoint:
              properties:
                data-lanes:
                  minItems: 2
                link-frequencies:
                  items:
                    const: 198000000
  - if:
      properties:
        compatible:
          enum:
            - smartsens,sc200ai
    then:
      properties:
        port:
          properties:
            endpoint:
              properties:
                data-lanes:
                  minItems: 2
                link-frequencies:
                  items:
                    enum: [185625000, 371250000]
  - if:
      properties:
        compatible:
          enum:
            - smartsens,sc1346
            - smartsens,sc200ai
            - smartsens,sc2310
            - smartsens,sc2331
    then:
      properties:
        smartsens,frame-sync-slave: false
        smartsens,secondary-i2c-addr: false

required:
  - compatible
  - reg
  - clocks
  - port

additionalProperties: false

examples:
  - |
    i2c {
        #address-cells = <1>;
        #size-cells = <0>;

        sensor@30 {
            compatible = "smartsens,sc2336";
            reg = <0x30>;
            clocks = <&sensor_clk>;
            clock-names = "xvclk";

            port {
                sc2336_out: endpoint {
                    data-lanes = <1 2>;
                    link-frequencies = /bits/ 64 <198000000>;
                    remote-endpoint = <&csi_in>;
                };
            };
        };
    };
```
