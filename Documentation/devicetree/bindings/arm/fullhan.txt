## Documentation/devicetree/bindings/mfd/hisilicon,hi3536dv100-misc-ctrl.yaml
```yaml
# SPDX-License-Identifier: (GPL-2.0-only OR BSD-2-Clause)
%YAML 1.2
---
$id: http://devicetree.org/schemas/mfd/hisilicon,hi3536dv100-misc-ctrl.yaml#
$schema: http://devicetree.org/meta-schemas/core.yaml#

title: HiSilicon Hi3536D V100 MISC_CTRL block

maintainers:
  - Dylan Corrales <deathcamel58@gmail.com>

description: |
  The miscellaneous control registers (MISC_CTRL, base 0x12120000, a 64 KiB
  window) of the Hi3536D V100 and the Hi3536E: the USB 2.0 control words, the
  USB 2.0 PHY port registers (offset 0x8000), the SATA and FE PHY controls and
  the DDR master priorities. A plain syscon regmap; the USB 2.0 PHY node is a
  child and reaches the control words and its port registers through it. The
  clock and reset generator and the system controller are different blocks
  with their own bindings.

properties:
  compatible:
    items:
      - const: hisilicon,hi3536dv100-misc-ctrl
      - const: syscon
      - const: simple-mfd

  reg:
    maxItems: 1

  usb-phy:
    $ref: /schemas/phy/hisilicon,hi3536dv100-usb2-phy.yaml#
    description: On-chip USB 2.0 PHY

required:
  - compatible
  - reg

additionalProperties: false

examples:
  - |
    #include <dt-bindings/clock/hi3536dv100-clock.h>

    syscon@12120000 {
        compatible = "hisilicon,hi3536dv100-misc-ctrl", "syscon", "simple-mfd";
        reg = <0x12120000 0x10000>;

        usb-phy {
            compatible = "hisilicon,hi3536dv100-usb2-phy";
            #phy-cells = <0>;
            clocks = <&crg HI3536DV100_USB2_PHY_CLK>,
                     <&crg HI3536DV100_USB2_BUS_CLK>,
                     <&crg HI3536DV100_USB2_OHCI48M_CLK>,
                     <&crg HI3536DV100_USB2_OHCI12M_CLK>,
                     <&crg HI3536DV100_USB2_HST_PHY_CLK>,
                     <&crg HI3536DV100_USB2_UTMI0_CLK>,
                     <&crg HI3536DV100_USB2_UTMI1_CLK>;
            clock-names = "ref", "bus", "ohci48m", "ohci12m", "hst-phy",
                          "utmi0", "utmi1";
            resets = <&crg 0xb8 12>, <&crg 0xb8 13>, <&crg 0xb8 14>,
                     <&crg 0xb8 16>, <&crg 0xbc 1>, <&crg 0xbc 2>,
                     <&crg 0xbc 3>, <&crg 0xbc 4>;
            reset-names = "bus", "utmi0", "utmi1", "hst-phy", "phy",
                          "port0-treq", "port1-treq", "test";
        };
    };
```

## Documentation/devicetree/bindings/mtd/partitions/openipc,uimage-firmware.yaml
```yaml
# SPDX-License-Identifier: GPL-2.0-only OR BSD-2-Clause
%YAML 1.2
---
$id: http://devicetree.org/schemas/mtd/partitions/openipc,uimage-firmware.yaml#
$schema: http://devicetree.org/meta-schemas/core.yaml#

title: OpenIPC uImage Firmware Partition

description: |
  OpenIPC NOR flash images pack a legacy U-Boot uImage followed by a SquashFS
  root filesystem aligned to the next 64 KiB boundary inside a single firmware
  partition. Because the kernel and rootfs boundary depends on the image sizes
  rather than fixed offsets, subpartitions are discovered from the uImage and
  SquashFS headers at runtime, exposing kernel, rootfs and optional
  rootfs_data partitions.

maintainers:
  - Difan Zhang <alex@osqdu.org>

allOf:
  - $ref: partition.yaml#

properties:
  compatible:
    const: openipc,uimage-firmware

required:
  - compatible

unevaluatedProperties: false

examples:
  - |
    partitions {
        compatible = "fixed-partitions";
        #address-cells = <1>;
        #size-cells = <1>;

        partition@0 {
            label = "boot";
            reg = <0x000000 0x040000>;
        };

        partition@40000 {
            label = "env";
            reg = <0x040000 0x010000>;
        };

        partition@50000 {
            compatible = "openipc,uimage-firmware";
            reg = <0x050000 0x0>;
            label = "firmware";
        };
    };
```

## Documentation/devicetree/bindings/net/hisilicon,hisi-femac-mdio.yaml
```yaml
# SPDX-License-Identifier: GPL-2.0-only OR BSD-2-Clause
%YAML 1.2
---
$id: http://devicetree.org/schemas/net/hisilicon,hisi-femac-mdio.yaml#
$schema: http://devicetree.org/meta-schemas/core.yaml#

title: HiSilicon Fast Ethernet MAC (FEMAC) MDIO controller

maintainers:
  - Dylan Corrales <deathcamel58@gmail.com>

properties:
  compatible:
    oneOf:
      - const: hisilicon,hisi-femac-mdio
      - items:
          - enum:
              - hisilicon,hi3520dv100-femac-mdio
              - hisilicon,hi3520dv200-femac-mdio
          - const: hisilicon,hisi-femac-mdio

  reg:
    minItems: 1
    items:
      - description: MDIO registers
      - description: |
          Internal PHY control register (Hi3520D: SYS_CTRL, its low five bits
          set the address the PHY answers at). The Hi3520D compatibles need
          this window and have no third one.
      - description: |
          Internal PHY trim data, for chips that keep them in a separate
          window. Without it the trim data are read from the control register
          of the second window.

  clocks:
    minItems: 1
    items:
      - description: MDIO clock
      - description: internal PHY clock

  clock-names:
    minItems: 1
    items:
      - const: mdio
      - const: phy

  resets:
    minItems: 1
    maxItems: 2
    description:
      The external PHY reset and the internal PHY reset, in the order of
      reset-names.

  reset-names:
    oneOf:
      - minItems: 1
        items:
          - const: external-phy
          - const: internal-phy
      - items:
          - const: internal-phy

  hisilicon,phy-reset-delays-us:
    minItems: 3
    maxItems: 3
    description:
      Pre-delay, pulse and post-delay of the reset of an external PHY in
      microseconds, required with the "external-phy" reset.

required:
  - compatible
  - reg
  - clocks
  - clock-names

dependentRequired:
  resets: [reset-names]
  reset-names: [resets]

allOf:
  - $ref: mdio.yaml#

  - if:
      properties:
        compatible:
          contains:
            enum:
              - hisilicon,hi3520dv100-femac-mdio
              - hisilicon,hi3520dv200-femac-mdio
      required:
        - compatible
    then:
      properties:
        reg:
          minItems: 2
          maxItems: 2

  - if:
      properties:
        reset-names:
          contains:
            const: external-phy
      required:
        - reset-names
    then:
      required:
        - hisilicon,phy-reset-delays-us

  - if:
      properties:
        reset-names:
          minItems: 2
      required:
        - reset-names
    then:
      properties:
        resets:
          minItems: 2

  - if:
      properties:
        reset-names:
          maxItems: 1
      required:
        - reset-names
    then:
      properties:
        resets:
          maxItems: 1

unevaluatedProperties: false

examples:
  - |
    mdio@10091100 {
        compatible = "hisilicon,hisi-femac-mdio";
        reg = <0x10091100 0x10>;
        clocks = <&crg 25>;
        clock-names = "mdio";
        resets = <&crg 0xec 3>;
        reset-names = "external-phy";
        hisilicon,phy-reset-delays-us = <10000 20000 20000>;
        #address-cells = <1>;
        #size-cells = <0>;

        phy0: ethernet-phy@1 {
            reg = <1>;
        };
    };
  - |
    mdio@10091100 {
        compatible = "hisilicon,hi3520dv200-femac-mdio",
                     "hisilicon,hisi-femac-mdio";
        reg = <0x10091100 0x10>, <0x20050094 0x4>;
        clocks = <&crg 25>;
        clock-names = "mdio";
        #address-cells = <1>;
        #size-cells = <0>;

        phy1: ethernet-phy@3 {
            reg = <3>;
        };
    };
```

## Documentation/devicetree/bindings/net/hisilicon,hisi-femac.yaml
```yaml
# SPDX-License-Identifier: GPL-2.0-only OR BSD-2-Clause
%YAML 1.2
---
$id: http://devicetree.org/schemas/net/hisilicon,hisi-femac.yaml#
$schema: http://devicetree.org/meta-schemas/core.yaml#

title: HiSilicon Fast Ethernet MAC (FEMAC)

maintainers:
  - Dylan Corrales <deathcamel58@gmail.com>

description: |
  Fast Ethernet MAC (FEMAC) found in several HiSilicon Hi35xx SoCs. The Hi3520D
  V100 register description names the block ETH (HIETH_SF), the other chips
  name it FEMAC. The Hi3516E V200 and V300 and the Hi3518E V200 and V300 share
  one register description (94 registers, identical on each chip), and the
  Hi3518E V100 has 90 of those 94 at the same offsets and with the same layout.
  The registers that differ or are missing are the ones the driver does not
  use: a second port, the RX checksum offload register, VLAN counters and the
  EEE registers.

  This is not the gigabit MAC of the Hi3520D V300 (GSF), the Hi3531 or the
  Hi3535; that one is a different IP block of the GMAC family and has its own
  binding.

  On the Hi3520D V100 the controller is the "hieth-sf" switch fabric with two
  ports (up and down) that share the global registers. The
  "hisilicon,hi3520dv100-femac" compatible describes the up port, whose
  registers and bits are those of this binding, with the global register
  region as the second reg entry.

  The MAC address is not read from the controller. The driver takes it from
  the first of these that holds a valid address, in this order: an address
  that is all zeros (or has the multicast bit set) is not valid and is
  skipped. If none holds a valid address the driver uses a random one and
  logs a warning. "mac-address" and "local-mac-address" (usually filled in by
  the boot loader) and an NVMEM cell named "mac-address" are defined by
  ethernet-controller.yaml; the obsolete "address" property is also read by
  the OF core but is not part of the schema. A node that names an NVMEM cell
  but has no valid address property defers the probe until the provider of
  the cell is registered, and stays deferred if it never is.

properties:
  compatible:
    oneOf:
      - items:
          - enum:
              - hisilicon,hi3516cv300-femac
              - hisilicon,hi3516dv300-femac
              - hisilicon,hi3516ev200-femac
              - hisilicon,hi3516ev300-femac
              - hisilicon,hi3518ev20x-femac
              - hisilicon,hi3518ev300-femac
              - hisilicon,hi3520dv100-femac
              - hisilicon,hi3536dv100-femac
          - enum:
              - hisilicon,hisi-femac-v1
              - hisilicon,hisi-femac-v2
      - enum:
          - hisilicon,hi3516cv300-femac
          - hisilicon,hisi-femac-v1
          - hisilicon,hisi-femac-v2

  reg:
    items:
      - description: MAC core registers
      - description: global MAC control registers

  interrupts:
    maxItems: 1

  clocks:
    maxItems: 1
    description: MAC main clock

  resets:
    minItems: 1
    maxItems: 2
    description:
      The MAC reset and the PHY reset, in the order of reset-names.

  reset-names:
    oneOf:
      - minItems: 1
        items:
          - const: mac
          - const: phy
      - items:
          - const: phy

  hisilicon,phy-reset-delays-us:
    minItems: 3
    maxItems: 3
    description:
      Pre-delay, pulse and post-delay of the PHY reset in microseconds,
      required with the "phy" reset.

required:
  - compatible
  - reg
  - interrupts
  - clocks
  - phy-mode
  - phy-handle

dependentRequired:
  resets: [reset-names]
  reset-names: [resets]

allOf:
  - $ref: ethernet-controller.yaml#

  - if:
      properties:
        reset-names:
          contains:
            const: phy
      required:
        - reset-names
    then:
      required:
        - hisilicon,phy-reset-delays-us

  - if:
      properties:
        reset-names:
          minItems: 2
      required:
        - reset-names
    then:
      properties:
        resets:
          minItems: 2

  - if:
      properties:
        reset-names:
          maxItems: 1
      required:
        - reset-names
    then:
      properties:
        resets:
          maxItems: 1

unevaluatedProperties: false

examples:
  - |
    ethernet@10090000 {
        compatible = "hisilicon,hi3516cv300-femac", "hisilicon,hisi-femac-v2";
        reg = <0x10090000 0x1000>, <0x10091300 0x200>;
        interrupts = <12>;
        clocks = <&crg 25>;
        resets = <&crg 0xec 0>, <&crg 0xec 3>;
        reset-names = "mac", "phy";
        phy-mode = "mii";
        phy-handle = <&phy0>;
        hisilicon,phy-reset-delays-us = <10000 20000 20000>;
    };
```
