## Documentation/devicetree/bindings/media/i2c/soi,jxf23.yaml
```yaml
# SPDX-License-Identifier: (GPL-2.0-only OR BSD-2-Clause)
%YAML 1.2
---
$id: http://devicetree.org/schemas/media/i2c/soi,jxf23.yaml#
$schema: http://devicetree.org/meta-schemas/core.yaml#

title: Silicon Optronics JXF23, JXF37PA, JXF38P and JXH63P image sensors

maintainers:
  - Difan Zhang <alex@osqdu.org>

properties:
  compatible:
    enum:
      - soi,jxf23
      - soi,jxf37pa
      - soi,jxf38p
      - soi,jxh63p

  reg:
    maxItems: 1

  clocks:
    maxItems: 1

  clock-names:
    const: xvclk

  avdd-supply:
    description: Analog supply.

  dovdd-supply:
    description: I/O supply.

  dvdd-supply:
    description: Digital core supply.

  reset-gpios:
    maxItems: 1

  pwdn-gpios:
    maxItems: 1

  port:
    $ref: /schemas/graph.yaml#/$defs/port-base
    additionalProperties: false

    properties:
      endpoint:
        $ref: /schemas/media/video-interfaces.yaml#
        unevaluatedProperties: false

        properties:
          data-lanes:
            minItems: 1
            items:
              - const: 1
              - const: 2

          link-frequencies:
            maxItems: 1
            items:
              enum: [150000000, 216000000, 400000000, 432000000]

        required:
          - data-lanes
          - link-frequencies

    required:
      - endpoint

allOf:
  - if:
      properties:
        compatible:
          enum:
            - soi,jxf37pa
    then:
      properties:
        port:
          properties:
            endpoint:
              properties:
                data-lanes:
                  minItems: 2
                link-frequencies:
                  items:
                    const: 216000000
  - if:
      properties:
        compatible:
          enum:
            - soi,jxf38p
    then:
      properties:
        port:
          properties:
            endpoint:
              properties:
                data-lanes:
                  minItems: 2
                link-frequencies:
                  items:
                    const: 216000000
  - if:
      properties:
        compatible:
          enum:
            - soi,jxh63p
    then:
      properties:
        port:
          properties:
            endpoint:
              properties:
                data-lanes:
                  maxItems: 1
                link-frequencies:
                  items:
                    const: 432000000
  - if:
      properties:
        compatible:
          enum:
            - soi,jxf23
    then:
      properties:
        port:
          properties:
            endpoint:
              properties:
                data-lanes:
                  minItems: 2
                link-frequencies:
                  items:
                    enum: [150000000, 400000000]

required:
  - compatible
  - reg
  - clocks
  - clock-names
  - port

additionalProperties: false

examples:
  - |
    i2c {
        #address-cells = <1>;
        #size-cells = <0>;

        sensor@40 {
            compatible = "soi,jxf23";
            reg = <0x40>;
            clocks = <&sensor_clk>;
            clock-names = "xvclk";

            port {
                endpoint {
                    data-lanes = <1 2>;
                    link-frequencies = /bits/ 64 <400000000>;
                    remote-endpoint = <&csi_in>;
                };
            };
        };
    };
```

## Documentation/devicetree/bindings/media/i2c/superpix,sp140a.yaml
```yaml
# SPDX-License-Identifier: (GPL-2.0-only OR BSD-2-Clause)
%YAML 1.2
---
$id: http://devicetree.org/schemas/media/i2c/superpix,sp140a.yaml#
$schema: http://devicetree.org/meta-schemas/core.yaml#

title: SuperPix SP140A image sensor

maintainers:
  - Difan Zhang <alex@osqdu.org>

properties:
  compatible:
    const: superpix,sp140a

  reg:
    maxItems: 1

  clocks:
    maxItems: 1

  clock-names:
    const: xvclk

  avdd-supply:
    description: Analog supply.

  dovdd-supply:
    description: I/O supply.

  dvdd-supply:
    description: Digital core supply.

  reset-gpios:
    maxItems: 1

  pwdn-gpios:
    maxItems: 1

  port:
    $ref: /schemas/graph.yaml#/$defs/port-base
    additionalProperties: false

    properties:
      endpoint:
        $ref: /schemas/media/video-interfaces.yaml#
        unevaluatedProperties: false

        properties:
          data-lanes:
            items:
              - const: 1

          link-frequencies:
            maxItems: 1
            items:
              const: 360000000

        required:
          - data-lanes
          - link-frequencies

    required:
      - endpoint

required:
  - compatible
  - reg
  - clocks
  - clock-names
  - port

additionalProperties: false

examples:
  - |
    i2c {
        #address-cells = <1>;
        #size-cells = <0>;

        sensor@3c {
            compatible = "superpix,sp140a";
            reg = <0x3c>;
            clocks = <&sensor_clk>;
            clock-names = "xvclk";

            port {
                endpoint {
                    data-lanes = <1>;
                    link-frequencies = /bits/ 64 <360000000>;
                    remote-endpoint = <&csi_in>;
                };
            };
        };
    };
```

## Documentation/devicetree/bindings/media/ingenic,t23-helix.yaml
```yaml
# SPDX-License-Identifier: (GPL-2.0-only OR BSD-2-Clause)
%YAML 1.2
---
$id: http://devicetree.org/schemas/media/ingenic,t23-helix.yaml#
$schema: http://devicetree.org/meta-schemas/core.yaml#

title: Ingenic T23 Helix H.264 and JPEG Video Encoder

maintainers:
  - Paul Cercueil <paul@crapouillou.net>

description:
  Hardware H.264 (Baseline/Main/High Profile) and baseline JPEG video
  encoder block in Ingenic T23 SoCs driven via VDMA descriptor chains.

properties:
  compatible:
    const: ingenic,t23-helix

  reg:
    maxItems: 1

  interrupts:
    maxItems: 1

  clocks:
    items:
      - description: VPU core divider clock
      - description: AVPU/Helix bus gate clock
      - description: IVDC bus gate clock

  clock-names:
    items:
      - const: vpu
      - const: gate
      - const: ivdc

  resets:
    maxItems: 1

  memory-region:
    maxItems: 1

required:
  - compatible
  - reg
  - interrupts
  - clocks
  - clock-names

additionalProperties: false

examples:
  - |
    #include <dt-bindings/clock/ingenic,t23-cgu.h>
    #include <dt-bindings/reset/ingenic,t23-reset.h>

    video-codec@13100000 {
        compatible = "ingenic,t23-helix";
        reg = <0x13100000 0x100000>;
        interrupt-parent = <&intc>;
        interrupts = <40>;
        clocks = <&cgu CLK_CGU_VPU>, <&cgu CLK_AVPU>, <&cgu CLK_IVDC>;
        clock-names = "vpu", "gate", "ivdc";
        resets = <&cpm_reset T23_RESET_HELIX>;
    };
```

## Documentation/devicetree/bindings/media/ingenic,t23-ipu.yaml
```yaml
# SPDX-License-Identifier: (GPL-2.0-only OR BSD-2-Clause)
%YAML 1.2
---
$id: http://devicetree.org/schemas/media/ingenic,t23-ipu.yaml#
$schema: http://devicetree.org/meta-schemas/core.yaml#

title: Ingenic T23 Image Processing Unit (IPU v1.3)

maintainers:
  - Paul Cercueil <paul@crapouillou.net>

description:
  Hardware NV12/NV21 to packed RGB32/NV21 color-space converter in Ingenic
  T23 SoCs.

properties:
  compatible:
    const: ingenic,t23-ipu

  reg:
    maxItems: 1

  interrupts:
    maxItems: 1

  clocks:
    maxItems: 1

  clock-names:
    const: ipu

  memory-region:
    maxItems: 1

required:
  - compatible
  - reg
  - interrupts
  - clocks
  - clock-names

additionalProperties: false

examples:
  - |
    #include <dt-bindings/clock/ingenic,t23-cgu.h>

    ipu@13080000 {
        compatible = "ingenic,t23-ipu";
        reg = <0x13080000 0x8000>;
        interrupt-parent = <&intc>;
        interrupts = <6>;
        clocks = <&cgu CLK_IPU>;
        clock-names = "ipu";
    };
```

## Documentation/devicetree/bindings/media/ingenic,t23-isp.yaml
```yaml
# SPDX-License-Identifier: (GPL-2.0-only OR BSD-2-Clause)
%YAML 1.2
---
$id: http://devicetree.org/schemas/media/ingenic,t23-isp.yaml#
$schema: http://devicetree.org/meta-schemas/core.yaml#

title: Ingenic T23 MIPI CSI-2, VIC, ISP and MSCA Video Pipeline

maintainers:
  - Paul Cercueil <paul@crapouillou.net>

description:
  Ingenic T23 integrated image signal processing pipeline comprising the
  MIPI CSI-2 receiver and D-PHY, Video Input Controller (VIC), Tiziano ISP
  core, and 3-channel MSCA scaler/DMA output engine.

properties:
  compatible:
    const: ingenic,t23-isp

  reg:
    items:
      - description: ISP core and MSCA registers
      - description: Video Input Controller (VIC) registers
      - description: MIPI CSI-2 controller registers
      - description: MIPI D-PHY registers
      - description: IVDC frame-sharing registers

  reg-names:
    items:
      - const: core
      - const: vic
      - const: csi
      - const: phy
      - const: ivdc

  interrupts:
    items:
      - description: ISP core and MSCA interrupt
      - description: VIC capture interrupt
      - description: IVDC interrupt
    minItems: 2

  interrupt-names:
    items:
      - const: core
      - const: vic
      - const: ivdc
    minItems: 2

  clocks:
    items:
      - description: ISP divider clock
      - description: ISP bus gate clock
      - description: CSI gate clock
      - description: VPU/IVDC divider clock
      - description: IVDC gate clock

  clock-names:
    items:
      - const: cgu_isp
      - const: isp
      - const: csi
      - const: cgu_vpu
      - const: ivdc

  resets:
    maxItems: 1

  reset-names:
    items:
      - const: isp

  memory-region:
    maxItems: 1

  ingenic,frame-sync-source-port:
    $ref: /schemas/types.yaml#/definitions/uint32
    enum: [0, 1]
    description:
      Sensor port index driving dual-sensor TDM frame synchronization.

  ports:
    $ref: /schemas/graph.yaml#/properties/ports

    properties:
      port@0:
        $ref: /schemas/graph.yaml#/$defs/port-base
        unevaluatedProperties: false
        description: Primary MIPI CSI-2 / DVP sensor input port.

        properties:
          endpoint:
            $ref: /schemas/media/video-interfaces.yaml#
            unevaluatedProperties: false

      port@1:
        $ref: /schemas/graph.yaml#/$defs/port-base
        unevaluatedProperties: false
        description: Secondary TDM MIPI CSI-2 sensor input port.

        properties:
          endpoint:
            $ref: /schemas/media/video-interfaces.yaml#
            unevaluatedProperties: false

required:
  - compatible
  - reg
  - reg-names
  - interrupts
  - interrupt-names
  - clocks
  - clock-names
  - resets
  - reset-names

additionalProperties: false

examples:
  - |
    #include <dt-bindings/clock/ingenic,t23-cgu.h>
    #include <dt-bindings/reset/ingenic,t23-reset.h>

    isp@13300000 {
        compatible = "ingenic,t23-isp";
        reg = <0x13300000 0x90000>,
              <0x133e0000 0x10000>,
              <0x10023000 0x1000>,
              <0x10022000 0x1000>,
              <0x13200000 0x10000>;
        reg-names = "core", "vic", "csi", "phy", "ivdc";
        interrupt-parent = <&intc>;
        interrupts = <29>, <30>, <38>;
        interrupt-names = "core", "vic", "ivdc";
        clocks = <&cgu CLK_CGU_ISP>, <&cgu CLK_ISP>,
                 <&cgu CLK_CSI>, <&cgu CLK_CGU_VPU>,
                 <&cgu CLK_IVDC>;
        clock-names = "cgu_isp", "isp", "csi", "cgu_vpu", "ivdc";
        resets = <&cpm_reset T23_RESET_ISP>;
        reset-names = "isp";
    };
```

## Documentation/devicetree/bindings/media/ingenic,t23-motor.yaml
```yaml
# SPDX-License-Identifier: (GPL-2.0-only OR BSD-2-Clause)
%YAML 1.2
---
$id: http://devicetree.org/schemas/media/ingenic,t23-motor.yaml#
$schema: http://devicetree.org/meta-schemas/core.yaml#

title: Ingenic T23 GPIO Unipolar Stepper Pan/Tilt Camera Motor

maintainers:
  - Paul Cercueil <paul@crapouillou.net>

properties:
  compatible:
    const: ingenic,t23-motor

  pan-gpios:
    minItems: 4
    maxItems: 4
    description: Four unipolar phase GPIOs driving the pan stepper motor.

  tilt-gpios:
    minItems: 4
    maxItems: 4
    description: Four unipolar phase GPIOs driving the tilt stepper motor.

  switch-gpios:
    maxItems: 1
    description:
      Optional output multiplexer GPIO that switches a shared 4-wire coil
      driver between the pan and tilt motor windings.

  ingenic,pan-max-steps:
    description: Maximum travel range of the pan axis in motor steps.
    $ref: /schemas/types.yaml#/definitions/uint32

  ingenic,tilt-max-steps:
    description: Maximum travel range of the tilt axis in motor steps.
    $ref: /schemas/types.yaml#/definitions/uint32

  ingenic,pan-max-degrees:
    description: Angular range of the pan axis corresponding to pan-max-steps.
    $ref: /schemas/types.yaml#/definitions/uint32
    minimum: 1
    maximum: 360
    default: 355

  ingenic,tilt-max-degrees:
    description: Angular range of the tilt axis corresponding to tilt-max-steps.
    $ref: /schemas/types.yaml#/definitions/uint32
    minimum: 1
    maximum: 360
    default: 90

  ingenic,pan-reset-steps:
    description: Homing step count driven along the pan axis during reset.
    $ref: /schemas/types.yaml#/definitions/uint32

  ingenic,tilt-reset-steps:
    description: Homing step count driven along the tilt axis during reset.
    $ref: /schemas/types.yaml#/definitions/uint32

  ingenic,tilt-step-div:
    description: Timer divider applied to tilt step pulses relative to pan.
    $ref: /schemas/types.yaml#/definitions/uint32
    minimum: 1
    maximum: 64
    default: 1

required:
  - compatible
  - pan-gpios

additionalProperties: false

examples:
  - |
    #include <dt-bindings/gpio/gpio.h>

    motor {
        compatible = "ingenic,t23-motor";
        pan-gpios = <&gpb 22 GPIO_ACTIVE_HIGH>,
                    <&gpb 21 GPIO_ACTIVE_HIGH>,
                    <&gpb 20 GPIO_ACTIVE_HIGH>,
                    <&gpb 19 GPIO_ACTIVE_HIGH>;
        switch-gpios = <&gpa 17 GPIO_ACTIVE_HIGH>;
    };
```

## Documentation/devicetree/bindings/memory-controllers/ingenic,t23-ddr.yaml
```yaml
# SPDX-License-Identifier: (GPL-2.0-only OR BSD-2-Clause)
%YAML 1.2
---
$id: http://devicetree.org/schemas/memory-controllers/ingenic,t23-ddr.yaml#
$schema: http://devicetree.org/meta-schemas/core.yaml#

title: Ingenic T23 DDR Memory Controller

maintainers:
  - Paul Cercueil <paul@crapouillou.net>

properties:
  compatible:
    const: ingenic,t23-ddr

  reg:
    maxItems: 3

  reg-names:
    items:
      - const: controller
      - const: phy
      - const: apb

required:
  - compatible
  - reg
  - reg-names

additionalProperties: false

examples:
  - |
    memory-controller@134f0000 {
        compatible = "ingenic,t23-ddr";
        reg = <0x134f0000 0x400>,
              <0x13011000 0x100>,
              <0x13012000 0x100>;
        reg-names = "controller", "phy", "apb";
    };
```
