## Documentation/devicetree/bindings/arm/fullhan.txt
```
Fullhan FH8626V100 board and SoC

The FH8626V100 is an ARM1176JZF-S SoC.

Required root node properties:
- compatible: "fullhan,fh8626v100", with fallback "fullhan,fh8626"

Example:

/ {
	model = "Fullhan FH8626V100";
	compatible = "fullhan,fh8626v100", "fullhan,fh8626";
};

Boards:

- Tenda CP3 V2.2 pan/tilt camera
  compatible = "tenda,cp3-v22", "fullhan,fh8626v100", "fullhan,fh8626";
```

## Documentation/devicetree/bindings/arm/hisilicon/hisilicon-bvt.yaml
```yaml
# SPDX-License-Identifier: (GPL-2.0-only OR BSD-2-Clause)
%YAML 1.2
---
$id: http://devicetree.org/schemas/arm/hisilicon/hisilicon-bvt.yaml#
$schema: http://devicetree.org/meta-schemas/core.yaml#

title: HiSilicon BVT IP Camera SoC Platforms

maintainers:
  - Dmitry Ilyin <6576495+widgetii@users.noreply.github.com>

description: |
  HiSilicon BVT (Broadcast Video Technology) SoC family: ARM Cortex-A7
  processors, and the earlier ARM926EJ-S Hi3516C V200 and Hi3518E V20X
  parts, used in IP cameras and video surveillance equipment.

  hisilicon,hi3518ev200 is the ARM926EJ-S Hi3518E V200, which the
  hisilicon,hi3518ev20x name predates and replaces; the latter names no chip
  and is deprecated.

properties:
  $nodename:
    const: /
  compatible:
    oneOf:
      - items:
          - const: hisilicon,hi3516ev200
      - items:
          - const: hisilicon,hi3516ev300
      - items:
          - const: hisilicon,hi3516cv200
      - items:
          - const: hisilicon,hi3518ev200
      - items:
          - const: hisilicon,hi3518ev20x
        deprecated: true
      - items:
          - const: hisilicon,hi3518ev300
      - items:
          - const: hisilicon,hi3516dv200
      - items:
          - const: hisilicon,hi3516dv300
      - items:
          - const: hisilicon,hi3536dv100

additionalProperties: true
```

## Documentation/devicetree/bindings/clock/hisilicon,hi3516cv300-crg.yaml
```yaml
# SPDX-License-Identifier: (GPL-2.0-only OR BSD-2-Clause)
%YAML 1.2
---
$id: http://devicetree.org/schemas/clock/hisilicon,hi3516cv300-crg.yaml#
$schema: http://devicetree.org/meta-schemas/core.yaml#

title: HiSilicon Hi3516C V300 / Hi3516E V100 Clock and Reset Generator (CRG) and system controller

maintainers:
  - Dylan Corrales <deathcamel58@gmail.com>

description: |
  The CRG of the Hi3516C V300 and the Hi3516E V100 ARM926EJ-S IP camera SoCs
  provides the three PLLs, the CPU, DDR and system APB clock selects, the
  module clock selects, the peripheral clock gates and the peripheral soft
  resets. Both SoCs are described by one data sheet with one CRG register
  map and one chip ID (SC_SYSID 0x3516_C300), so the Hi3516C V300 compatibles
  are the fallback of the Hi3516E V100 ones. The SP804 timer count clock
  selects live in the system controller, which has its own compatible and
  provides those clocks.

  The PLLs and the CPU, DDR and system APB clock selects are read only: the
  boot loader programs them (a switch needs the PLL lock and the handshake
  bits of PERI_CRG55). The clock driver reads them back, the fixed module
  clocks are dividers of the decoded VPLL and EPLL outputs and of the
  crystal, and it says so when a PLL is not locked, bypassed, powered down or
  not at the output of the data sheet clock tree. The system
  controller registers are write protected by SC_LOCKEN, so the timer count
  clock selects are read only as well. The module clock selects and the
  Ethernet interface selects of PERI_CRG59 (core clock, RMII clock source and
  the clock output to the PHY) are writable clock muxes, so that a board can
  choose them with assigned-clock-parents instead of relying on the boot
  loader. Nothing is written unless a device tree asks for it. The clock
  core reports the select it reads, and the select of the Ethernet core clock
  is 99 MHz after reset but may hold 54 MHz when a boot loader has used the
  network, so a board that needs one of the two sets it explicitly.

  The hisilicon,hi3516cv300-sys compatible is the name that the vendor device
  trees use for the system controller; it is deprecated and accepted for the
  existing device trees.

  Reset specifiers have two cells: the register offset from the CRG base and
  the bit number. A set bit holds the peripheral in reset, for example
  <&crg 0xec 0> is the soft reset of the Ethernet MAC. Only the soft reset
  bits that the data sheet lists are valid: a specifier that names another
  register or bit is rejected. The ARM core, DDR test and PLL spread spectrum
  modulator resets are not available.

  See include/dt-bindings/clock/hi3516cv300-clock.h for the clock identifiers.

properties:
  compatible:
    oneOf:
      - items:
          - const: hisilicon,hi3516ev100-crg
          - const: hisilicon,hi3516cv300-crg
      - const: hisilicon,hi3516cv300-crg
      - items:
          - const: hisilicon,hi3516ev100-sysctrl
          - const: hisilicon,hi3516cv300-sysctrl
          - const: syscon
      - items:
          - const: hisilicon,hi3516cv300-sysctrl
          - const: syscon
      - items:
          - const: hisilicon,hi3516cv300-sys
          - const: syscon
        deprecated: true

  reg:
    maxItems: 1

  '#clock-cells':
    const: 1

  '#reset-cells':
    const: 2

required:
  - compatible
  - reg
  - '#clock-cells'

allOf:
  - if:
      properties:
        compatible:
          contains:
            const: hisilicon,hi3516cv300-crg
    then:
      required:
        - '#reset-cells'
    else:
      properties:
        '#reset-cells': false

additionalProperties: false

examples:
  - |
    clock-controller@12010000 {
        compatible = "hisilicon,hi3516cv300-crg";
        reg = <0x12010000 0x1000>;
        #clock-cells = <1>;
        #reset-cells = <2>;
    };

    system-controller@12020000 {
        compatible = "hisilicon,hi3516cv300-sysctrl", "syscon";
        reg = <0x12020000 0x1000>;
        #clock-cells = <1>;
    };

  - |
    clock-controller@12010000 {
        compatible = "hisilicon,hi3516ev100-crg", "hisilicon,hi3516cv300-crg";
        reg = <0x12010000 0x1000>;
        #clock-cells = <1>;
        #reset-cells = <2>;
    };
```

## Documentation/devicetree/bindings/clock/hisilicon,hi3516ev200-clock.yaml
```yaml
# SPDX-License-Identifier: (GPL-2.0-only OR BSD-2-Clause)
%YAML 1.2
---
$id: http://devicetree.org/schemas/clock/hisilicon,hi3516ev200-clock.yaml#
$schema: http://devicetree.org/meta-schemas/core.yaml#

title: HiSilicon BVT SoC Clock/Reset Generator (CRG)

maintainers:
  - Dmitry Ilyin <6576495+widgetii@users.noreply.github.com>

description: |
  The CRG (Clock/Reset Generator) provides clock and reset control for
  all peripherals on HiSilicon BVT IP camera SoCs.

properties:
  compatible:
    enum:
      - hisilicon,hi3516ev200-clock
      - hisilicon,hi3516ev300-clock
      - hisilicon,hi3518ev300-clock
      - hisilicon,hi3516dv200-clock
      - hisilicon,hi3516dv300-clock

  reg:
    maxItems: 1

  '#clock-cells':
    const: 1

  '#reset-cells':
    const: 2

required:
  - compatible
  - reg
  - '#clock-cells'
  - '#reset-cells'

additionalProperties: false

examples:
  - |
    clock@12010000 {
        compatible = "hisilicon,hi3516ev300-clock";
        reg = <0x12010000 0x1000>;
        #clock-cells = <1>;
        #reset-cells = <2>;
    };
```

## Documentation/devicetree/bindings/clock/hisilicon,hi3516ev200-crg.yaml
```yaml
# SPDX-License-Identifier: (GPL-2.0-only OR BSD-2-Clause)
%YAML 1.2
---
$id: http://devicetree.org/schemas/clock/hisilicon,hi3516ev200-crg.yaml#
$schema: http://devicetree.org/meta-schemas/core.yaml#

title: HiSilicon Hi3516E V200 and Hi3516E V300 Clock and Reset Generator (CRG)

maintainers:
  - Dylan Corrales <deathcamel58@gmail.com>

description: |
  The CRG of the Hi3516E V200 and the Hi3516E V300 provides the PLLs, the
  CPU, DDR and bus clock selection, the peripheral clock gates and selects,
  and the peripheral soft resets. The two chips have the same register map
  as far as the Hi3516E V300 data sheet (Issue 00B06) and the vendor code
  for the Hi3516E V200 tell, but there is no data sheet register chapter
  for the Hi3516E V200 and a few bits differ, so each chip has its own
  compatible and neither falls back to the other.

  Reset specifiers have two cells: the register offset from the CRG base and
  the bit number. A set bit holds the peripheral in reset, for example
  <&crg 0x16c 0> is the soft reset of the Ethernet MAC. Only the soft reset
  bits of the peripherals are valid: a specifier that names another register
  or bit is rejected. The ARM core, DDR and DDR test resets are not available.

  The clock identifiers are in include/dt-bindings/clock/hi3516ev200-clock.h.
  The SP804 timer count clock selects are in the system controller, see
  Documentation/devicetree/bindings/arm/hisilicon/controller/sysctrl.yaml.

properties:
  compatible:
    oneOf:
      - items:
          - enum:
              - hisilicon,hi3516ev200-crg
              - hisilicon,hi3516ev300-crg
          - const: syscon
      - enum:
          - hisilicon,hi3516ev200-crg
          - hisilicon,hi3516ev300-crg
      - description:
          Names used by device trees written for the vendor kernel, matched
          by the driver for compatibility, with and without the syscon.
        items:
          - enum:
              - hisilicon,hi3516ev200-clock
              - hisilicon,hi3516ev300-clock
          - const: syscon
        deprecated: true
      - description:
          The same deprecated names alone, as the former binding allowed.
        enum:
          - hisilicon,hi3516ev200-clock
          - hisilicon,hi3516ev300-clock
        deprecated: true

  reg:
    maxItems: 1

  '#clock-cells':
    const: 1

  '#reset-cells':
    const: 2

required:
  - compatible
  - reg
  - '#clock-cells'
  - '#reset-cells'

additionalProperties: false

examples:
  - |
    clock-controller@12010000 {
        compatible = "hisilicon,hi3516ev300-crg", "syscon";
        reg = <0x12010000 0x1000>;
        #clock-cells = <1>;
        #reset-cells = <2>;
    };
```

## Documentation/devicetree/bindings/clock/hisilicon,hi3518ev200-crg.yaml
```yaml
# SPDX-License-Identifier: (GPL-2.0-only OR BSD-2-Clause)
%YAML 1.2
---
$id: http://devicetree.org/schemas/clock/hisilicon,hi3518ev200-crg.yaml#
$schema: http://devicetree.org/meta-schemas/core.yaml#

title: HiSilicon Hi3516C V200 / Hi3518E V200 Clock and Reset Generator (CRG) and system controller

maintainers:
  - Vasiliy Yakovlev <vixand@openipc.org>

description: |
  The CRG of the Hi3516C V200 and the Hi3518E V200 (and V201) ARM926EJ-S IP
  camera SoCs provides the PLLs, the CPU and bus clock selection, the
  peripheral clock gates and the peripheral soft resets. Both SoCs have the
  same register description, so the Hi3518E V200 compatibles are the fallback
  of the Hi3516C V200 ones. The SP804 timer count clock selects live in the
  system controller, which has its own compatible and provides those clocks.

  The hisilicon,hi3518ev20x-clock and hisilicon,hi3518ev20x-sysctrl
  compatibles name no chip and are deprecated; they are accepted for the
  existing device trees.

  Reset specifiers have two cells: the register offset from the CRG base and
  the bit number. A set bit holds the peripheral in reset.

  See include/dt-bindings/clock/hi3516cv200-clock.h for the clock identifiers.

properties:
  compatible:
    oneOf:
      - items:
          - const: hisilicon,hi3516cv200-crg
          - const: hisilicon,hi3518ev200-crg
      - const: hisilicon,hi3518ev200-crg
      - const: hisilicon,hi3518ev20x-clock
        deprecated: true
      - items:
          - const: hisilicon,hi3516cv200-sysctrl
          - const: hisilicon,hi3518ev200-sysctrl
          - const: syscon
      - items:
          - const: hisilicon,hi3518ev200-sysctrl
          - const: syscon
      - items:
          - const: hisilicon,hi3518ev20x-sysctrl
          - const: syscon
        deprecated: true

  reg:
    maxItems: 1

  '#clock-cells':
    const: 1

  '#reset-cells':
    const: 2

required:
  - compatible
  - reg
  - '#clock-cells'

allOf:
  - if:
      properties:
        compatible:
          contains:
            enum:
              - hisilicon,hi3518ev200-crg
              - hisilicon,hi3518ev20x-clock
    then:
      required:
        - '#reset-cells'
    else:
      properties:
        '#reset-cells': false

additionalProperties: false

examples:
  - |
    clock-controller@20030000 {
        compatible = "hisilicon,hi3516cv200-crg", "hisilicon,hi3518ev200-crg";
        reg = <0x20030000 0x1000>;
        #clock-cells = <1>;
        #reset-cells = <2>;
    };

    system-controller@20050000 {
        compatible = "hisilicon,hi3516cv200-sysctrl",
                     "hisilicon,hi3518ev200-sysctrl", "syscon";
        reg = <0x20050000 0x1000>;
        #clock-cells = <1>;
    };
```

## Documentation/devicetree/bindings/clock/hisilicon,hi3536dv100-crg.yaml
```yaml
# SPDX-License-Identifier: (GPL-2.0-only OR BSD-2-Clause)
%YAML 1.2
---
$id: http://devicetree.org/schemas/clock/hisilicon,hi3536dv100-crg.yaml#
$schema: http://devicetree.org/meta-schemas/core.yaml#

title: HiSilicon Hi3536D V100 Clock and Reset Generator (CRG) and system controller

maintainers:
  - Dylan Corrales <deathcamel58@gmail.com>

description: |
  The CRG of the Hi3536D V100, the single Cortex-A7 NVR decoder SoC (marked
  Hi3536DRBCV100), provides six PLLs, the CPU, DDR and bus clock selects, the
  module clock selects, the peripheral clock gates and the peripheral soft
  resets. The Hi3536E (marked Hi3536ERBCV100) reports the same SCSYSID
  (0x3536D100) and is described by the same compatible: it is known to differ
  from the Hi3536D V100 in the PLL and DDR setup of its boot code and in
  SC_SYSID0 (offset 0xee0 of the system controller, reported as 0x02000000
  by the OpenIPC U-Boot, where a Hi3536D V100 reads 0x01000000), and no data
  sheet of it exists, so nothing else is known about its clock tree. Nothing
  available shows a difference in its register map (the driver reads the PLLs
  and does not depend on their values), so it has no compatible of its own: one
  goes in front of this one when a register dump shows a clock tree difference.

  The SP804 timer count clock selects live in the system controller, which
  has its own compatible and provides those clocks.

  Reset specifiers have two cells: the register offset from the CRG base and
  the bit number. A set bit holds the peripheral in reset, for example
  <&crg 0xc4 0> is the soft reset of the Ethernet MAC. A specifier that names
  a register or a bit that is not a listed reset is rejected.

  See include/dt-bindings/clock/hi3536dv100-clock.h for the clock identifiers
  and the reset bits.

properties:
  compatible:
    oneOf:
      - const: hisilicon,hi3536dv100-crg
      - items:
          - const: hisilicon,hi3536dv100-sysctrl
          - const: syscon

  reg:
    maxItems: 1

  '#clock-cells':
    const: 1

  '#reset-cells':
    const: 2

required:
  - compatible
  - reg
  - '#clock-cells'

allOf:
  - if:
      properties:
        compatible:
          contains:
            const: hisilicon,hi3536dv100-crg
    then:
      required:
        - '#reset-cells'
    else:
      properties:
        '#reset-cells': false

additionalProperties: false

examples:
  - |
    clock-controller@12040000 {
        compatible = "hisilicon,hi3536dv100-crg";
        reg = <0x12040000 0x1000>;
        #clock-cells = <1>;
        #reset-cells = <2>;
    };

    system-controller@12050000 {
        compatible = "hisilicon,hi3536dv100-sysctrl", "syscon";
        reg = <0x12050000 0x1000>;
        #clock-cells = <1>;
    };
```
