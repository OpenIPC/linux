## arch/arm/configs/hi3516cv610_defconfig
```kconfig
# CONFIG_LOCALVERSION_AUTO is not set
# CONFIG_SWAP is not set
CONFIG_SYSVIPC=y
CONFIG_USELIB=y
CONFIG_LOG_BUF_SHIFT=14
CONFIG_SYSFS_DEPRECATED=y
CONFIG_RELAY=y
CONFIG_CC_OPTIMIZE_FOR_SIZE=y
CONFIG_SGETMASK_SYSCALL=y
# CONFIG_FHANDLE is not set
CONFIG_BPF_SYSCALL=y
CONFIG_USERFAULTFD=y
CONFIG_EMBEDDED=y
# CONFIG_SLAB_MERGE_DEFAULT is not set
CONFIG_ARCH_BSP=y
CONFIG_ARCH_HI3516CV610=y
# CONFIG_VDSO is not set
# CONFIG_CACHE_L2X0 is not set
CONFIG_SMP=y
CONFIG_THUMB2_KERNEL=y
# CONFIG_ARM_PATCH_IDIV is not set
CONFIG_CPU_SW_DOMAIN_PAN=y
# CONFIG_ARM_MODULE_PLTS is not set
CONFIG_ARM_APPENDED_DTB=y
CONFIG_ARM_ATAG_DTB_COMPAT=y
CONFIG_BUILD_ARM_APPENDED_DTB_IMAGE_NAMES="hi3516cv610-demb"
CONFIG_VFP=y
CONFIG_NEON=y
# CONFIG_SUSPEND is not set
# CONFIG_GCC_PLUGINS is not set
CONFIG_MODULES=y
CONFIG_MODULE_UNLOAD=y
CONFIG_PARTITION_ADVANCED=y
CONFIG_CMDLINE_PARTITION=y
# CONFIG_MQ_IOSCHED_DEADLINE is not set
# CONFIG_MQ_IOSCHED_KYBER is not set
# CONFIG_ENABLE_IPREC_DEBUG is not set
CONFIG_NET=y
CONFIG_PACKET=y
CONFIG_UNIX=y
CONFIG_INET=y
CONFIG_IP_MULTICAST=y
# CONFIG_IPV6 is not set
CONFIG_NETFILTER=y
# CONFIG_WIRELESS is not set
# CONFIG_ETHTOOL_NETLINK is not set
CONFIG_UEVENT_HELPER=y
CONFIG_UEVENT_HELPER_PATH="/sbin/hotplug"
CONFIG_DEVTMPFS=y
CONFIG_DEVTMPFS_MOUNT=y
# CONFIG_PREVENT_FIRMWARE_BUILD is not set
CONFIG_FW_LOADER=m
CONFIG_MTD=y
CONFIG_MTD_CMDLINE_PARTS=y
CONFIG_MTD_BLOCK2MTD=y
CONFIG_MTD_SPI_NAND_BSP=y
CONFIG_MTD_RAW_NAND=y
CONFIG_MTD_SPI_NAND_FMC100=y
CONFIG_MTD_SPI_NOR=y
# CONFIG_MTD_SPI_NOR_USE_4K_SECTORS is not set
CONFIG_SPI_BSP_SFC=y
# CONFIG_CLOSE_SPI_8PIN_4IO is not set
CONFIG_MTD_UBI=y
CONFIG_BLK_DEV_LOOP=y
CONFIG_BLK_DEV_RAM=y
CONFIG_BLK_DEV_RAM_SIZE=65536
CONFIG_SCSI=y
CONFIG_BLK_DEV_SD=y
CONFIG_NETDEVICES=y
# CONFIG_NET_VENDOR_ALACRITECH is not set
# CONFIG_NET_VENDOR_AMAZON is not set
# CONFIG_NET_VENDOR_AQUANTIA is not set
# CONFIG_NET_VENDOR_ARC is not set
# CONFIG_NET_VENDOR_AURORA is not set
# CONFIG_NET_VENDOR_BROADCOM is not set
# CONFIG_NET_VENDOR_CADENCE is not set
# CONFIG_NET_VENDOR_CAVIUM is not set
# CONFIG_NET_VENDOR_CIRRUS is not set
# CONFIG_NET_VENDOR_CORTINA is not set
# CONFIG_NET_VENDOR_EZCHIP is not set
# CONFIG_NET_VENDOR_FARADAY is not set
# CONFIG_NET_VENDOR_GOOGLE is not set
# CONFIG_NET_VENDOR_HISILICON is not set
# CONFIG_NET_VENDOR_HUAWEI is not set
# CONFIG_NET_VENDOR_INTEL is not set
CONFIG_VENDOR_FEMAC=y
# CONFIG_NET_VENDOR_MARVELL is not set
# CONFIG_NET_VENDOR_MICREL is not set
# CONFIG_NET_VENDOR_MICROCHIP is not set
# CONFIG_NET_VENDOR_MICROSEMI is not set
# CONFIG_NET_VENDOR_NATSEMI is not set
# CONFIG_NET_VENDOR_NETRONOME is not set
# CONFIG_NET_VENDOR_NI is not set
# CONFIG_NET_VENDOR_PENSANDO is not set
# CONFIG_NET_VENDOR_QUALCOMM is not set
# CONFIG_NET_VENDOR_RENESAS is not set
# CONFIG_NET_VENDOR_ROCKER is not set
# CONFIG_NET_VENDOR_SAMSUNG is not set
# CONFIG_NET_VENDOR_SEEQ is not set
# CONFIG_NET_VENDOR_SOLARFLARE is not set
# CONFIG_NET_VENDOR_SMSC is not set
# CONFIG_NET_VENDOR_SOCIONEXT is not set
# CONFIG_NET_VENDOR_STMICRO is not set
# CONFIG_NET_VENDOR_SYNOPSYS is not set
# CONFIG_NET_VENDOR_VIA is not set
# CONFIG_NET_VENDOR_WIZNET is not set
# CONFIG_NET_VENDOR_XILINX is not set
CONFIG_MDIO_VENDOR_FEMAC=y
CONFIG_USB_USBNET=y
CONFIG_USB_NET_RNDIS_HOST=y
# CONFIG_USB_NET_CDC_SUBSET is not set
# CONFIG_USB_NET_ZAURUS is not set
# CONFIG_WLAN is not set
CONFIG_INPUT_EVDEV=y
# CONFIG_INPUT_KEYBOARD is not set
# CONFIG_INPUT_MOUSE is not set
# CONFIG_SERIO is not set
# CONFIG_LEGACY_PTYS is not set
CONFIG_SERIAL_AMBA_PL011=y
CONFIG_SERIAL_AMBA_PL011_CONSOLE=y
# CONFIG_HW_RANDOM is not set
CONFIG_I2C=y
CONFIG_I2C_CHARDEV=y
CONFIG_I2C_BSP=y
CONFIG_SPI=y
CONFIG_SPI_PL022=y
CONFIG_SPI_SPIDEV=y
CONFIG_GPIOLIB=y
CONFIG_GPIO_SYSFS=y
CONFIG_GPIO_GENERIC_PLATFORM=y
CONFIG_GPIO_PL061=y
CONFIG_POWER_RESET_BSP=y
# CONFIG_HWMON is not set
CONFIG_MFD_BSP_FMC=y
CONFIG_MFD_SYSCON=y
# CONFIG_MEDIA_CEC_SUPPORT is not set
CONFIG_MEDIA_SUPPORT=y
CONFIG_MEDIA_USB_SUPPORT=y
CONFIG_USB_VIDEO_CLASS=y
# CONFIG_USB_GSPCA is not set
# CONFIG_RADIO_ADAPTERS is not set
CONFIG_SOUND=y
CONFIG_SND=y
# CONFIG_SND_ARM is not set
CONFIG_USB=y
CONFIG_USB_XHCI_HCD=y
CONFIG_USB_STORAGE=y
CONFIG_USB_DWC3=y
CONFIG_USB_GADGET=y
CONFIG_USB_CONFIGFS=y
CONFIG_USB_CONFIGFS_ACM=y
CONFIG_USB_CONFIGFS_RNDIS=y
CONFIG_USB_CONFIGFS_MASS_STORAGE=y
CONFIG_USB_CONFIGFS_F_UAC1=y
CONFIG_USB_CONFIGFS_F_UVC=y
CONFIG_MPP_TO_GADGET_UVC=y
CONFIG_MMC=y
CONFIG_MMC_SDHCI=y
CONFIG_MMC_SDHCI_PLTFM=y
# CONFIG_VIRTIO_MENU is not set
# CONFIG_VHOST_MENU is not set
# CONFIG_ARM_ARCH_TIMER_EVTSTREAM is not set
# CONFIG_IOMMU_SUPPORT is not set
CONFIG_PWM=y
CONFIG_PWM_SYSFS=y
CONFIG_PWM_BSP=y
# CONFIG_NVMEM is not set
CONFIG_USB_WING=y
CONFIG_WING_UPS_PHY=y
CONFIG_WING_UPS_XVP_PHY=y
CONFIG_WING_UPS_MISSILE_PHY=y
CONFIG_MMC_SDHCI_NEBULA=y
# CONFIG_DNOTIFY is not set
CONFIG_VFAT_FS=y
CONFIG_TMPFS=y
CONFIG_TMPFS_POSIX_ACL=y
CONFIG_JFFS2_FS=y
CONFIG_UBIFS_FS=y
CONFIG_CRAMFS=y
CONFIG_SQUASHFS=y
CONFIG_SQUASHFS_LZO=y
CONFIG_SQUASHFS_XZ=y
CONFIG_NFS_FS=y
CONFIG_NFS_V3_ACL=y
CONFIG_NLS_CODEPAGE_437=y
CONFIG_NLS_ISO8859_1=y
CONFIG_SECURITY_DMESG_RESTRICT=y
CONFIG_HARDENED_USERCOPY=y
CONFIG_INIT_ON_ALLOC_DEFAULT_ON=y
CONFIG_CRYPTO_ECB=y
CONFIG_CRYPTO_CMAC=y
CONFIG_CRYPTO_SHA256=y
CONFIG_CRYPTO_AES=y
CONFIG_CRC_CCITT=y
CONFIG_MAGIC_SYSRQ=y
CONFIG_PANIC_ON_OOPS=y
CONFIG_DETECT_HUNG_TASK=y
CONFIG_SCHEDSTATS=y
CONFIG_STACKTRACE=y
# CONFIG_RCU_TRACE is not set
# CONFIG_FTRACE is not set
CONFIG_STRICT_DEVMEM=y
CONFIG_IO_STRICT_DEVMEM=y
CONFIG_DEBUG_USER=y
```

## arch/arm/mach-anycloud/Kconfig
```kconfig
# linux/arch/arm/mach-anycloud/Kconfig
#
# Copyright 2018 Anyka Microelectronics
#
# Licensed under GPLv2

# Machine support

config MACH_AK37D
	bool "anycloudv500 ak37d support"
	depends on ARCH_AK
	help
	  Support for ak37d

config MACH_AK39EV330
	bool "anycloudv500 ak39ev330 support"
	depends on ARCH_AK
	help
	  Support for ak39ev330

config MACH_AK37E
	bool "anycloudv500 ak37e support"
	depends on ARCH_AK
	help
		Support for ak37e


config MACH_AK3918AV100
	bool "anycloudv500 AK3918AV100 support"
	depends on ARCH_AK
	select MULTI_IRQ_HANDLER
	help
		Support for AK3918AV100

config MACH_AK3918AV100_FPGA
	bool "anycloudv500 AK3918AV100 fpga support"
	depends on MACH_AK3918AV100
	help
		Support for AK3918AV100 fpga

config MACH_AK3918EV300L
	bool "anycloud AK3918EV300L support"
	depends on ARCH_AK
	select MULTI_IRQ_HANDLER
	help
		Support for AK3918EV300L

config AK_OPENIPC_DTB
	string "Device tree appended to the uImage"
	depends on ARCH_AK
	default "ak3918ev300l-demb" if MACH_AK3918EV300L
	default "ak3918av100-demb" if MACH_AK3918AV100
	default ""
	help
	  Name, without .dtb, of the blob arch/arm/boot/Makefile appends to
	  the zImage to make the uImage (CONFIG_ARM_APPENDED_DTB), as
	  OpenIPC's NOR images boot it: ak3918av100-demb for the 64 MB
	  AK3918AV100N/P and KM01N, ak3918av100x-demb for the 128 MB
	  AK3918AV100X/XP and KM01D, ak3918ev300l-demb for the AK3918EV300L,
	  or a camera's own board. Empty: the plain zImage, as the SDK boots
	  it with its DTB partition.
```

## arch/arm/mach-fh/Kconfig
```kconfig
if ARCH_FULLHAN

menu "Fullhan platform type"


menuconfig FH_FASTBOOT
    bool "Fastboot configurations"
    default n
    help
      Fullhan Fastboot configurations

if FH_FASTBOOT
config DEFERRED_INIICALLS
    bool "Enable deferred initcalls support"
    default n
    help
      enable deferred initcalls, use deferred_initcall() to deferred some initcalls,
      after kernel boot, use cat /proc/deferred_initcalls to run all deferred initcalls

if DEFERRED_INIICALLS
config DEFERRED_INIICALLS_DEBUG
    bool "Debug deferred initcalls"
    default n

config DEFERRED_INIICALLS_SLAB_SYSFS
    bool "defer slab_sysfs_init"
    default n
    depends on SYSFS

config DEFERRED_INIICALLS_IRQ_SYSFS
    bool "defer irq_sysfs_init"
    default n
    depends on SYSFS

config DEFERRED_INIICALLS_PARAM_SYSFS
    bool "defer param_sysfs_init"
    depends on SYSFS
    default n

config DEFERRED_INIICALLS_GMAC
    bool "defer gmac driver init"
    default n
    depends on FH_GMAC=y

config DEFERRED_INIICALLS_SPI
    bool "defer spi driver init"
    default n
    depends on SPI_FH=y

config DEFERRED_INIICALLS_MMC
    bool "defer mmc driver init"
    default n
    depends on MMC_FH=y

config DEFERRED_INIICALLS_USB
    bool "defer usb driver init"
    default n
    depends on USB_DWC2=y

config DEFERRED_INIICALLS_RTC
    bool "defer rtc driver init"
    default n
    depends on RTC_DRV_FH=y
endif

endif

choice
prompt "Board"
config ARCH_FH8626V100
	bool "Fullhan FH8626V100"
	select CPU_V6
	select FULLHAN_INTC
	select FULLHAN_TIMER
	help
	  Enable support for the Fullhan FH8626V100 SoC. The target uses an
	  ARMv6 CPU with the Fullhan interrupt controller and timer. This
	  option provides the SoC-level facilities required by the legacy
	  non-device-tree platform code; board devices are registered by the
	  matching machine configuration.

config ARCH_FH885xV200
        bool "Fullhan FH885xV200"
        select CPU_V6
        select FULLHAN_INTC
        select FULLHAN_TIMER
        select PINCTRL if USE_OF
        help
          Support for Fullhan FH885xV200 SoC

endchoice
config FH_CHIP_NAME
        string
        prompt "Select chip name, keep default"
        default "fh8626v100" if MACH_FH8626V100
        default "fh8856v200" if MACH_FH8856V200
        default "fh8852v200" if MACH_FH8852V200
        default "fh8858v200" if MACH_FH8858V200
        default "fh8856v210" if MACH_FH8856V210
        default "fh8852v210" if MACH_FH8852V210
        default "fh8858v210" if MACH_FH8858V210

config MACH_FH8626V100
	bool "FullHan FH8626V100 board"
	default y
	depends on ARCH_FH8626V100
	help
	  Enable the legacy non-device-tree machine description for
	  FH8626V100 boards. It preserves the stock U-Boot ATAG handoff and
	  the verified early MMIO mappings while the native OpenIPC kernel is
	  brought up incrementally. Device support is added only after the
	  corresponding FH8626V100 hardware contract is verified.

config FH8626V100_ONCHIP_RTC
	bool "Enable the FH8626V100 on-chip RTC"
	default y
	depends on MACH_FH8626V100 && RTC_DRV_FH
	help
	  Register the FH8626V100 on-chip RTC platform device. Individual board
	  profiles may disable it when the required clock/backup hardware is not
	  available or has not been validated on that board. The Fullhan TSENSOR
	  is accessed through the same RTC core command channel rather than a
	  direct temperature MMIO register, so enabling this option is also a
	  prerequisite for the legacy TSENSOR path but does not prove that either
	  function works on a particular board.

config FH8626V100_AJL33PQ0866_MMC
	bool "Enable AJL33PQ0866 one-bit SD0 slot"
	default n
	depends on MACH_FH8626V100 && MMC_FH
	help
	  Register only the SD0 controller wired to the microSD slot on the
	  ANJIA AJL33PQ0866 and select its exact stock SD0_1BIT_NO_WP pinmux.
	  The one-bit profile leaves pad66 available as the active-low GPIO61
	  reset button. Other FH8626V100 boards must select their own controller
	  registration and pinmux policy.

config MACH_FH8856V200
    bool "FullHan FH8856V200 board"
    default n
    depends on ARCH_FH885xV200
    help
      Configure this option to specify the whether the board used
      for development is FH8856V200

config MACH_FH8852V200
    bool "FullHan FH8852V200 board"
    default n
    depends on ARCH_FH885xV200
    help
      Configure this option to specify the whether the board used
      for development is FH8852V200

config MACH_FH8858V200
    bool "FullHan FH8858V200 board"
    default n
    depends on ARCH_FH885xV200
    help
      Configure this option to specify the whether the board used
      for development is FH8858V200

config MACH_FH8856V210
    bool "FullHan FH8856V210 board"
    default n
    depends on ARCH_FH885xV200
    help
      Configure this option to specify the whether the board used
      for development is FH8856V210

config MACH_FH8852V210
    bool "FullHan FH8852V210 board"
    default n
    depends on ARCH_FH885xV210
    help
      Configure this option to specify the whether the board used
      for development is FH8852V200

config MACH_FH8858V210
    bool "FullHan FH8858V210 board"
    default n
    depends on ARCH_FH885xV200
    help
      Configure this option to specify the whether the board used
      for development is FH8858V210


endmenu

endif
```

## arch/arm/mach-fullhan/Kconfig
```kconfig
menuconfig ARCH_FULLHAN
	bool "Fullhan Microelectronics SoCs"
	depends on ARCH_MULTI_V6
	select ARM_AMBA
	select COMMON_CLK
	select GENERIC_IRQ_CHIP
	select GPIOLIB
	select PINCTRL
	select SPARSE_IRQ
	select TIMER_OF
	select USE_OF
	help
	  Support for Fullhan Microelectronics SoC families,
	  including the FH8626V100. The CPU on that SoC is an
	  ARM1176JZF-S. This option builds the machine support
	  used to boot a Fullhan board described by OF.

if ARCH_FULLHAN

config SOC_FH8626V100
	bool "Fullhan FH8626V100 SoC"
	default y
	select FH_INTC
	select FH_CLK
	select FH_TIMER
	help
	  Enable support for the Fullhan FH8626V100 IP camera
	  SoC. The option brings in the SoC interrupt
	  controller, clock tree and timer required to boot.
	  Other on-chip devices are selected separately.

config FH_INTC
	bool "Fullhan DW APB root interrupt controller"
	default y
	select IRQ_DOMAIN
	help
	  Support for the root interrupt controller on Fullhan
	  SoCs. On-chip devices use it as their interrupt
	  parent. A consumer names one hardware source with a
	  single cell in its interrupts property.

config FH_CLK
	bool "Fullhan FH8626V100 Clock Driver"
	default y
	depends on COMMON_CLK
	help
	  Support for the common clock tree on the Fullhan
	  FH8626V100. The provider shares the system
	  controller register window with the other users of
	  that block and publishes the on-chip clocks.

endif
```

## arch/arm/mach-xm530/Kconfig
```kconfig
if ARCH_XM530

menu "xm530 board feature"

config MACH_XM530
	bool "Support xm530 platform"
	select CPU_V7
	select ARM_GIC
	select ARM_TIMER_SP804
	select PL330
	select DMA_SHARED_BUFFER
	help
	  Includes support for the  xm530 platform.

	  This includes specific configurations for the module and
	  its peripherals.

config XM530_MACHINE_NAME
	string "Machine name"
	default "xm530"
	help
	  The name /proc/cpuinfo reports as Hardware, which ipctool (and
	  so ipcinfo and sysupgrade) takes as the chip name. The
	  XM530V200, XM533 and XM535 boot this machine record, under the
	  same machine ID, and their builds set their own name, as their
	  vendor kernels do.

config XM530_SP804_LATCH
	bool "SP804 clocksource reads a latched count (XM530V200)"
	default n
	help
	  The XM530V200 timers snapshot their count on request: setting
	  bit 8 of TimerControl copies TimerValue into the register at
	  +0x1C, and the bit reads back clear once it has. Its vendor
	  kernel reads the clocksource that way, never TimerValue
	  directly. XM530, XM533 and XM535 read TimerValue.

config DEFAULT_BUSCLK
	int "DEFAULT_BUSCLK"
	default "50000000"
	help
	  Default AHB clock rate

endmenu

endif
```

## drivers/clk/axera/Kconfig
```kconfig
# SPDX-License-Identifier: GPL-2.0-only

config COMMON_CLK_AXERA
	bool

config COMMON_CLK_AX620E
	bool "Clock driver for Axera AX620E"
	depends on ARCH_AXERA || COMPILE_TEST
	depends on HAS_IOMEM
	select COMMON_CLK_AXERA
	default ARCH_AXERA
	help
	  This driver supports Axera AX620E SoC clocks.
```
