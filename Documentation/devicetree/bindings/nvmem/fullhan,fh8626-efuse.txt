## Documentation/devicetree/bindings/nvmem/fullhan,fh8626-efuse.txt
```
Fullhan FH8626 eFuse

Required properties:
- compatible: "fullhan,fh8626v100-efuse", "fullhan,fh8626-efuse"
- reg: MMIO window of the controller
- clocks: the eFuse clock
- clock-names: "efuse"

Example:

	efuse@f1600000 {
		compatible = "fullhan,fh8626v100-efuse",
			     "fullhan,fh8626-efuse";
		reg = <0xf1600000 0x4000>;
		clocks = <&clk FH8626_CLK_EFUSE>;
		clock-names = "efuse";
	};
```

## Documentation/devicetree/bindings/phy/fullhan,fh8626v100-mipi-phy.txt
```
Fullhan FH8626V100 MIPI input PHY
================================

This PHY controls the MIPI input enable and pixel route in the FH8626V100
system controller. The CSI receiver owns its own D-PHY test interface and
bus clocks. Only the single-lane input configuration is supported.

Required properties:
- compatible: "fullhan,fh8626v100-mipi-phy"
- #phy-cells: 0

The PHY must be a child of the "fullhan,fh8626v100-pmu" system controller,
which also has the "syscon" and "simple-mfd" compatibles. It has no separate
register range.

While initialized and powered, the provider holds the MIPI route and PHY
enable. Shutdown restores only those controls. Access is serialized with
the clock provider. Pixel-clock muxes that share this route are not
registered as independent clocks.

Example:

system-controller@f0000000 {
	compatible = "fullhan,fh8626v100-pmu", "syscon", "simple-mfd";
	reg = <0xf0000000 0x4000>;

	mipi_phy: mipi-phy {
		compatible = "fullhan,fh8626v100-mipi-phy";
		#phy-cells = <0>;
	};
};
```

## Documentation/devicetree/bindings/phy/fullhan,fh8626v100-usb-phy.txt
```
Fullhan FH8626V100 integrated USB2 PHY

This node is a child of the Fullhan PMU. The provider owns the integrated
UTMI PHY's PMU sequence, USB bus clock and downstream host VBUS regulator.
It uses the PMU's serialized accessors, without another MMIO mapping.

Required properties:
- compatible: "fullhan,fh8626v100-usb-phy"
- #phy-cells: <0>
- clocks: USB HCLK gate
- clock-names: "hclk"
- vbus-supply: real regulator for the board's downstream USB power switch

Only the host configuration with a 16-bit UTMI interface is supported.
System suspend is rejected while the PHY is powered because the host's
live context cannot be restored after the PHY reset sequence.

Example (inside the PMU node):

	usb_phy: usb-phy {
		compatible = "fullhan,fh8626v100-usb-phy";
		#phy-cells = <0>;
		clocks = <&clk FH8626_CLK_USB_HCLK>;
		clock-names = "hclk";
		vbus-supply = <&usb_vbus>;
	};
```

## Documentation/devicetree/bindings/pinctrl/fullhan,fh8626v100-pinctrl.txt
```
Fullhan FH8626V100 pin controller

Required properties:
- compatible: "fullhan,fh8626v100-pinctrl"
- reg: pad configuration registers

Pin configuration nodes use the generic groups/function/pins binding.
The function name selects the mux.

Bias properties:
- bias-pull-up
- bias-pull-down
- bias-disable

Optional properties:
- fullhan,drive: drive code, an integer from 0 to 7. The hardware has
  no milliamp encoding, so drive-strength is not accepted.
```

## Documentation/devicetree/bindings/pwm/fullhan,fh8626v100-pwm.txt
```
Fullhan FH8626V100 PWM controller

Required properties:
- compatible: "fullhan,fh8626v100-pwm"
- reg: MMIO window of the controller
- interrupts: controller interrupt
- clocks: the PWM input clock
- clock-names: "pwm"
- #pwm-cells: must be <3>

The cells are the channel, the period in nanoseconds and the flags
from include/dt-bindings/pwm/pwm.h.

Example:

	pwm@f0400000 {
		compatible = "fullhan,fh8626v100-pwm";
		reg = <0xf0400000 0x4000>;
		interrupts = <36>;
		clocks = <&clk FH8626_CLK_PWM>;
		clock-names = "pwm";
		#pwm-cells = <3>;
	};
```

## Documentation/devicetree/bindings/remoteproc/fullhan,fh8626v100-arc.txt
```
Fullhan FH8626V100 ARC coprocessor

The ARC coprocessor runs firmware from system memory at the same
addresses as the ARM. The node has no reg property; the boot and
doorbell registers are part of the PMU window.

Required properties:
- compatible: "fullhan,fh8626v100-arc"
- interrupts: the ARC to ARM doorbell interrupt
- clocks: the ARC clock
- resets: the ARC reset
- memory-region: two no-map reserved-memory regions, in order:
  - the memory the firmware is loaded into and runs from
  - a "shared-dma-pool" for the virtio rings and buffers. It must hold
    the vrings of the firmware's resource table and the rpmsg buffers
    for them; 256 KiB holds two vrings of up to 128 entries.

Example:

	remoteproc {
		compatible = "fullhan,fh8626v100-arc";
		interrupts = <32>;
		clocks = <&clk FH8626_CLK_ARC>;
		resets = <&clk FH8626_RST_ARC>;
		memory-region = <&arc_memory>, <&arc_dma>;
	};
```

## Documentation/devicetree/bindings/rtc/fullhan,fh8626v100-rtc.txt
```
Fullhan FH8626V100 real-time clock

Required properties:
- compatible: "fullhan,fh8626v100-rtc"
- reg: MMIO window of the RTC
- interrupts: RTC interrupt

The node has no clocks property.

Example:

	rtc@f1500000 {
		compatible = "fullhan,fh8626v100-rtc";
		reg = <0xf1500000 0x4000>;
		interrupts = <33>;
	};
```

## Documentation/devicetree/bindings/soc/fullhan,fh8626-arc-isolation.txt
```
Fullhan FH8626 ARC companion isolation

The node holds the companion in reset and gates its clock. It has
no reg property.

Required properties:
- compatible: "fullhan,fh8626-arc-isolation",
  "fullhan,fh8626v100-arc"
- clocks: the companion clock
- clock-names: "arc"

Example:

	arc-isolation {
		compatible = "fullhan,fh8626-arc-isolation",
			     "fullhan,fh8626v100-arc";
		clocks = <&clk FH8626_CLK_ARC>;
		clock-names = "arc";
	};
```

## Documentation/devicetree/bindings/sound/fullhan,fh8626-audio.txt
```
Fullhan FH8626 audio controller

Required properties:
- compatible: "fullhan,fh8626-audio"
- reg: MMIO window of the controller
- interrupts: controller interrupt
- clocks: four clocks, in the order of clock-names
- clock-names: "ac", "i2s", "mclk", "pclk"
- dmas: receive and transmit channels, in that order
- dma-names: "rx", "tx"

Optional properties:
- spk-gpios: speaker GPIO, supplied by the board

Example:

	audio@f0a00000 {
		compatible = "fullhan,fh8626-audio";
		reg = <0xf0a00000 0x1000>;
		interrupts = <12>;
		clocks = <&clk FH8626_CLK_AC>, <&clk FH8626_CLK_I2S>,
			 <&clk FH8626_CLK_ACODEC_MCLK>,
			 <&clk FH8626_CLK_ACODEC_PCLK>;
		clock-names = "ac", "i2s", "mclk", "pclk";
		dmas = <&dma 0 0 0>, <&dma 1 0 0>;
		dma-names = "rx", "tx";
	};
```

## Documentation/devicetree/bindings/spi/fullhan,fh8626v100-spi.txt
```
Fullhan FH8626V100 SPI controller

Required properties:
- compatible: "fullhan,fh8626v100-spi"
- reg: MMIO window of the controller
- interrupts: controller interrupt
- clocks: the SPI input clock
- clock-names: "spi"
- #address-cells: must be <1>
- #size-cells: must be <0>

Optional properties:
- num-cs: number of chip selects
- cs-gpios: GPIO specifiers used as chip selects
- pinctrl-names and pinctrl-0: pin configuration

Example:

	spi@f0e00000 {
		compatible = "fullhan,fh8626v100-spi";
		reg = <0xf0e00000 0x4000>;
		interrupts = <17>;
		clocks = <&clk FH8626_CLK_SPI0>;
		clock-names = "spi";
		#address-cells = <1>;
		#size-cells = <0>;
	};
```

## Documentation/devicetree/bindings/spi/hisilicon,hi3520dv200-sfc.yaml
```yaml
# SPDX-License-Identifier: (GPL-2.0-only OR BSD-2-Clause)
%YAML 1.2
---
$id: http://devicetree.org/schemas/spi/hisilicon,hi3520dv200-sfc.yaml#
$schema: http://devicetree.org/meta-schemas/core.yaml#

title: HiSilicon Hi3520DV200 SPI flash controller (SFC v350)

maintainers:
  - Bjorn Stout <bjorn.stout@hotmail.com>

description:
  The SPI-NOR controller of the Hi3520DV200 (hardware version 0x350), with
  the register layout of the v3xx controllers handled by spi-hisi-sfc-v3xx.
  Without an interrupt the driver polls for completion.

allOf:
  - $ref: spi-controller.yaml#

properties:
  compatible:
    const: hisilicon,hi3520dv200-sfc

  reg:
    maxItems: 1

  interrupts:
    maxItems: 1

  num-cs:
    description:
      Number of chip selects. The flash on Hi3520DV200 boards is on CS1.
    maximum: 2
    default: 1

required:
  - compatible
  - reg

unevaluatedProperties: false

examples:
  - |
    spi@10010000 {
        compatible = "hisilicon,hi3520dv200-sfc";
        reg = <0x10010000 0x1000>;
        num-cs = <2>;
        #address-cells = <1>;
        #size-cells = <0>;

        flash@1 {
            compatible = "jedec,spi-nor";
            reg = <1>;
            label = "hi_sfc";
            spi-max-frequency = <50000000>;
        };
    };
```

## Documentation/devicetree/bindings/timer/fullhan,fh8626v100-timer.txt
```
Fullhan FH8626V100 dual timer

Required properties:
- compatible: "fullhan,fh8626v100-timer"
- reg: MMIO resource containing both timer channels
- interrupts: channel 0 interrupt
- clocks: the shared tmr0 input clock
- clock-frequency: requested shared input rate in Hz. The driver does not
  substitute a rate. It stops both inherited channels before changing the
  divider and uses the rate returned by the clock provider for all time
  conversions. The clockevent minimum remains 15 input ticks at any
  selected rate.

Optional properties:
- clock-names: "timer"

Channel 0 provides one-shot clockevents. Channel 1 provides the clocksource,
sched_clock and ARM delay timer.
```

## Documentation/devicetree/bindings/usb/fullhan,fh8626v100-usb.txt
```
Fullhan FH8626V100 USB host
==========================

Synopsys DWC2 with integrated UTMI PHY and Fullhan PMU sequence.
Required properties:
- compatible: "fullhan,fh8626v100-usb" (no generic fallback)
- reg: controller window, 0xe0700000 / 0x4000 on V100
- interrupts: hardware source 27
- clocks: USB functional clock
- clock-names: "otg"
- phys: phandle to the Fullhan integrated USB2 PHY
- phy-names: "usb2-phy"
- dr_mode: "host"

The PHY is described by
Documentation/devicetree/bindings/phy/fullhan,fh8626v100-usb-phy.txt.
Its node owns the HCLK gate and board VBUS supply. The controller uses
the standard DWC2 generic PHY path and the Fullhan parameter table entry.
```

## Documentation/devicetree/bindings/watchdog/fullhan,fh8626v100-watchdog.txt
```
Fullhan FH8626V100 watchdog

The controller follows the Synopsys DesignWare watchdog binding in
Documentation/devicetree/bindings/watchdog/dw_wdt.txt. The node has
one clock. There is no second clock and no clock-names property.

Required properties:
- compatible: "fullhan,fh8626v100-watchdog", "snps,dw-wdt"
- reg: MMIO window of the watchdog
- interrupts: timeout warning interrupt
- clocks: the watchdog clock

Optional properties:
- assigned-clocks: the watchdog clock
- assigned-clock-rates: requested rate of that clock

Example:

	watchdog@f0d00000 {
		compatible = "fullhan,fh8626v100-watchdog", "snps,dw-wdt";
		reg = <0xf0d00000 0x4000>;
		interrupts = <2>;
		clocks = <&clk FH8626_CLK_WDT>;
		assigned-clocks = <&clk FH8626_CLK_WDT>;
		assigned-clock-rates = <1000000>;
	};
```
