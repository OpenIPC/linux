## Documentation/devicetree/bindings/net/hisilicon-femac.txt
```
Hisilicon Fast Ethernet MAC controller

Required properties:
- compatible: should contain one of the following version strings:
	* "hisilicon,hisi-femac-v1"
	* "hisilicon,hisi-femac-v2"
	and the soc string "hisilicon,hi3516cv300-femac" or
	"hisilicon,hi3520dv100-femac" (Hi3520D V100 up port, with the global
	register region as the second reg entry).
- reg: specifies base physical address(s) and size of the device registers.
  The first region is the MAC core register base and size.
  The second region is the global MAC control register.
- interrupts: should contain the MAC interrupt.
- clocks: A phandle to the MAC main clock.
- resets: should contain the phandle to the MAC reset signal(required) and
	the PHY reset signal(optional).
- reset-names: should contain the reset signal name "mac"(required)
	and "phy"(optional).
- phy-mode: see ethernet-controller.yaml [1].
- phy-handle: see ethernet-controller.yaml [1].
- hisilicon,phy-reset-delays-us: triplet of delays if PHY reset signal given.
	The 1st cell is reset pre-delay in micro seconds.
	The 2nd cell is reset pulse in micro seconds.
	The 3rd cell is reset post-delay in micro seconds.

The MAC address is not read from the hardware. The driver takes it from the
first of these that holds a valid address (all-zero values are ignored):
"mac-address" and "local-mac-address" (defined by ethernet-controller.yaml[1],
usually filled in by the boot loader through an ethernetN alias), the obsolete
"address" property (read by the OF core, not part of the schema), an NVMEM cell
named "mac-address" ("nvmem-cells" and "nvmem-cell-names", also defined by
ethernet-controller.yaml[1]). If none of them gives a valid address the driver
uses a random one and warns. An NVMEM provider that is not registered yet
defers the probe.

[1] Documentation/devicetree/bindings/net/ethernet-controller.yaml

Example:
	hisi_femac: ethernet@10090000 {
		compatible = "hisilicon,hi3516cv300-femac","hisilicon,hisi-femac-v2";
		reg = <0x10090000 0x1000>,<0x10091300 0x200>;
		interrupts = <12>;
		clocks = <&crg HI3518EV200_ETH_CLK>;
		resets = <&crg 0xec 0>,<&crg 0xec 3>;
		reset-names = "mac","phy";
		phy-mode = "mii";
		phy-handle = <&phy0>;
		hisilicon,phy-reset-delays-us = <10000 20000 20000>;
	};
```

## Documentation/devicetree/bindings/net/ingenic,mac.yaml
```yaml
# SPDX-License-Identifier: (GPL-2.0-only OR BSD-2-Clause)
%YAML 1.2
---
$id: http://devicetree.org/schemas/net/ingenic,mac.yaml#
$schema: http://devicetree.org/meta-schemas/core.yaml#

title: MAC in Ingenic SoCs

maintainers:
  - 周琰杰 (Zhou Yanjie) <zhouyanjie@wanyeetech.com>

description:
  The Ethernet Media Access Controller in Ingenic SoCs.

select:
  properties:
    compatible:
      contains:
        enum:
          - ingenic,jz4775-mac
          - ingenic,x1000-mac
          - ingenic,x1600-mac
          - ingenic,x1830-mac
          - ingenic,t23-mac
          - ingenic,x2000-mac
  required:
    - compatible

allOf:
  - $ref: snps,dwmac.yaml#
  - if:
      not:
        properties:
          compatible:
            contains:
              const: ingenic,t23-mac
    then:
      properties:
        clocks:
          maxItems: 1
        clock-names:
          const: stmmaceth

properties:
  compatible:
    oneOf:
      - enum:
          - ingenic,jz4775-mac
          - ingenic,x1000-mac
          - ingenic,x1600-mac
          - ingenic,x1830-mac
          - ingenic,t23-mac
          - ingenic,x2000-mac
      - items:
          - const: ingenic,t23-mac
          - const: snps,dwmac

  reg:
    maxItems: 1

  interrupts:
    maxItems: 1

  interrupt-names:
    const: macirq

  clocks:
    minItems: 1
    items:
      - description: GMAC main clock
      - description: MAC PHY clock

  clock-names:
    minItems: 1
    items:
      - const: stmmaceth
      - const: macphy

  mode-reg:
    $ref: /schemas/types.yaml#/definitions/phandle
    description: An extra syscon register that control ethernet interface and timing delay

  rx-clk-delay-ps:
    description: RGMII receive clock delay defined in pico seconds

  tx-clk-delay-ps:
    description: RGMII transmit clock delay defined in pico seconds

required:
  - compatible
  - reg
  - interrupts
  - interrupt-names
  - clocks
  - clock-names
  - mode-reg

unevaluatedProperties: false

examples:
  - |
    #include <dt-bindings/clock/ingenic,x1000-cgu.h>

    mac: ethernet@134b0000 {
        compatible = "ingenic,x1000-mac";
        reg = <0x134b0000 0x2000>;

        interrupt-parent = <&intc>;
        interrupts = <55>;
        interrupt-names = "macirq";

        clocks = <&cgu X1000_CLK_MAC>;
        clock-names = "stmmaceth";

        mode-reg = <&mac_phy_ctrl>;
        phy-mode = "rmii";
    };
...
```

## Documentation/devicetree/bindings/nvmem/ingenic,t23-efuse.yaml
```yaml
# SPDX-License-Identifier: (GPL-2.0-only OR BSD-2-Clause)
%YAML 1.2
---
$id: http://devicetree.org/schemas/nvmem/ingenic,t23-efuse.yaml#
$schema: http://devicetree.org/meta-schemas/core.yaml#

title: Ingenic T23 SoC eFuse NVMEM

maintainers:
  - Difan Zhang <alex@osqdu.org>

description:
  Direct memory-mapped read-only eFuse OTP window on Ingenic T23 SoCs,
  gated by the CPM eFuse clock.

allOf:
  - $ref: nvmem.yaml#

properties:
  compatible:
    const: ingenic,t23-efuse

  reg:
    maxItems: 1

  clocks:
    maxItems: 1

  clock-names:
    const: efuse

required:
  - compatible
  - reg
  - clocks
  - clock-names

unevaluatedProperties: false

examples:
  - |
    #include <dt-bindings/clock/ingenic,t23-cgu.h>

    efuse@13540200 {
        compatible = "ingenic,t23-efuse";
        reg = <0x13540200 0x40>;
        clocks = <&cgu CLK_EFUSE>;
        clock-names = "efuse";
    };
...
```

## Documentation/devicetree/bindings/phy/hisilicon,hi3520dv100-sata-phy.yaml
```yaml
# SPDX-License-Identifier: (GPL-2.0-only OR BSD-2-Clause)
%YAML 1.2
---
$id: http://devicetree.org/schemas/phy/hisilicon,hi3520dv100-sata-phy.yaml#
$schema: http://devicetree.org/meta-schemas/core.yaml#

title: HiSilicon Hi3520D V100 SATA PHY

maintainers:
  - Dylan Corrales <deathcamel58@gmail.com>

description:
  The SATA PHY of the HiSilicon AHCI controller, here of the Hi3520D V100. It
  is configured through registers inside the register window of the AHCI
  controller (PHY control, OOB control and the per-port FIFOTH and PHYCTL
  registers) and through options of the system controller, and has a reset
  bit of its own in the SATA clock and reset register of the CRG. One node
  provides one PHY per port, selected by the port number; the number of ports
  is the size of the "ports" window divided by 0x80. The ports share the PHY
  reset and the PHY and OOB control registers. An AHCI node references the
  PHY of a port from its sata-port@N sub-node. The compatible is named after
  the silicon revision.

  The clock select bits of the SATA register of the CRG (150 MHz or 50 MHz
  clock, internal or cko_alive alive clock) are clock muxes of the CRG clock
  driver; the AHCI node selects the parent of each mux with assigned-clocks
  and assigned-clock-parents. The controller, TX, RX and alive resets of the
  same register must be released before the PHY is initialized, which the
  AHCI node does with its resets property; the PHY node only has its own
  reset.

  The PHY control register of every port holds the transmit boost, transmit
  attenuation and receive equalization codes, which the optional properties
  hisilicon,tx-boost, hisilicon,tx-atten and hisilicon,rx-eq give per port as
  raw hardware codes. The data sheet values 0x0e262709 (1.5 Gbit/s) and
  0x0e662709 (3 Gbit/s) have tx-boost 9, tx-atten 0 and rx-eq 0. The generic
  tx-p2p-microvolt of phy-common-props is not used because the codes have no
  documented voltage mapping.

properties:
  compatible:
    const: hisilicon,hi3520dv100-sata-phy

  reg:
    items:
      - description: Global PHY control registers (SATA_TM to SATA_OOB_CTL)
      - description:
          Per-port register blocks, 0x80 bytes per port starting at the first
          port

  reg-names:
    items:
      - const: ctrl
      - const: ports

  '#phy-cells':
    const: 1
    description: Port number, 0 to the number of ports minus 1

  resets:
    items:
      - description: PHY reset (PERI_CRG45 bit 0)

  hisilicon,sysctrl:
    $ref: /schemas/types.yaml#/definitions/phandle
    description:
      System controller (syscon) with the SATA PHY options, PERIPHCTRL25 (bit 2
      powers the PHY down, bits 21 and 20 select test modes) and PERIPHCTRL3
      (bits 9:0, reference clock offset and spread spectrum select).

  hisilicon,tx-boost:
    $ref: /schemas/types.yaml#/definitions/uint32-array
    minItems: 1
    maxItems: 2
    items:
      minimum: 0
      maximum: 15
    description:
      Transmit boost code (PHY control register TX_BOOST, bits 3:0), one entry
      for every port or a single entry for all ports. The data sheet gives the
      boost as -20 log [1 - (code + 0.5) / 32] dB; this is the data sheet
      formula, not a measurement. The vendor reference value is 6.

  hisilicon,tx-atten:
    $ref: /schemas/types.yaml#/definitions/uint32-array
    minItems: 1
    maxItems: 2
    items:
      minimum: 0
      maximum: 4
    description:
      Transmit attenuation code (PHY control register TX_ATTEN, bits 6:4), one
      entry for every port or a single entry for all ports. The codes 0 to 4
      are the amplitude ratios 16/16, 14/16, 12/16, 10/16 and 9/16; code 5 is
      reserved in the register description and not allowed. The vendor reference
      value is 0.

  hisilicon,rx-eq:
    $ref: /schemas/types.yaml#/definitions/uint32-array
    minItems: 1
    maxItems: 2
    items:
      minimum: 0
      maximum: 7
    description:
      Receive equalization code (PHY control register RX_EQ_VAL, bits 16:14),
      one entry for every port or a single entry for all ports. The data sheet
      gives about (code + 1) x 0.5 dB; this is the data sheet formula, not a
      measurement. The vendor reference value is 5.

required:
  - compatible
  - reg
  - reg-names
  - '#phy-cells'
  - resets
  - hisilicon,sysctrl

additionalProperties: false

examples:
  - |
    phy@10080050 {
        compatible = "hisilicon,hi3520dv100-sata-phy";
        reg = <0x10080050 0x20>, <0x10080100 0x100>;
        reg-names = "ctrl", "ports";
        #phy-cells = <1>;
        resets = <&crg 0xb4 0>;
        hisilicon,sysctrl = <&sysctrl>;
        hisilicon,tx-boost = <9>;
        hisilicon,tx-atten = <0>;
        hisilicon,rx-eq = <0>;
    };
```

## Documentation/devicetree/bindings/phy/hisilicon,hi3536dv100-sata-phy.yaml
```yaml
# SPDX-License-Identifier: (GPL-2.0-only OR BSD-2-Clause)
%YAML 1.2
---
$id: http://devicetree.org/schemas/phy/hisilicon,hi3536dv100-sata-phy.yaml#
$schema: http://devicetree.org/meta-schemas/core.yaml#

title: HiSilicon Hi3536D V100 SATA PHY

maintainers:
  - Dylan Corrales <deathcamel58@gmail.com>

description:
  The SATA PHY of the HiSilicon AHCI controller of the Hi3536D V100, which
  has one port. It is configured through registers inside the register window
  of the AHCI controller (the global PHY control registers and the per-port
  FIFOTH, PHYCTL1 and PHYCTL registers) and through MISC_CTRL, and has a
  reference clock and a reset line of its own in PERI_CRG44. One node provides
  one PHY per port, selected by the port number; the number of ports is the
  size of the "ports" window divided by 0x80. An AHCI node references the PHY
  of a port from its sata-port@N sub-node. The compatible is named after the
  silicon revision; the Hi3520D V100 PHY has other registers and its own
  binding.

  The reference clock is a gate behind a clock select of the CRG (25 MHz or
  100 MHz); the node selects the parent with assigned-clocks and
  assigned-clock-parents. The clocks of the controller itself (PERI_CRG45)
  belong to the AHCI node. Its four resets are shared between the AHCI node,
  which releases them before it initializes the PHY, and this node, which
  pulses them while it initializes the PHY (the vendor sequence resets the
  controller, then the PHY, and releases the PHY first); a boot loader that ran
  SATA leaves them released, so without the pulse the controller would never
  be reset. The PHY releases them again before it returns, so the AHCI node
  finds them as it released them.

properties:
  compatible:
    const: hisilicon,hi3536dv100-sata-phy

  reg:
    items:
      - description:
          Global PHY control registers (SATA_PHY_CTL0 to SATA_OOB_CTL)
      - description:
          Per-port register blocks, 0x80 bytes per port starting at the first
          port

  reg-names:
    items:
      - const: ctrl
      - const: ports

  '#phy-cells':
    const: 1
    description: Port number, 0 to the number of ports minus 1

  clocks:
    items:
      - description: PHY reference clock gate (PERI_CRG44 bit 0)

  clock-names:
    items:
      - const: ref

  assigned-clocks:
    maxItems: 1

  assigned-clock-parents:
    maxItems: 1

  resets:
    items:
      - description: PHY lane reset (PERI_CRG44 bit 1)
      - description: Controller bus reset (PERI_CRG45 bit 8), shared
      - description: Controller alive clock reset (PERI_CRG45 bit 9), shared
      - description: Controller RX0 reset (PERI_CRG45 bit 10), shared
      - description: Controller port 0 reset (PERI_CRG45 bit 11), shared

  reset-names:
    items:
      - const: lane
      - const: ctrl-bus
      - const: ctrl-alive
      - const: ctrl-rx0
      - const: ctrl-sata0

  hisilicon,misc-ctrl:
    $ref: /schemas/types.yaml#/definitions/phandle
    description:
      MISC_CTRL syscon (hisilicon,hi3536dv100-misc-ctrl), whose register at
      offset 0x58 takes the analog PHY parameters.

required:
  - compatible
  - reg
  - reg-names
  - '#phy-cells'
  - clocks
  - clock-names
  - resets
  - reset-names
  - hisilicon,misc-ctrl

additionalProperties: false

examples:
  - |
    #include <dt-bindings/clock/hi3536dv100-clock.h>

    phy@100300a0 {
        compatible = "hisilicon,hi3536dv100-sata-phy";
        reg = <0x100300a0 0x1c>, <0x10030100 0x80>;
        reg-names = "ctrl", "ports";
        #phy-cells = <1>;
        clocks = <&crg HI3536DV100_SATA_PHY_REF_CLK>;
        clock-names = "ref";
        assigned-clocks = <&crg HI3536DV100_SATA_REF_MUX>;
        assigned-clock-parents = <&crg HI3536DV100_FIXED_100M>;
        resets = <&crg 0xb0 1>, <&crg 0xb4 8>, <&crg 0xb4 9>,
                 <&crg 0xb4 10>, <&crg 0xb4 11>;
        reset-names = "lane", "ctrl-bus", "ctrl-alive", "ctrl-rx0",
                      "ctrl-sata0";
        hisilicon,misc-ctrl = <&misc>;
    };
```
