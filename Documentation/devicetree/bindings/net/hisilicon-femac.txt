## Documentation/devicetree/bindings/rtc/hisilicon,hisi-spi-rtc.yaml
```yaml
# SPDX-License-Identifier: GPL-2.0-only OR BSD-2-Clause
%YAML 1.2
---
$id: http://devicetree.org/schemas/rtc/hisilicon,hisi-spi-rtc.yaml#
$schema: http://devicetree.org/meta-schemas/core.yaml#

title: HiSilicon SPI-bridged real-time clock

maintainers:
  - Dylan Corrales <deathcamel58@gmail.com>

description: |
  Battery-backed RTC of the HiSilicon DVR, NVR and IPC SoCs. The counter (a
  100 Hz tick counter with a 16-bit day count) and its alarm comparator live
  in a separate power domain. The CPU reaches them through a small SPI master
  in the APB register window (SPI_CLK_DIV and SPI_RW registers). The bridge
  clock is the APB clock divided by 2 * (SPI_CLK_DIV + 1), and the data sheets
  limit it to 12 MHz or 5 MHz depending on the SoC.

  The APB side is the same on all SoCs. The register map behind the bridge
  and a few timing rules come in editions:

    V1: counter registers always readable, no wait around the load, crystal
        temperature compensation registers. Hi3520D V100 (also Hi3515A and
        Hi3515C), Hi3518A/C V100, Hi3518E V100, Hi3516C V100.
    V1 with lock: V1 with a counter lock request and a 5 ms wait between
        writing the load value and starting the load. Hi3516A V100 and
        Hi3516D V100 (one data sheet).
    V2: counter lock request, no temperature compensation registers. Hi3518E
        V200 and Hi3516C V200.
    V3: V2 with a battery under-voltage interrupt behind a global interrupt
        enable, and a 5 MHz limit of the bridge clock. Hi3516A V200,
        Hi3516A V300, Hi3516C V300, Hi3516E V100, Hi3519 V101, Hi3536D V100.

  The alarm interrupt line is shared with another source on some SoCs: VIC
  line 2 with the debug UART interrupt (COMMRX) on Hi3518, Hi3518E V100 and
  Hi3516C V100, where a system controller bit (PERI_CTRL0 bit 31) selects the
  source, and with the temperature capture interrupt on Hi3518E V200,
  Hi3516C V200, Hi3516A V200 and Hi3519 V101. Routing the line to the RTC is
  part of the board setup and is not done by the RTC driver. If another
  handler of the line is not compatible with a shared, oneshot threaded
  handler, the driver registers the clock without the alarm and without
  wakeup instead of failing. This works only when the RTC probes after the
  other source: an RTC that gets the line first takes it with a shared,
  oneshot handler, and the other source needs the same to share it.

  The data sheets describe no crystal, oscillator or battery selection that a
  board has to choose, so the node has no properties for them. The crystal
  frequency is nominally 32.768 kHz (the reset value of Sdm_coef, which
  accepts 32700 to 32800 Hz), and a missing crystal or supply shows as a
  counter that does not run, which the driver reports.

  The driver programs the bridge divider, the counter lock mode, the
  interrupt registers, the test clock output select, the match value and,
  on the editions that have it, TEMP_SEL (temperature compensation mode),
  which it sets to its reset value 0 (compensation on, internal sensor). The
  other modes of TEMP_SEL switch the compensation off or take the temperature
  from a register that nothing feeds. The correction table (LUT1 to LUT47),
  TOT_OFFSET, TEMP_OFFSET and Sdm_coef are left alone: they trim the
  crystal, the reset values suit a typical one and the battery powered
  domain is the only place the calibration of a board can live in. A
  property for a different crystal frequency can be added when a board needs
  one. The sensor and low-voltage sample periods (RTC_SAR_CTRL on V1,
  RTC_UV_CTRL on V3), RTC_ANA_CTRL (bias current of the analog start-up
  circuit, Hi3516A V100 and Hi3516D V100) and the user registers are not
  needed for timekeeping and are left alone as well.

allOf:
  - $ref: rtc.yaml#

properties:
  compatible:
    oneOf:
      - items:
          - enum:
              - hisilicon,hi3516cv100-rtc
              - hisilicon,hi3518ev100-rtc
              - hisilicon,hi3518v100-rtc
              - hisilicon,hi3520dv100-rtc
          - const: hisilicon,hisi-spi-rtc-v1
      - items:
          - enum:
              - hisilicon,hi3516cv200-rtc
              - hisilicon,hi3518ev200-rtc
          - const: hisilicon,hisi-spi-rtc-v2
      - items:
          - enum:
              - hisilicon,hi3516av200-rtc
              - hisilicon,hi3516av300-rtc
              - hisilicon,hi3516cv300-rtc
              - hisilicon,hi3516ev100-rtc
              - hisilicon,hi3519v101-rtc
              - hisilicon,hi3536dv100-rtc
          - const: hisilicon,hisi-spi-rtc-v3
      - items:
          - enum:
              - hisilicon,hi3516av100-rtc
              - hisilicon,hi3516dv100-rtc
          - const: hisilicon,hisi-spi-rtc-v1-lock

  reg:
    maxItems: 1

  interrupts:
    maxItems: 1
    description:
      Alarm (counter match) interrupt. Without it the alarm is not available.
      The line may be shared with another interrupt source.

  clocks:
    maxItems: 1
    description:
      APB bus clock, the reference of the SPI bridge clock divider.

  wakeup-source: true

required:
  - compatible
  - reg
  - clocks

unevaluatedProperties: false

examples:
  - |
    #include <dt-bindings/clock/hi3520dv100-clock.h>
    #include <dt-bindings/interrupt-controller/arm-gic.h>

    rtc@20060000 {
        compatible = "hisilicon,hi3520dv100-rtc", "hisilicon,hisi-spi-rtc-v1";
        reg = <0x20060000 0x1000>;
        interrupts = <GIC_SPI 7 IRQ_TYPE_LEVEL_HIGH>;
        clocks = <&crg HI3520DV100_APB_CLK>;
        wakeup-source;
    };
```

## Documentation/devicetree/bindings/sound/ingenic,t23-aic-loop.yaml
```yaml
# SPDX-License-Identifier: (GPL-2.0-only OR BSD-2-Clause)
%YAML 1.2
---
$id: http://devicetree.org/schemas/sound/ingenic,t23-aic-loop.yaml#
$schema: http://devicetree.org/meta-schemas/core.yaml#

title: Ingenic T23 AIC Loopback Capture DAI

maintainers:
  - Paul Cercueil <paul@crapouillou.net>

allOf:
  - $ref: dai-common.yaml#

properties:
  compatible:
    const: ingenic,t23-aic-loop

  '#sound-dai-cells':
    const: 0

  ingenic,aic:
    $ref: /schemas/types.yaml#/definitions/phandle
    description: Phandle to the companion Ingenic T23 AIC node.

  dmas:
    maxItems: 1

  dma-names:
    const: rx

required:
  - compatible
  - ingenic,aic
  - '#sound-dai-cells'
  - dmas
  - dma-names

unevaluatedProperties: false

examples:
  - |
    aic-loop {
      compatible = "ingenic,t23-aic-loop";
      ingenic,aic = <&aic>;
      #sound-dai-cells = <0>;
      dmas = <&pdma 5 0xffffffff>;
      dma-names = "rx";
    };
```

## Documentation/devicetree/bindings/spi/hisilicon,hifmc100.yaml
```yaml
# SPDX-License-Identifier: (GPL-2.0-only OR BSD-2-Clause)
%YAML 1.2
---
$id: http://devicetree.org/schemas/spi/hisilicon,hifmc100.yaml#
$schema: http://devicetree.org/meta-schemas/core.yaml#

title: HiSilicon flash memory controller (FMC, hifmc100)

maintainers:
  - Dylan Corrales <deathcamel58@gmail.com>

description: |
  Flash controller of the HiSilicon IP camera and NVR SoCs that came after the
  HISFC350 (see hisilicon,hisfc350): one block for SPI NOR and SPI NAND flash
  on two chip selects (SFC_CS0N, SFC_CS1N). The SDK calls the IP "hifmc100"
  and its version register (offset 0xbc) reads 0x100 on every SoC listed here,
  so the register cannot tell the SoCs apart: the SoC-specific compatible
  documents the SoC, "hisilicon,hifmc100" is the IP level fallback that
  follows it (a node needs both). Adding a SoC with this IP is an entry in
  the list below and a device tree node.

  The controller runs flash commands in two ways: register mode, in which the
  opcode, address and up to 4 KiB of data (kept in a buffer that appears at
  the start of the "memory" resource) are sent as one operation, and DMA mode,
  in which it moves data between the flash and DDR. There is no register that
  maps the flash into the "memory" resource (only its first 4 KiB + 256 bytes
  are used), the size of that resource differs between the SoCs (64 KiB,
  16 MiB, or 64 MiB at 0x58000000 on the Hi3518E V200 generation).

  The SPI clock is the controller clock divided by two (single transfer rate;
  by four in double transfer rate mode, which the driver does not use): there
  is no other divider, so spi-max-frequency of a flash node does not change it
  and the clock rate has to be set with assigned-clock-rates or
  assigned-clock-parents. Some of the clock selects of the SoCs (198 or
  297 MHz on the Hi3516C V300, 300 and 360 MHz on the Hi3516E V200 and V300)
  are only valid for the double transfer rate mode according to the data
  sheets. Flash reads with two or four address lines (1-2-2, 1-4-4) need
  spi-tx-bus-width next to spi-rx-bus-width, because the SPI core counts the
  address phase as a transmit phase; the driver writes on one line only.

  The pad mux and pad configuration of the flash pins (on the Hi3516E V200
  the SFC pins are shared with the eMMC and SDIO1 pins) are not described by
  this binding and not programmed by the driver: they must be set up before
  the controller is probed, by the boot loader or by a pinctrl node of the
  board; the driver warns when no flash answers the status register read.
  The controller has two chip selects, the driver uses chip select 0 only:
  the register description of the operation configuration register in some
  of the data sheets calls the chip select field invalid for DMA operations,
  their DMA procedures tell to set it, and the driver uses DMA for flash
  reads and page programs. Nothing was verified on a flash on chip select 1,
  so a flash node with another reg value is not accepted, and neither is
  cs-gpios (the controller only has its own chip select lines).

  The MTD device of a flash node is named after the node's "label" property,
  or after the SPI device (spiB.0, B being the bus number of the controller)
  when there is none. Boot loaders that pass the partitions as
  "mtdparts=<name>:..." on the kernel command line (the HiSilicon SDK U-Boot
  and OpenIPC's U-Boot use "hi_sfc") only match an MTD device of that name,
  so a board that boots with such a command line needs label = "hi_sfc"
  on its flash node, as with the HISFC350 controller driver.

  The controller also drives SPI NAND flash, which the driver does not
  support. A node that lists "hisilicon,hisi-fmc" or "hisilicon,fmc-spi-nand"
  is the vendor description of a controller with both flash types, it is not
  handled by this binding. The nodes of the earlier SPI NOR driver of this
  controller ("hisilicon,fmc-spi-nor", see mtd/hisilicon,fmc-spi-nor.txt, an
  SPI_HISI_SFC device) are not described by this binding either; they stay
  with that driver and its text binding until their device trees are
  converted to this one.

allOf:
  - $ref: spi-controller.yaml#

properties:
  compatible:
    items:
      - enum:
          - hisilicon,hi3516cv200-fmc
          - hisilicon,hi3516cv300-fmc
          - hisilicon,hi3516dv300-fmc
          - hisilicon,hi3516ev200-fmc
          - hisilicon,hi3516ev300-fmc
          - hisilicon,hi3518ev200-fmc
          - hisilicon,hi3536dv100-fmc
      - const: hisilicon,hifmc100

  reg:
    items:
      - description: Controller registers
      - description: Memory space of the controller (at least 8 KiB), the
          first 4 KiB + 256 bytes are the buffer of the register mode

  reg-names:
    items:
      - const: control
      - const: memory

  clocks:
    maxItems: 1
    description: Controller clock (the FMC gate and select of the CRG)

  resets:
    maxItems: 1
    description: Controller soft reset

  interrupts:
    maxItems: 1
    description: Operation completion interrupt (not used by the driver)

  num-cs:
    const: 1

  cs-gpios: false

patternProperties:
  "@[0-9a-f]+$":
    type: object
    properties:
      reg:
        items:
          - maximum: 0

required:
  - compatible
  - reg
  - reg-names
  - clocks

unevaluatedProperties: false

examples:
  - |
    #include <dt-bindings/clock/hi3516ev200-clock.h>

    spi@10000000 {
        compatible = "hisilicon,hi3516ev200-fmc", "hisilicon,hifmc100";
        reg = <0x10000000 0x1000>, <0x14000000 0x10000>;
        reg-names = "control", "memory";
        clocks = <&crg HI3516EV200_FMC_CLK>;
        assigned-clocks = <&crg HI3516EV200_FMC_CLK>;
        assigned-clock-rates = <100000000>;
        #address-cells = <1>;
        #size-cells = <0>;

        flash@0 {
            compatible = "jedec,spi-nor";
            reg = <0>;
            label = "hi_sfc";
            spi-max-frequency = <50000000>;
            spi-rx-bus-width = <2>;
            spi-tx-bus-width = <2>;
        };
    };
```
