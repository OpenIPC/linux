## Documentation/devicetree/bindings/spi/hisilicon,hisfc350.yaml
```yaml
# SPDX-License-Identifier: (GPL-2.0-only OR BSD-2-Clause)
%YAML 1.2
---
$id: http://devicetree.org/schemas/spi/hisilicon,hisfc350.yaml#
$schema: http://devicetree.org/meta-schemas/core.yaml#

title: HiSilicon HISFC350 SPI flash controller

maintainers:
  - Dylan Corrales <deathcamel58@gmail.com>

description: |
  SPI NOR flash controller (HISFC350 in the HiSilicon SDK) of the Hi3520D V100.
  The data sheets of the Hi3516A/D, Hi3516C V100, Hi3518 and Hi3518E V100 show
  the same controller; no compatible exists for them until someone has run one.
  Flashes are attached to chip select 0 or 1, the chip select is the reg value
  of the flash node. The register layout is the one of the v3xx controller of
  the hi16xx server SoCs, which is handled by drivers/spi/spi-hisi-sfc-v3xx.c.

  The VERSION register (offset 0x1f8) reads 0x350 on every SoC listed here, so
  it cannot tell the SoCs apart. The SoC-specific compatible documents the
  SoC, "hisilicon,hisfc350" is the IP level fallback.

  The controller has a window on the AHB bus (0x58000000-0x5bffffff on these
  SoCs) in which each flash is mapped, and a bus DMA engine that raises the
  controller interrupt when it is done. The SPI clock is the controller clock
  divided by two, there is no other divider, so spi-max-frequency of a flash
  node does not change it. Flash reads with two or four address lines (1-2-2,
  1-4-4) need spi-tx-bus-width next to spi-rx-bus-width, because the SPI core
  counts the address phase as a transmit phase; the controller writes data on
  one line only.

  The Hi3520D V100 has two chip selects (num-cs = <2>); the boot flash is on
  chip select 1.

  The Hi3516 V100 ("hisfc300", every register at another offset), the Hi3516A/D
  SPI NAND controller and the FMC (HiFMC100) flash controller of the Hi3518E
  V200, Hi3516C V200/V300, Hi3516E V200/V300, Hi3516A V200/V300, Hi3516D V300
  and Hi3519 (see hisilicon,fmc-spi-nor) are different IP blocks.

  A node that lists only "hisilicon,hi3520dv100-sfc" is the earlier
  description of the Hi3520D V100 controller, with the command registers only
  (one reg entry, no clock or reset). This standalone form is deprecated. The
  Hi3520D V200 has no other description yet: its node lists only
  "hisilicon,hi3520dv200-sfc" with the command registers.

allOf:
  - $ref: spi-controller.yaml#
  - if:
      properties:
        compatible:
          maxItems: 1
    then:
      properties:
        reg:
          maxItems: 1
        reg-names: false
        clocks: false
        resets: false
      patternProperties:
        "^.*@[0-9a-f]+$":
          properties:
            reg:
              items:
                - maximum: 1
    else:
      required:
        - clocks
  - if:
      properties:
        compatible:
          contains:
            const: hisilicon,hi3520dv100-sfc
          minItems: 2
    then:
      properties:
        num-cs:
          const: 2
      patternProperties:
        "^.*@[0-9a-f]+$":
          properties:
            reg:
              items:
                - maximum: 1
properties:
  compatible:
    oneOf:
      - items:
          - enum:
              - hisilicon,hi3520dv100-sfc
          - const: hisilicon,hisfc350
      - description: Command registers only, the earlier description of the
          Hi3520D V100, replaced by the form above
        deprecated: true
        const: hisilicon,hi3520dv100-sfc
      - description: Command registers only, the Hi3520D V200 (the window,
          clock and reset of its controller are not described yet)
        const: hisilicon,hi3520dv200-sfc

  reg:
    minItems: 1
    items:
      - description: Controller registers
      - description: Flash bus window (0x58000000-0x5bffffff on these SoCs)

  reg-names:
    minItems: 1
    items:
      - const: regs
      - const: mem

  clocks:
    maxItems: 1
    description: Controller clock (the SFC gate of the CRG)

  resets:
    maxItems: 1
    description: Controller soft reset

  num-cs:
    enum: [1, 2]

  interrupts:
    maxItems: 1
    description: Command and bus DMA completion interrupt

required:
  - compatible
  - reg

unevaluatedProperties: false

examples:
  - |
    #include <dt-bindings/clock/hi3520dv100-clock.h>
    #include <dt-bindings/interrupt-controller/arm-gic.h>

    spi@10010000 {
        compatible = "hisilicon,hi3520dv100-sfc", "hisilicon,hisfc350";
        reg = <0x10010000 0x10000>, <0x58000000 0x4000000>;
        reg-names = "regs", "mem";
        num-cs = <2>;
        interrupts = <GIC_SPI 18 IRQ_TYPE_LEVEL_HIGH>;
        clocks = <&crg HI3520DV100_SFC_CLK>;
        assigned-clocks = <&crg HI3520DV100_SFC_MUX>;
        assigned-clock-parents = <&crg HI3520DV100_FIXED_75M>;
        #address-cells = <1>;
        #size-cells = <0>;

        flash@1 {
            compatible = "jedec,spi-nor";
            reg = <1>;
            spi-rx-bus-width = <2>;
            spi-tx-bus-width = <2>;
        };
    };
```

## Documentation/devicetree/bindings/spi/ingenic,t23-sfc.yaml
```yaml
# SPDX-License-Identifier: (GPL-2.0-only OR BSD-2-Clause)
%YAML 1.2
---
$id: http://devicetree.org/schemas/spi/ingenic,t23-sfc.yaml#
$schema: http://devicetree.org/meta-schemas/core.yaml#

title: Ingenic T-Series SFC v1 SPI Flash Controller

maintainers:
  - Paul Cercueil <paul@crapouillou.net>

allOf:
  - $ref: spi-controller.yaml#

properties:
  compatible:
    enum:
      - ingenic,t23-sfc

  reg:
    maxItems: 1

  interrupts:
    maxItems: 1

  clocks:
    items:
      - description: SFC divider clock
      - description: SFC AHB gate clock

  clock-names:
    items:
      - const: sfc
      - const: gate

required:
  - compatible
  - reg
  - interrupts
  - clocks
  - clock-names

unevaluatedProperties: false

examples:
  - |
    #include <dt-bindings/clock/ingenic,t23-cgu.h>
    spi@13440000 {
      compatible = "ingenic,t23-sfc";
      reg = <0x13440000 0x10000>;
      interrupt-parent = <&intc>;
      interrupts = <7>;
      clocks = <&cgu CLK_CGU_SFC>, <&cgu CLK_SFC>;
      clock-names = "sfc", "gate";
      #address-cells = <1>;
      #size-cells = <0>;

      flash@0 {
        compatible = "jedec,spi-nor";
        reg = <0>;
        label = "jz_sfc";
        spi-max-frequency = <50000000>;
      };
    };
```

## arch/arm/configs/axera_ax620u_defconfig
```kconfig
# CONFIG_LOCALVERSION_AUTO is not set
CONFIG_SYSVIPC=y
CONFIG_HIGH_RES_TIMERS=y
CONFIG_PREEMPT=y
# CONFIG_CPU_ISOLATION is not set
CONFIG_IKCONFIG=y
CONFIG_IKCONFIG_PROC=y
CONFIG_AXLOG_BUF_SHIFT=17
CONFIG_LOG_CPU_MAX_BUF_SHIFT=13
CONFIG_CGROUPS=y
CONFIG_CPUSETS=y
# CONFIG_UTS_NS is not set
# CONFIG_IPC_NS is not set
# CONFIG_PID_NS is not set
# CONFIG_NET_NS is not set
# CONFIG_PERF_EVENTS is not set
CONFIG_PROFILING=y
CONFIG_ARCH_AXERA=y
CONFIG_ARCH_AX620E=y
CONFIG_PL310_ERRATA_753970=y
CONFIG_ARM_ERRATA_720789=y
CONFIG_SMP=y
CONFIG_HAVE_ARM_ARCH_TIMER=y
CONFIG_MCPM=y
CONFIG_HZ_200=y
CONFIG_HIGHMEM=y
CONFIG_SECCOMP=y
CONFIG_ZBOOT_ROM_TEXT=0x0
CONFIG_ZBOOT_ROM_BSS=0x0
CONFIG_CMDLINE="console=ttyAMA0"
CONFIG_VFP=y
CONFIG_NEON=y
CONFIG_KERNEL_MODE_NEON=y
CONFIG_PM_AUTOSLEEP=y
CONFIG_PM_WAKELOCKS=y
CONFIG_OPROFILE=y
CONFIG_MODULES=y
CONFIG_MODULE_UNLOAD=y
# CONFIG_BLK_DEV_BSG is not set
CONFIG_PARTITION_ADVANCED=y
CONFIG_CMDLINE_PARTITION=y
# CONFIG_IOSCHED_DEADLINE is not set
# CONFIG_IOSCHED_CFQ is not set
# CONFIG_CORE_DUMP_DEFAULT_ELF_HEADERS is not set
CONFIG_NET=y
CONFIG_PACKET=y
CONFIG_UNIX=y
CONFIG_INET=y
CONFIG_IP_PNP=y
CONFIG_IP_PNP_DHCP=y
CONFIG_IP_PNP_BOOTP=y
# CONFIG_IPV6 is not set
CONFIG_CFG80211=m
# CONFIG_CFG80211_DEFAULT_PS is not set
CONFIG_CFG80211_WEXT=y
CONFIG_MAC80211=m
CONFIG_RFKILL=y
CONFIG_DEVTMPFS=y
CONFIG_DEVTMPFS_MOUNT=y
CONFIG_MTD=y
CONFIG_MTD_TESTS=m
CONFIG_MTD_CMDLINE_PARTS=y
CONFIG_MTD_BLOCK=y
CONFIG_MTD_SPI_NAND=y
CONFIG_MTD_UBI=y
CONFIG_BLK_DEV_NULL_BLK=y
CONFIG_BLK_DEV_LOOP=y
CONFIG_SCSI=y
# CONFIG_SCSI_PROC_FS is not set
CONFIG_BLK_DEV_SD=y
CONFIG_NETDEVICES=y
# CONFIG_NET_VENDOR_ALACRITECH is not set
# CONFIG_NET_VENDOR_AMAZON is not set
# CONFIG_NET_VENDOR_AQUANTIA is not set
# CONFIG_NET_VENDOR_ARC is not set
# CONFIG_NET_VENDOR_AURORA is not set
# CONFIG_NET_VENDOR_BROADCOM is not set
# CONFIG_NET_VENDOR_CADENCE is not set
# CONFIG_NET_VENDOR_CAVIUM is not set
# CONFIG_NET_VENDOR_CIRRUS is not set
# CONFIG_NET_VENDOR_CORTINA is not set
# CONFIG_NET_VENDOR_EZCHIP is not set
# CONFIG_NET_VENDOR_FARADAY is not set
# CONFIG_NET_VENDOR_HISILICON is not set
# CONFIG_NET_VENDOR_HUAWEI is not set
# CONFIG_NET_VENDOR_INTEL is not set
# CONFIG_NET_VENDOR_MARVELL is not set
# CONFIG_NET_VENDOR_MELLANOX is not set
# CONFIG_NET_VENDOR_MICREL is not set
# CONFIG_NET_VENDOR_MICROSEMI is not set
# CONFIG_NET_VENDOR_NATSEMI is not set
# CONFIG_NET_VENDOR_NETRONOME is not set
# CONFIG_NET_VENDOR_NI is not set
# CONFIG_NET_VENDOR_QUALCOMM is not set
# CONFIG_NET_VENDOR_RENESAS is not set
# CONFIG_NET_VENDOR_ROCKER is not set
# CONFIG_NET_VENDOR_SAMSUNG is not set
# CONFIG_NET_VENDOR_SEEQ is not set
# CONFIG_NET_VENDOR_SOLARFLARE is not set
# CONFIG_NET_VENDOR_SMSC is not set
# CONFIG_NET_VENDOR_SOCIONEXT is not set
CONFIG_STMMAC_ETH=y
# CONFIG_DWMAC_GENERIC is not set
# CONFIG_NET_VENDOR_SYNOPSYS is not set
# CONFIG_NET_VENDOR_VIA is not set
# CONFIG_NET_VENDOR_WIZNET is not set
CONFIG_MARVELL_PHY=y
CONFIG_REALTEK_PHY=y
CONFIG_PPP=y
CONFIG_PPP_BSDCOMP=y
CONFIG_PPP_DEFLATE=y
CONFIG_PPP_FILTER=y
CONFIG_PPP_MPPE=y
CONFIG_PPP_MULTILINK=y
CONFIG_PPPOE=y
CONFIG_PPP_ASYNC=y
CONFIG_PPP_SYNC_TTY=y
# CONFIG_WLAN_VENDOR_ADMTEK is not set
# CONFIG_WLAN_VENDOR_ATH is not set
# CONFIG_WLAN_VENDOR_ATMEL is not set
# CONFIG_WLAN_VENDOR_BROADCOM is not set
# CONFIG_WLAN_VENDOR_CISCO is not set
# CONFIG_WLAN_VENDOR_INTEL is not set
# CONFIG_WLAN_VENDOR_INTERSIL is not set
# CONFIG_WLAN_VENDOR_MARVELL is not set
# CONFIG_WLAN_VENDOR_MEDIATEK is not set
# CONFIG_WLAN_VENDOR_RALINK is not set
# CONFIG_WLAN_VENDOR_REALTEK is not set
# CONFIG_WLAN_VENDOR_RSI is not set
# CONFIG_WLAN_VENDOR_ST is not set
# CONFIG_WLAN_VENDOR_TI is not set
CONFIG_USB_ZD1201=m
# CONFIG_WLAN_VENDOR_QUANTENNA is not set
CONFIG_INPUT_EVDEV=y
# CONFIG_SERIO_SERPORT is not set
CONFIG_LEGACY_PTY_COUNT=16
CONFIG_SERIAL_8250=y
CONFIG_SERIAL_8250_CONSOLE=y
CONFIG_SERIAL_8250_NR_UARTS=5
CONFIG_SERIAL_8250_RUNTIME_UARTS=5
CONFIG_SERIAL_8250_DW=y
# CONFIG_HW_RANDOM is not set
CONFIG_I2C_CHARDEV=y
CONFIG_I2C_DESIGNWARE_PLATFORM=y
CONFIG_SPI=y
CONFIG_SPI_DESIGNWARE=y
CONFIG_SPI_AXERA=y
CONFIG_SPI_DW_MMIO=y
CONFIG_SPI_AXERA_MMIO=y
CONFIG_GPIOLIB=y
CONFIG_GPIO_SYSFS=y
CONFIG_GPIO_DWAPB=y
# CONFIG_GPIO_LP_AXERA is not set
CONFIG_GPIO_GENERIC_PLATFORM=y
# CONFIG_HWMON is not set
CONFIG_THERMAL=y
CONFIG_THERMAL_GOV_POWER_ALLOCATOR=y
# CONFIG_AXERA_THERMAL is not set
CONFIG_WATCHDOG=y
CONFIG_DW_WATCHDOG=y
CONFIG_MEDIA_SUPPORT=y
CONFIG_MEDIA_CAMERA_SUPPORT=y
CONFIG_MEDIA_CONTROLLER=y
CONFIG_VIDEO_V4L2_SUBDEV_API=y
CONFIG_MEDIA_USB_SUPPORT=y
CONFIG_USB_VIDEO_CLASS=y
# CONFIG_USB_GSPCA is not set
CONFIG_FB=y
CONFIG_FB_MODE_HELPERS=y
CONFIG_BACKLIGHT_LCD_SUPPORT=y
CONFIG_BACKLIGHT_CLASS_DEVICE=y
CONFIG_FRAMEBUFFER_CONSOLE=y
CONFIG_FRAMEBUFFER_CONSOLE_DETECT_PRIMARY=y
CONFIG_LOGO=y
# CONFIG_LOGO_LINUX_MONO is not set
# CONFIG_LOGO_LINUX_VGA16 is not set
CONFIG_SOUND=y
CONFIG_SND=y
CONFIG_SND_SOC=y
CONFIG_HID_DRAGONRISE=y
CONFIG_HID_GYRATION=y
CONFIG_HID_TWINHAN=y
CONFIG_HID_PANTHERLORD=y
CONFIG_HID_PETALYNX=y
CONFIG_HID_SAMSUNG=y
CONFIG_HID_SUNPLUS=y
CONFIG_HID_GREENASIA=y
CONFIG_HID_SMARTJOYPLUS=y
CONFIG_HID_TOPSEED=y
CONFIG_HID_THRUSTMASTER=y
CONFIG_HID_ZEROPLUS=y
CONFIG_USB=y
CONFIG_USB_ANNOUNCE_NEW_DEVICES=y
CONFIG_USB_XHCI_HCD=y
CONFIG_USB_XHCI_DBGCAP=y
CONFIG_USB_XHCI_PLATFORM=y
CONFIG_USB_ACM=y
CONFIG_USB_STORAGE=y
CONFIG_USB_UAS=y
CONFIG_USB_SERIAL=y
CONFIG_USB_SERIAL_GENERIC=y
CONFIG_USB_SERIAL_CH341=y
CONFIG_USB_SERIAL_PL2303=y
CONFIG_USB_TEST=y
CONFIG_USB_GADGET=y
CONFIG_UVC_H264=y
CONFIG_USB_CONFIGFS=y
CONFIG_USB_CONFIGFS_SERIAL=y
CONFIG_USB_CONFIGFS_ACM=y
CONFIG_USB_CONFIGFS_RNDIS=y
CONFIG_USB_CONFIGFS_MASS_STORAGE=y
CONFIG_USB_CONFIGFS_F_LB_SS=y
CONFIG_USB_CONFIGFS_F_UVC=y
CONFIG_TYPEC=y
CONFIG_TYPEC_TCPM=y
CONFIG_TYPEC_TCPCI=y
CONFIG_MMC=y
CONFIG_MMC_SDHCI=y
CONFIG_MMC_SDHCI_PLTFM=y
CONFIG_RTC_CLASS=y
CONFIG_DMADEVICES=y
CONFIG_AXERA_AXI_DMAC=y
CONFIG_SYNC_FILE=y
CONFIG_UIO=y
CONFIG_UIO_PDRV_GENIRQ=m
# CONFIG_VIRTIO_MENU is not set
# CONFIG_COMMON_CLK_AX620E is not set
CONFIG_COMMON_CLK_AX620U=y
CONFIG_ARM_TIMER_SP804=y
# CONFIG_IOMMU_SUPPORT is not set
# CONFIG_AXERA_OSAL is not set
# CONFIG_AXERA_DW_APB_TIMER is not set
# CONFIG_AXERA_PERIPH_TIMER32 is not set
# CONFIG_AXERA_WAKE_TIMER is not set
# CONFIG_AXERA_RISCV_DRV is not set
CONFIG_AXERA_AX620U_COMPAT=y
# CONFIG_AXERA_AX620E_PINMUX is not set
CONFIG_PWM=y
CONFIG_PWM_AXERA=y
# CONFIG_AXERA_RESET_AX620E is not set
CONFIG_EXT2_FS=y
CONFIG_EXT3_FS=y
CONFIG_JBD2_DEBUG=y
CONFIG_OVERLAY_FS=y
CONFIG_VFAT_FS=y
CONFIG_EXFAT_FS=y
CONFIG_TMPFS=y
CONFIG_UBIFS_FS=y
CONFIG_CRAMFS=y
CONFIG_SQUASHFS=y
CONFIG_SQUASHFS_LZO=y
CONFIG_SQUASHFS_XZ=y
CONFIG_PSTORE=y
CONFIG_PSTORE_CONSOLE=y
CONFIG_PSTORE_RAM=y
CONFIG_NFS_FS=y
CONFIG_NFS_V4=y
CONFIG_ROOT_NFS=y
CONFIG_NLS_CODEPAGE_437=y
CONFIG_NLS_ISO8859_1=y
# CONFIG_CRYPTO_HW is not set
CONFIG_PRINTK_TIME=y
CONFIG_DYNAMIC_DEBUG=y
CONFIG_DEBUG_INFO=y
CONFIG_DEBUG_FS=y
CONFIG_MAGIC_SYSRQ=y
CONFIG_DEBUG_KERNEL=y
CONFIG_DETECT_HUNG_TASK=y
CONFIG_PANIC_ON_OOPS=y
CONFIG_PANIC_TIMEOUT=5
# CONFIG_SCHED_DEBUG is not set
CONFIG_STACKTRACE=y
CONFIG_RCU_TRACE=y
CONFIG_DEBUG_USER=y
```
