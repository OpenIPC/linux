## arch/mips/configs/isvp_marmot_defconfig
```kconfig
CONFIG_MACH_XBURST2=y
CONFIG_SOC_T41=y
CONFIG_CPU_MIPS32_R2=y
CONFIG_FORCE_MAX_ZONEORDER=15
# CONFIG_COMPACTION is not set
CONFIG_SMP=y
CONFIG_NR_CPUS=2
CONFIG_HZ_100=y
CONFIG_PREEMPT=y
# CONFIG_SECCOMP is not set
CONFIG_CROSS_COMPILE="mips-linux-gnu-"
# CONFIG_LOCALVERSION_AUTO is not set
CONFIG_KERNEL_LZMA=y
# CONFIG_SWAP is not set
CONFIG_SYSVIPC=y
CONFIG_POSIX_MQUEUE=y
# CONFIG_CROSS_MEMORY_ATTACH is not set
CONFIG_FHANDLE=y
CONFIG_NO_HZ_FULL=y
CONFIG_HIGH_RES_TIMERS=y
CONFIG_IKCONFIG=y
CONFIG_IKCONFIG_PROC=y
CONFIG_LOG_BUF_SHIFT=14
CONFIG_BLK_DEV_INITRD=y
CONFIG_CC_OPTIMIZE_FOR_SIZE=y
CONFIG_EXPERT=y
CONFIG_SYSCTL_SYSCALL=y
# CONFIG_KALLSYMS is not set
# CONFIG_ADVISE_SYSCALLS is not set
# CONFIG_VM_EVENT_COUNTERS is not set
# CONFIG_COMPAT_BRK is not set
CONFIG_SLAB=y
CONFIG_MODULES=y
CONFIG_MODULE_FORCE_LOAD=y
CONFIG_MODULE_UNLOAD=y
CONFIG_MODULE_FORCE_UNLOAD=y
# CONFIG_LBDAF is not set
# CONFIG_BLK_DEV_BSG is not set
CONFIG_PARTITION_ADVANCED=y
# CONFIG_COREDUMP is not set
CONFIG_NET=y
CONFIG_PACKET=y
CONFIG_UNIX=y
CONFIG_INET=y
CONFIG_IP_MULTICAST=y
CONFIG_IP_PNP=y
CONFIG_IP_PNP_DHCP=y
CONFIG_IP_PNP_BOOTP=y
CONFIG_IP_PNP_RARP=y
# CONFIG_INET_XFRM_MODE_TRANSPORT is not set
# CONFIG_INET_XFRM_MODE_TUNNEL is not set
# CONFIG_INET_XFRM_MODE_BEET is not set
# CONFIG_INET_LRO is not set
CONFIG_NETWORK_PHY_TIMESTAMPING=y
CONFIG_NETFILTER=y
CONFIG_NETFILTER_XT_TARGET_NFLOG=y
CONFIG_NETFILTER_XT_TARGET_NFQUEUE=y
CONFIG_NETFILTER_XT_MATCH_QUOTA=y
CONFIG_IP_SET=y
CONFIG_IP_SET_BITMAP_IPMAC=y
CONFIG_IP_NF_IPTABLES=y
CONFIG_IP_NF_FILTER=y
CONFIG_IP_NF_MANGLE=y
CONFIG_IP_NF_RAW=y
CONFIG_CFG80211=y
CONFIG_NL80211_TESTMODE=y
CONFIG_CFG80211_WEXT=y
CONFIG_MAC80211=y
CONFIG_MAC80211_MESH=y
CONFIG_RFKILL=y
CONFIG_RFKILL_INPUT=y
CONFIG_UEVENT_HELPER_PATH="/sbin/hotplug"
CONFIG_DEVTMPFS=y
CONFIG_DEVTMPFS_MOUNT=y
# CONFIG_STANDALONE is not set
# CONFIG_PREVENT_FIRMWARE_BUILD is not set
# CONFIG_FW_LOADER is not set
# CONFIG_ALLOW_DEV_COREDUMP is not set
CONFIG_MTD=y
CONFIG_MTD_CMDLINE_PARTS=y
CONFIG_MTD_BLOCK=y
CONFIG_INGENIC_SFC_V2=y
CONFIG_BLK_DEV_LOOP=y
CONFIG_NETDEVICES=y
CONFIG_INGENIC_MAC=y
CONFIG_INGENIC_MAC_DMA_INTERFACES=y
# CONFIG_NET_VENDOR_ARC is not set
# CONFIG_NET_CADENCE is not set
# CONFIG_NET_VENDOR_BROADCOM is not set
# CONFIG_NET_VENDOR_EZCHIP is not set
# CONFIG_NET_VENDOR_INTEL is not set
# CONFIG_NET_VENDOR_MARVELL is not set
# CONFIG_NET_VENDOR_MICREL is not set
# CONFIG_NET_VENDOR_NATSEMI is not set
# CONFIG_NET_VENDOR_QUALCOMM is not set
# CONFIG_NET_VENDOR_RENESAS is not set
# CONFIG_NET_VENDOR_ROCKER is not set
# CONFIG_NET_VENDOR_SAMSUNG is not set
# CONFIG_NET_VENDOR_SEEQ is not set
# CONFIG_NET_VENDOR_SMSC is not set
# CONFIG_NET_VENDOR_STMICRO is not set
# CONFIG_NET_VENDOR_VIA is not set
# CONFIG_NET_VENDOR_WIZNET is not set
CONFIG_PHYLIB=y
# CONFIG_WLAN is not set
# CONFIG_INPUT_MOUSEDEV is not set
# CONFIG_INPUT_KEYBOARD is not set
# CONFIG_INPUT_MOUSE is not set
# CONFIG_SERIO is not set
CONFIG_DEVPTS_MULTIPLE_INSTANCES=y
# CONFIG_LEGACY_PTYS is not set
# CONFIG_DEVKMEM is not set
CONFIG_SERIAL_INGENIC_UART=y
CONFIG_SERIAL_INGENIC_CONSOLE=y
CONFIG_SERIAL_INGENIC_MAGIC_SYSRQ=y
# CONFIG_HW_RANDOM is not set
CONFIG_I2C=y
CONFIG_I2C_INGENIC=y
CONFIG_GPIO_SYSFS=y
# CONFIG_HWMON is not set
CONFIG_WATCHDOG=y
CONFIG_INGENIC_WDT=y
CONFIG_MFD_INGENIC_TCU=y
# CONFIG_JZ_IPU is not set
# CONFIG_VGA_CONSOLE is not set
CONFIG_SOC_VPU=y
CONFIG_CHANNEL_NODE_NUM=8
CONFIG_VPU_HELIX=y
CONFIG_USB=y
CONFIG_USB_ANNOUNCE_NEW_DEVICES=y
CONFIG_USB_DWC2=y
CONFIG_INGENIC_INNOPHY=y
CONFIG_MMC=y
CONFIG_MMC_SDHCI=y
CONFIG_DMADEVICES=y
CONFIG_INGENIC_PDMAC=y
# CONFIG_MIPS_PLATFORM_DEVICES is not set
# CONFIG_IOMMU_SUPPORT is not set
CONFIG_PWM=y
CONFIG_EXT2_FS=y
CONFIG_EXT4_FS=y
# CONFIG_DNOTIFY is not set
# CONFIG_INOTIFY_USER is not set
CONFIG_OVERLAY_FS=y
CONFIG_VFAT_FS=y
CONFIG_PROC_KCORE=y
CONFIG_TMPFS=y
CONFIG_CONFIGFS_FS=y
CONFIG_JFFS2_FS=y
CONFIG_JFFS2_FS_WBUF_VERIFY=y
CONFIG_JFFS2_FS_XATTR=y
CONFIG_JFFS2_COMPRESSION_OPTIONS=y
CONFIG_CRAMFS=y
CONFIG_SQUASHFS=y
CONFIG_SQUASHFS_XZ=y
CONFIG_NFS_FS=y
CONFIG_ROOT_NFS=y
CONFIG_NLS_CODEPAGE_437=y
CONFIG_NLS_ASCII=y
CONFIG_NLS_ISO8859_1=y
CONFIG_NLS_UTF8=y
CONFIG_PRINTK_TIME=y
# CONFIG_ENABLE_WARN_DEPRECATED is not set
# CONFIG_ENABLE_MUST_CHECK is not set
CONFIG_DEBUG_FS=y
# CONFIG_SECTION_MISMATCH_WARN_ONLY is not set
CONFIG_MAGIC_SYSRQ=y
CONFIG_PANIC_TIMEOUT=10
# CONFIG_SCHED_DEBUG is not set
# CONFIG_DEBUG_PREEMPT is not set
CONFIG_STACKTRACE=y
# CONFIG_FTRACE is not set
# CONFIG_CRYPTO_MANAGER_DISABLE_TESTS is not set
# CONFIG_CRYPTO_ECHAINIV is not set
CONFIG_CRYPTO_ECB=y
CONFIG_CRYPTO_CMAC=y
# CONFIG_CRYPTO_HW is not set
```

## drivers/clk/axera/Kconfig
```kconfig
config COMMON_CLK_AXERA
	bool
	help
	  Axera SoCs' clock support.

config COMMON_CLK_AX620E
	bool "Clock driver for Axera AX620E"
	depends on ARCH_AXERA || COMPILE_TEST
	depends on !COMMON_CLK_AX620U
	select COMMON_CLK_AXERA
	default ARCH_AXERA
	help
	  This driver supports Axera AX620E basic clocks.


config COMMON_CLK_AX620U
	bool "Clock driver for Axera AX620U (axera,ax620x)"
	depends on ARCH_AXERA || COMPILE_TEST
	select COMMON_CLK_AXERA
	help
	  Clock driver for the AX620U ("axera,ax620x") camera SoC, a
	  different die from AX620E with its own clock register map: the
	  muxes, gates and dividers of its eight syscon clock blocks, with
	  the stock AX620U kernel's clock names and IDs. The PLLs are
	  fixed-rate, as the first stage programs them. It binds the same
	  compatibles as COMMON_CLK_AX620E, which it therefore excludes.
```

## drivers/clk/hisilicon/Kconfig
```kconfig
# SPDX-License-Identifier: GPL-2.0-only
config COMMON_CLK_HI3520DV100
	bool "Hi3520D V100 Clock and Reset Driver"
	depends on ARCH_HISI || ARCH_HISI_BVT || COMPILE_TEST
	select RESET_HISI
	help
	  Build the clock and reset driver for the CRG and the system
	  controller clocks of the HiSilicon Hi3520D V100 (and the Hi3515A and
	  Hi3515C of the same data sheet). It provides the bus clock, the
	  peripheral clock gates and selects, the SP804 and SP805 count clock
	  selects and the peripheral soft resets. The SP804 timers need it,
	  so it is built in. Hi3520D V200 kernels select it as well, but their
	  device trees do not use it.

config COMMON_CLK_HI3516CV300
	bool "Hi3516C V300 / Hi3516E V100 Clock and Reset Driver"
	depends on ARCH_HISI || ARCH_HISI_BVT || COMPILE_TEST
	select RESET_HISI
	default ARCH_HI3516CV300
	help
	  Build the clock and reset driver for the CRG and the system
	  controller clocks of the Hi3516C V300 and the Hi3516E V100.
	  The SP804 timer is probed before the platform drivers, so the
	  clocks are registered early and the driver cannot be a module.

config COMMON_CLK_HI3516CV200
	bool "Hi3516C V200 / Hi3518E V20x Clock and Reset Driver"
	depends on ARCH_HISI || ARCH_HISI_BVT || COMPILE_TEST
	select RESET_HISI
	default ARCH_HI3516CV200
	help
	  Build the clock and reset driver for the CRG and the system
	  controller clocks of the Hi3516C V200 and Hi3518E V200/V201.
	  The SP804 timer is probed before the platform drivers, so the
	  clocks are registered early and the driver cannot be a module.

config COMMON_CLK_HI3536DV100
	bool "Hi3536D V100 / Hi3536E Clock and Reset Driver"
	depends on ARCH_HISI || ARCH_HISI_BVT || COMPILE_TEST
	select RESET_HISI
	default ARCH_HI3536DV100
	help
	  Build the clock and reset driver for the CRG and the system
	  controller clocks of the HiSilicon Hi3536D V100 and the Hi3536E.
	  The SP804 timer is the only tick source of these SoCs and is
	  probed before the platform drivers, so the clocks are registered
	  early and the driver cannot be a module.

config COMMON_CLK_HI3516AV100
	tristate "HI3516AV100 / Hi3516DV100 Clock Driver"
	depends on ARCH_HISI || ARCH_HISI_BVT || COMPILE_TEST
	select RESET_HISI
	default ARCH_HI3516AV100
	help
	  Build the clock driver for the V2A family — hi3516av100 and
	  the pin-compatible hi3516dv100 (Cortex-A7 / ARMv7). Ports the
	  vendor Hi3516A_SDK_V1.0.8.0 BSP clock topology onto the modern
	  crg- platform_driver scaffold. APLL programming is stubbed —
	  the CPU runs at the U-Boot-configured rate.

config COMMON_CLK_HI3519
	tristate "Hi3519 Clock Driver"
	depends on ARCH_HISI || ARCH_HISI_BVT || COMPILE_TEST
	select RESET_HISI
	default ARCH_HISI
	help
	  Build the clock driver for hi3519.

config COMMON_CLK_HI3559A
	bool "Hi3559A Clock Driver"
	depends on ARCH_HISI || ARCH_HISI_BVT || COMPILE_TEST
	select RESET_HISI
	default ARCH_HISI
	help
	  Build the clock driver for hi3559a.

config COMMON_CLK_HI3660
	bool "Hi3660 Clock Driver"
	depends on ARCH_HISI || ARCH_HISI_BVT || COMPILE_TEST
	default ARCH_HISI
	help
	  Build the clock driver for hi3660.

config COMMON_CLK_HI3670
	bool "Hi3670 Clock Driver"
	depends on ARCH_HISI || ARCH_HISI_BVT || COMPILE_TEST
	default ARCH_HISI
	help
	  Build the clock driver for hi3670.

config COMMON_CLK_HI3798CV200
	tristate "Hi3798CV200 Clock Driver"
	depends on ARCH_HISI || ARCH_HISI_BVT || COMPILE_TEST
	select RESET_HISI
	default ARCH_HISI
	help
	  Build the clock driver for hi3798cv200.

config COMMON_CLK_HI6220
	bool "Hi6220 Clock Driver"
	depends on ARCH_HISI || ARCH_HISI_BVT || COMPILE_TEST
	default ARCH_HISI
	help
	  Build the Hisilicon Hi6220 clock driver based on the common clock framework.

config RESET_HISI
	bool "HiSilicon Reset Controller Driver"
	depends on ARCH_HISI || ARCH_HISI_BVT || COMPILE_TEST
	select RESET_CONTROLLER
	help
	  Build reset controller driver for HiSilicon device chipsets.

config STUB_CLK_HI6220
	bool "Hi6220 Stub Clock Driver" if EXPERT
	depends on (COMMON_CLK_HI6220 || COMPILE_TEST)
	depends on MAILBOX
	default COMMON_CLK_HI6220
	help
	  Build the Hisilicon Hi6220 stub clock driver.

config STUB_CLK_HI3660
	bool "Hi3660 Stub Clock Driver" if EXPERT
	depends on (COMMON_CLK_HI3660 || COMPILE_TEST)
	depends on MAILBOX
	default COMMON_CLK_HI3660
	help
	  Build the Hisilicon Hi3660 stub clock driver.

config COMMON_CLK_HI3516EV200
	bool "Hi3516E V200 and V300 Clock and Reset Driver"
	depends on ARCH_HISI_BVT || COMPILE_TEST
	select RESET_HISI
	default ARCH_HI3516EV200 || ARCH_HI3516EV300
	help
	  Build the clock and reset driver for the CRG and the system
	  controller clocks of the HiSilicon Hi3516E V200 and Hi3516E V300.
	  It provides the PLLs, the CPU, DDR and bus clocks, the peripheral
	  clock gates and selects, the SP804 count clock selects and the
	  peripheral soft resets. The SP804 timers can need it before platform
	  drivers run, so it is built in.

config COMMON_CLK_HI3516EV300
	bool "Hi3516E V300 Clock Driver"
	depends on ARCH_HISI_BVT || COMPILE_TEST
	select COMMON_CLK_HI3516EV200
	default ARCH_HI3516EV300
	help
	  The Hi3516E V300 uses the same driver as the Hi3516E V200. This
	  option is kept so that a configuration that has it set keeps its
	  clock driver; it selects COMMON_CLK_HI3516EV200.

config COMMON_CLK_HI3518EV300
	bool "Hi3518EV300 Clock Driver"
	depends on ARCH_HISI_BVT || COMPILE_TEST
	default ARCH_HI3518EV300

config COMMON_CLK_HI3516DV200
	bool "Hi3516DV200 Clock Driver"
	depends on ARCH_HISI_BVT || COMPILE_TEST
	default ARCH_HI3516DV200

config COMMON_CLK_HI3516CV500
	bool "Hi3516CV500 Clock Driver"
	depends on ARCH_HISI_BVT || COMPILE_TEST
	default ARCH_HI3516CV500

config COMMON_CLK_HI3516DV300
	bool "Hi3516DV300 Clock Driver"
	depends on ARCH_HISI_BVT || COMPILE_TEST
	default ARCH_HI3516DV300
```

## drivers/media/i2c/smartsens/Kconfig
```kconfig
# SPDX-License-Identifier: GPL-2.0
# Copyright (C) 2026 Difan Zhang

config VIDEO_SMARTSENS_COMMON
	tristate

config VIDEO_SC1A4T
	tristate "SmartSens SC1A4T sensor support"
	depends on I2C && VIDEO_DEV && OF
	select MEDIA_CONTROLLER
	select VIDEO_V4L2_SUBDEV_API
	select V4L2_FWNODE
	select VIDEO_SMARTSENS_COMMON
	help
	  This is a Video4Linux2 sensor driver for the SmartSens SC1A4T
	  CMOS image sensor in primary or frame-sync slave configuration.

	  To compile this driver as a module, choose M here: the module
	  will be called sensor_sc1a4t.

config VIDEO_SC2336P
	tristate "SmartSens SC2336 / SC2336P sensor support"
	depends on I2C && VIDEO_DEV && OF
	select MEDIA_CONTROLLER
	select VIDEO_V4L2_SUBDEV_API
	select V4L2_FWNODE
	select VIDEO_SMARTSENS_COMMON
	help
	  This is a Video4Linux2 sensor driver for the SmartSens SC2336
	  and SC2336P CMOS image sensors.

	  To compile this driver as a module, choose M here: the module
	  will be called sensor_sc2336p.

config VIDEO_SC2337P
	tristate "SmartSens SC2337P sensor support"
	depends on I2C && VIDEO_DEV && OF
	select MEDIA_CONTROLLER
	select VIDEO_V4L2_SUBDEV_API
	select V4L2_FWNODE
	select VIDEO_SMARTSENS_COMMON
	help
	  This is a Video4Linux2 sensor driver for the SmartSens SC2337P
	  CMOS image sensor.

	  To compile this driver as a module, choose M here: the module
	  will be called sensor_sc2337p.

config VIDEO_SC1346
	tristate "SmartSens SC1346 sensor support"
	depends on I2C && VIDEO_DEV && OF
	select MEDIA_CONTROLLER
	select VIDEO_V4L2_SUBDEV_API
	select V4L2_FWNODE
	select VIDEO_SMARTSENS_COMMON
	help
	  Say Y here to enable the V4L2 driver for the SmartSens SC1346
	  1280x720 CMOS image sensor with a MIPI CSI-2 interface.

	  To build this driver as a module, choose M here. The module
	  will be called sensor_sc1346.

config VIDEO_SC200AI
	tristate "SmartSens SC200AI sensor support"
	depends on I2C && VIDEO_DEV && OF
	select MEDIA_CONTROLLER
	select VIDEO_V4L2_SUBDEV_API
	select V4L2_FWNODE
	select VIDEO_SMARTSENS_COMMON
	help
	  Say Y here to enable the V4L2 driver for the SmartSens SC200AI
	  1920x1080 CMOS image sensor with a MIPI CSI-2 interface.

	  To build this driver as a module, choose M here. The module
	  will be called sensor_sc200ai.

config VIDEO_SC2310
	tristate "SmartSens SC2310 sensor support"
	depends on I2C && VIDEO_DEV && OF
	select MEDIA_CONTROLLER
	select VIDEO_V4L2_SUBDEV_API
	select V4L2_FWNODE
	select VIDEO_SMARTSENS_COMMON
	help
	  Say Y here to enable the V4L2 driver for the SmartSens SC2310
	  1920x1080 CMOS image sensor with a MIPI CSI-2 interface.

	  To build this driver as a module, choose M here. The module
	  will be called sensor_sc2310.

config VIDEO_SC2331
	tristate "SmartSens SC2331 sensor support"
	depends on I2C && VIDEO_DEV && OF
	select MEDIA_CONTROLLER
	select VIDEO_V4L2_SUBDEV_API
	select V4L2_FWNODE
	select VIDEO_SMARTSENS_COMMON
	help
	  Say Y here to enable the V4L2 driver for the SmartSens SC2331
	  1920x1080 CMOS image sensor with a MIPI CSI-2 interface.

	  To build this driver as a module, choose M here. The module
	  will be called sensor_sc2331.
```

## drivers/media/platform/grainmedia/Kconfig
```kconfig
# SPDX-License-Identifier: GPL-2.0-only

comment "Grain Media platform drivers"

config VIDEO_GM_CAP020
	tristate "Grain Media GM8126 video capture"
	depends on V4L_PLATFORM_DRIVERS
	depends on VIDEO_DEV && OF
	depends on ARCH_GRAINMEDIA || COMPILE_TEST
	select V4L2_FWNODE
	select V4L2_ASYNC
	select VIDEOBUF2_DMA_CONTIG
	help
	  The FTCAP020 capture unit of the GM8126: a sensor's picture,
	  scaled down, as packed 4:2:2.

config VIDEO_GM_MCP200
	tristate "Grain Media GM8126 H.264 encoder"
	depends on V4L_MEM2MEM_DRIVERS
	depends on VIDEO_DEV
	depends on ARCH_GRAINMEDIA || COMPILE_TEST
	select VIDEOBUF2_DMA_CONTIG
	select V4L2_MEM2MEM_DEV
	help
	  The FTMCP200 H.264 baseline encoder of the GM8126.
```

## drivers/media/platform/hisilicon/Kconfig
```kconfig
# SPDX-License-Identifier: GPL-2.0-only

comment "HiSilicon media platform drivers"

source "drivers/media/platform/hisilicon/hisi-jpge/Kconfig"
```
