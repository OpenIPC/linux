## lotus/drivers/mfd/Kconfig
```kconfig
config MFD_LOTUS_FMC
	tristate "Multi-Functions Flash Memory Controller"
	depends on OF
	depends on ARCH_LOTUS
	select MFD_CORE
	select REGMAP_MMIO
	help
	  Select this option to enable the Multi-Functions Flash Memory
	  CMFD_LOTUS_FMController(FMC) driver.
```

## lotus/drivers/mmc/host/Kconfig
```kconfig
config MMC_SDHCI_LOTUS
	tristate "SDHCI support on the Lotus SoC"
	depends on ARCH_XMFALCON || ARCH_XMORCA
	depends on MMC_SDHCI_PLTFM
	help
	  This selects the SDHCI support for Lotus System-on-Chip devices.
	  If you have a controller with this interface, say Y or M here.
	  If unsure, say N.
```

## lotus/drivers/mtd/Kconfig
```kconfig
menuconfig LOTUS_FMC100
	tristate "Flash Memory Controller V100 support"
	default n
	select MTD_BLOCK
	select MFD_LOTUS_FMC
	help
	  Support Flash Memory Controller V100.

if LOTUS_FMC100

config LOTUS_FMC100_SPINOR
	bool "Spi-Nor Flash support"
	default y
	help
	  Support Spi-Nor Flash Memory.

config LOTUS_FMC100_SPINAND
	bool "Spi-Nand Flash support"
	default n
	help
	  Support Spi-Nand Flash Memory.

config LOTUS_FMC100_NAND
	bool "Nand Flash support"
	default n
	help
	  Support Nand Flash Memory.

config LOTUS_NAND_FS_MAY_NO_YAFFS2
	bool "Remove the restraintion of 16bit ecc type on yaffs2"
	depends on LOTUS_FMC100
	default n
	help
	  The ecc type: 16bit is limited by the flash memory controller,
	  as the yaffs2 tag of rootfs limits the min size of CTRL len is 28.

endif
```

## lotus/drivers/net/Kconfig
```kconfig
source "lotus/drivers/net/phy/Kconfig"
source "lotus/drivers/net/ethernet/Kconfig"
source "lotus/drivers/net/mdio/Kconfig"
source "lotus/drivers/net/can/Kconfig"
```

## lotus/drivers/net/can/ftcan010/Kconfig
```kconfig
# SPDX-License-Identifier: GPL-2.0-only
config CAN_FTCAN
	tristate "FTCAN support"
	select FTCAN_CALC_BITTIMING
	help
	  Say Y here if you want support for Lotus FT_CAN controller framework.
	  This is common support for devices that embed the Lotus FT_CAN IP.

if CAN_FTCAN
menu "FTCAN config"
config FTCAN_CALC_BITTIMING
	bool "FTCAN bit-timing calculation"
	default y
	help
	  If enabled, CAN bit-timing parameters will be calculated for the
	  bit-rate specified via Netlink argument "bitrate" when the device
	  get started. This works fine for the most common CAN controllers
	  with standard bit-rates but may fail for exotic bit-rates or CAN
	  source clock frequencies. Disabling saves some space, but then the
	  bit-timing parameters must be specified directly using the Netlink
	  arguments "tq", "prop_seg", "phase_seg1", "phase_seg2" and "sjw".
	  If unsure, say Y.

config FTCAN_SUPPORT_OVERLOAD_FRAME
	bool "FTCAN support overload frame"
	default y
	help
	  If enabled, CAN will transmit 1 overload fame for RX FIFO full
	  condition.
	  If unsure, say Y.

choice
	prompt "Choose retransmission times"
	default RETRANSMITTED_3_TIMES
	help
	  Choose retransmission times control due to arbitration
	  loss and errors.

	config ALWAYS_RETRANSMITTED
		bool "Message will always be retransmitted"
	config NEVER_RETRANSMITTED
		bool "Message will not be retransmitted"
	config RETRANSMITTED_3_TIMES
		bool "Message will be retransmitted at most 3 times"
	config RETRANSMITTED_8_TIMES
		bool "Message will be retransmitted at most 8 times"
endchoice

config FTCAN_RETRANSMISSION_TIMES
	int
	default 0 if ALWAYS_RETRANSMITTED
	default 1 if NEVER_RETRANSMITTED
	default 2 if RETRANSMITTED_3_TIMES
	default 3 if RETRANSMITTED_8_TIMES

endmenu
endif
```

## lotus/drivers/net/ethernet/Kconfig
```kconfig
choice
    prompt "Ethernet select"
    default LOTUS_FEMAC

config LOTUS_FEMAC
	tristate "Fast Ethernet MAC controller support"
	depends on HAS_IOMEM
	select PHYLIB
	select RESET_CONTROLLER
	help
	  This selects the Fast Ethernet MAC Controller(FEMAC).
	  The FEMAC receives and transmits data over Ethernet
	  ports at 10/100 Mbps in full-duplex or half-duplex mode.
	  The FEMAC exchanges data with the CPU, and supports
	  the energy efficient Ethernet (EEE).

config LOTUS_FTGMAC030
	tristate "Ftgmac030 Ethernet MAC controller support"
	depends on HAS_IOMEM
	select PHYLIB
	select RESET_CONTROLLER
	select LOTUS_PHY
	help
	  This selects the Ftgmac030 Ethernet MAC Controller(FTMAC).
	  The FTMAC receives and transmits data over Ethernet
	  ports at 10/100 Mbps in full-duplex or half-duplex mode.
	  The FTMAC exchanges data with the CPU, and supports
	  the energy efficient Ethernet (EEE).

endchoice
```

## lotus/drivers/net/ethernet/femac/Kconfig
```kconfig
config LOTUS_FEMAC
	tristate "Fast Ethernet MAC controller support"
	depends on HAS_IOMEM
	select PHYLIB
	select RESET_CONTROLLER
	help
	  This selects the Fast Ethernet MAC Controller(FEMAC).
	  The FEMAC receives and transmits data over Ethernet
	  ports at 10/100 Mbps in full-duplex or half-duplex mode.
	  The FEMAC exchanges data with the CPU, and supports
	  the energy efficient Ethernet (EEE).
```

## lotus/drivers/net/ethernet/ftgmac030/Kconfig
```kconfig
config LOTUS_FTGMAC030
	tristate "Ftgmac030 Ethernet MAC controller support"
	depends on HAS_IOMEM
	select PHYLIB
	select RESET_CONTROLLER
	help
	  This selects the Ftgmac030 Ethernet MAC Controller(FTMAC).
	  The FTMAC receives and transmits data over Ethernet
	  ports at 10/100 Mbps in full-duplex or half-duplex mode.
	  The FTMAC exchanges data with the CPU, and supports
	  the energy efficient Ethernet (EEE).
```

## lotus/drivers/net/mdio/Kconfig
```kconfig
config MDIO_LOTUS_FEMAC
	tristate "Fast Ethernet MAC MDIO bus support"
	depends on HAS_IOMEM && OF_MDIO && LOTUS_FEMAC
	help
	  This module provides a driver for the MDIO busses found in the
	  Lotus SoC that have an Fast Ethernet.
```

## lotus/drivers/net/phy/Kconfig
```kconfig
config LOTUS_PHY
	tristate "Lotus PHY controller support"
	help
	  This selects the Lotus PHY Controller(PHY).
```

## lotus/drivers/power/Kconfig
```kconfig
source "lotus/drivers/power/reset/Kconfig"
source "lotus/drivers/power/dvfs/Kconfig"
```

## lotus/drivers/power/dvfs/Kconfig
```kconfig
config POWER_DVFS_LOTUS
	bool "Lotus Cpufreq Driver"
	depends on ARCH_LOTUS
	select PM_OPP
	help
	  cpufreq support for Lotus boards.
```

## lotus/drivers/power/reset/Kconfig
```kconfig
config POWER_RESET_LOTUS
	bool "Power-Off(Reboot) Driver"
	depends on ARCH_LOTUS
	help
	  Reboot support for Lotus boards.
```

## lotus/drivers/pwm/Kconfig
```kconfig
config PWM_LOTUS
        tristate "Lotus IPC PWM Controller"
        depends on ARCH_LOTUS
	select PWM
        help
	  Generic PWM framework driver for Lotus SoCs.

	  To compile this driver as a module, choose M here: the module
	  will be called pwm-lotus.
```

## lotus/drivers/rtc/Kconfig
```kconfig
config RTC_DRV_LOTUS
        tristate "Lotus RTC support"
        depends on ARCH_LOTUS
        help
          Generic RTC framework driver for Xmedia SoCs.

          To compile this driver as a module, choose M here: the module
          will be called rtc.
```

## lotus/drivers/spi/Kconfig
```kconfig
config SPI_PL022_LOTUS
        tristate "ARM AMBA PL022 SSP controller"
        depends on ARM_AMBA
        default y if MACH_U300
        default y if ARCH_REALVIEW
        default y if INTEGRATOR_IMPD1
        default y if ARCH_VERSATILE
        help
          This selects the ARM(R) AMBA(R) PrimeCell PL022 SSP
          controller. If you have an embedded system with an AMBA(R)
          bus and a PL022 controller, say Y or M here.
```

## lotus/drivers/usb/Kconfig
```kconfig
config USB_DWC3_LOTUS
	tristate "Platforms Device DWC3"
	depends on ARCH_LOTUS
	depends on USB_SUPPORT
	help
	  LOTUS SoCs with one DesignWare Core USB3 IP
	  Say 'Y' or 'M' if you have one such device.
```

## lotus/fs/Kconfig
```kconfig
#
# File system configuration
#

menu "File systems"

source "lotus/fs/yaffs2/Kconfig"

endmenu
```

## lotus/machine/Kconfig
```kconfig
menuconfig ARCH_LOTUS
	bool "Lotus SoCs"
	select ARM_AMBA
	select ARM_GIC if ARCH_MULTI_V7
	select POWER_RESET
	select POWER_RESET_LOTUS
	select POWER_SUPPLY
	select HAVE_ARCH_KCSAN
	# select HAVE_ARCH_KASAN
	# select ARCH_HAS_UBSAN_SANITIZE_ALL

if ARCH_LOTUS

config ARCH_XMFALCON
	bool "XMFALCON Cortex-A55 Family"
	select HAVE_ARM_ARCH_TIMER
	select HAVE_KERNEL_GZIP
	select HAVE_KERNEL_LZMA
	select PINCTRL
	select POWER_RESET_LOTUS
	help
	  Support for XMFALCON Soc Family.

config ARCH_XMORCA
	bool "XMORCA Cortex-A7 Family"
	depends on ARCH_MULTI_V7
	select HAVE_ARM_ARCH_TIMER
	select PINCTRL
	select POWER_RESET_LOTUS
	help
	  Support for XMORCA Soc Family.

endif

config LOTUS_SOC_NAME
	string "Soc name"
	default "xmfalcon" if ARCH_XMFALCON
	default "xmorca" if ARCH_XMORCA

# config TINY_LINUX
#         bool "Tiny Linux"
#         default n
#

menu "Boot options"

config BSP_ZRELADDR
	hex 'zreladdr'
	default "0x40008000"

endmenu

config FPGA_SUPPORT
	bool "FPGA Support"
	help
	  Support for FPGA board.
```

## lotus/scripts/Kconfig
```kconfig
config HW_GZIP_TOOL
	string "HW GZIP Tool"
	default ""
	help
	  "HW GZIP Tool file path"
```

## lotus/self-test/Kconfig
```kconfig
menuconfig LOTUS_SELF_TEST
	bool "Self test"
	default n

if LOTUS_SELF_TEST
config LOTUS_HRTIMER_TEST
	tristate "Support hrtimer test"
	default y if LOTUS_SELF_TEST

config LOTUS_TIMESTAMP_TEST
	tristate "Support timestamp test"
	default y if LOTUS_SELF_TEST
endif # if LOTUS_SELF_TEST
```

## modules/gpu/Kconfig
```kconfig
menu "GPU support for sunxi"

config SUNXI_GPU_TYPE
	string "The GPU type"
	default "None"
	help
	  The GPU type used on the platform.

config GPU_PM_OPP
	bool "GPU PM OPP"
	default n
	select PM_OPP
	help
	  Read VF table of GPU

endmenu
```

## modules/nand/Kconfig
```kconfig
config SUNXI_NAND
	tristate  "The sunxi nand driver"
	default n
	help
	  The nand used on the platform.

	  If unsure, say m.
source "modules/nand/common1/Kconfig"

config SUNXI_NAND_IOCTL_SECBLK
	depends on (SUNXI_NAND)
	bool  "Support ioctl for nand secure storage item"
	default y
	help
	  Ioctl for secure storage item

config SUNXI_NAND_IOCTL_SECKV
	depends on (SUNXI_NAND)
	bool  "Support ioctl for nand secure storage kv"
	default n
	help
	  Ioctl for secure storage kv

config SUNXI_NAND_IOCTL_SECKV_PROTECT
	depends on (SUNXI_NAND_IOCTL_SECKV)
	bool "Protect nand secure storage kv"
	default y
	help
	  If y, write kv to secure storage will default
	  with protect flag, then you can't overwrite it
	  unless erase first.
```
