## drivers/media/platform/ingenic/helix/Kconfig
```kconfig
# SPDX-License-Identifier: GPL-2.0
# Copyright (C) 2026 Difan Zhang

config VIDEO_INGENIC_HELIX
	tristate "Ingenic T23 Helix V4L2 M2M video encoder"
	depends on V4L_MEM2MEM_DRIVERS
	depends on VIDEO_DEV
	depends on MACH_INGENIC || COMPILE_TEST
	depends on OF && HAS_DMA
	select VIDEOBUF2_DMA_CONTIG
	select V4L2_MEM2MEM_DEV
	help
	  V4L2 memory-to-memory H.264 and JPEG hardware encoder driver
	  for Ingenic T23 SoCs.

	  To compile this driver as a module, choose M here: the module
	  will be called ingenic-helix-v4l2.
```

## drivers/media/platform/ingenic/ipu/Kconfig
```kconfig
# SPDX-License-Identifier: GPL-2.0
# Copyright (C) 2026 Difan Zhang

config VIDEO_INGENIC_IPU
	tristate "Ingenic T23 IPU v13 V4L2 M2M image processor"
	depends on V4L_MEM2MEM_DRIVERS
	depends on VIDEO_DEV
	depends on MACH_INGENIC || COMPILE_TEST
	depends on OF && HAS_DMA
	select VIDEOBUF2_DMA_CONTIG
	select V4L2_MEM2MEM_DEV
	help
	  V4L2 memory-to-memory NV12/NV21 and RGB format conversion and
	  crop/compose driver for Ingenic T23 IPU v13 hardware.

	  To compile this driver as a module, choose M here: the module
	  will be called ingenic-ipu.
```

## drivers/media/platform/ingenic/tx-isp/Kconfig
```kconfig
# SPDX-License-Identifier: GPL-2.0
# Copyright (C) 2026 Difan Zhang

config VIDEO_INGENIC_ISP
	tristate "Ingenic T23 Image Signal Processor (ISP) driver"
	depends on V4L_PLATFORM_DRIVERS
	depends on VIDEO_DEV && VIDEO_V4L2_SUBDEV_API && MEDIA_CONTROLLER
	depends on MACH_INGENIC || COMPILE_TEST
	depends on OF && HAS_DMA
	select VIDEOBUF2_V4L2
	select VIDEOBUF2_DMA_CONTIG
	select VIDEOBUF2_VMALLOC
	select V4L2_FWNODE
	help
	  Say yes or m here to build V4L2 support for the Ingenic T23 VIC,
	  CSI-2 receiver, ISP core, MSCA scaler, motion detector, and OSD
	  overlay pipeline.

	  To compile this driver as a module, choose M here: the module
	  will be called tx-isp.
```

## drivers/phy/ingenic/Kconfig
```kconfig
# SPDX-License-Identifier: GPL-2.0
#
# Phy drivers for Ingenic platforms
#
config PHY_INGENIC_USB
	tristate "Ingenic SoCs USB PHY Driver"
	depends on MIPS || COMPILE_TEST
	depends on USB_SUPPORT
	depends on HAS_IOMEM
	select GENERIC_PHY
	select MFD_SYSCON if MACH_T23
	help
	  This driver provides USB PHY support for the USB controller found
	  on the JZ-series, X-series, and T-series SoCs from Ingenic.
```

## drivers/soc/axera/Kconfig
```kconfig
# SPDX-License-Identifier: GPL-2.0-only

config AXERA_VPU
	bool "Axera VPU clock, reset, and frequency"
	depends on ARCH_AXERA
	select PM_OPP
	default y
	help
	  Turn on the AX630C Hantro VENC, JENC, and VDEC clocks and resets
	  and switch their muxes across the vendor OPP rates.
	  The vendor command-queue driver is not in the public SDK.

config AXERA_OSAL
	bool "Axera OSAL (AX_OSAL_* kernel API for the vendor media modules)"
	depends on ARCH_AXERA
	select AXERA_OS_MEM
	select SRCU
	help
	  The operating system abstraction layer Axera's closed media
	  modules (ax_sys, ax_cmm, ax_pool, ax_npu, ax_ivps, ...) link
	  against. Built in, as in the vendor kernel, together with
	  /proc/ax_proc.

config AX_HWINFO
	bool "Axera hardware info (/proc/ax_proc/{chip_type,board_id,uid})"
	depends on ARCH_AXERA

config AX_BWLIMITER
	bool "Axera DDR bandwidth limiter"
	depends on ARCH_AXERA

config AXERA_SYS_MAP
	bool "Axera /dev/ax_sysmap DDR mapping for user space"
	depends on ARCH_AXERA

config AXERA_DW_APB_TIMER
	tristate "Axera DW APB timer channels"
	depends on ARCH_AXERA

config AXERA_PERIPH_TIMER32
	tristate "Axera peripheral timer32"
	depends on ARCH_AXERA

config AXERA_HRTIMER
	bool "Axera DW-timer based ax_hrtimer"
	depends on ARCH_AXERA

config AXERA_OS_MEM
	bool "Axera per-module kernel memory accounting (ax_os_mem_*)"
	depends on ARCH_AXERA

config AXERA_DISPLAY_DUMMY
	bool "Axera display stubs (ax_display_register) without DRM"
	depends on ARCH_AXERA && DRM=n
	default y
```
