## drivers/net/ethernet/fullhan/Kconfig
```kconfig
#
# Fullhan device configuration
#

config NET_VENDOR_FULLHAN
	bool "Fullhan devices"
	default y
	depends on ARM
	---help---
	  If you have a network (Ethernet) card belonging to this class, say Y
	  and read the Ethernet-HOWTO, available from
	  <http://www.tldp.org/docs.html#howto>.

	  Note that the answer to this question doesn't directly affect the
	  kernel: saying N will just cause the configurator to skip all
	  the questions about Faraday cards. If you say Y, you will be asked for
	  your specific card in the following questions.

if NET_VENDOR_FULLHAN

config FH_GMAC
	tristate "FH 10/100 Ethernet driver"
	select MII
	select PHYLIB
	select CRC32
	depends on NETDEVICES && HAS_IOMEM
	help
	  This is the driver for the Ethernet IPs are built around a
	  Synopsys IP Core.

config FH_GMAC_DA
	bool "FH GMAC DMA arbitration scheme"
	default n
	help
	  Selecting this option, rx has priority over Tx (only for Giga
	  Ethernet device).
	  By default, the DMA arbitration scheme is based on Round-robin
	  (rx:tx priority is 1:1).	  


config FH_EPHY
	bool "FH Independent Research Ephy"
	default n
	help
	  This is the driver for Independent Research Ephy.


endif # NET_VENDOR_FULLHAN
```

## drivers/net/ethernet/goke/Kconfig
```kconfig
#
# Acorn Network device configuration
#  These are for Acorn's Expansion card network interfaces
#

config ETH_GOKE
	tristate "Goke 10/100/1000 GMAC Ethernet support"
	depends on GK_ETH
	select CRC32
	select PHYLIB
	select MII
	help
	  This driver supports Goke 10/100/1000 GMAC Ethernet.
```

## drivers/net/ethernet/ingenic/Kconfig
```kconfig
config INGENIC_MAC
	tristate "ingenic on-chip MAC support"
	select CRC32
	select RMII
	select MII
	help
	  This is the driver for INGENIC on-chip mac device.

config INGENIC_MAC_DMA_INTERFACES
	bool "Ingenic mac dma interfaces"
	depends on INGENIC_MAC
	help
	  This is for MAC Dma interfaces selection
choice
	prompt "Ingenic mac dma bus interfaces"
	depends on INGENIC_MAC_DMA_INTERFACES
	default CONFIG_INGENIC_MAC_AHB_BUS

config INGENIC_MAC_AXI_BUS
	bool "MAC_AXI_BUS"
	help
	  Select for mac dma AXI bus

config INGENIC_MAC_AHB_BUS
	bool "MAC_AHB_BUS"
	help
	  Select for mac dma AHB bus
endchoice
```

## drivers/net/ethernet/novatek/Kconfig
```kconfig
#
# Synopsys network device configuration
#

config NET_VENDOR_NOVATEK
	bool "Novatek devices"
	default y
	---help---
	  If you have a network (Ethernet) device belonging to this class, say Y.

	  Note that the answer to this question doesn't directly affect the
	  kernel: saying N will just cause the configurator to skip all
	  the questions about Novatek devices. If you say Y, you will be asked
	  for your specific device in the following questions.

source "drivers/net/ethernet/novatek/na51055/Kconfig"
source "drivers/net/ethernet/novatek/na51089/Kconfig"
```

## drivers/net/ethernet/novatek/na51055/Kconfig
```kconfig
#
# Synopsys network device configuration
#

config NOVATEK_DWC_ETH_QOS_NA51055
	tristate "Novatek DWC Ethernet QOS support"
	depends on NVT_IVOT_PLAT_NA51055 && NET_VENDOR_NOVATEK
        select PHYLIB
        select CRC32
        select MII
        select INET_LRO
        depends on HAS_DMA
        ---help---
          This driver supports the DWC Ethernet QoS

config TX_DESC
	int
	prompt "Tx Descriptor Number (minimum: 32)"
	default 256
	range 32 256
	depends on NOVATEK_DWC_ETH_QOS_NA51055
	
config RX_DESC
	int
	prompt "Rx Descriptor Number (minimum: 32)"
	default 256
	range 32 256
	depends on NOVATEK_DWC_ETH_QOS_NA51055

config NVT_MDIO_NA51055
        tristate "Novatek NA51055 Ethernet MDIO driver"
        depends on NVT_IVOT_PLAT_NA51055
	select NVT_MDIO_NA51055_CFG
        help
          Support mdio driver on Novatek NA51055.

config NVT_MDIO_NA51055_CFG
	bool
	prompt "MDIO DRIVER CONFIG"
	depends on NVT_MDIO_NA51055
	default n
```

## drivers/net/ethernet/novatek/na51089/Kconfig
```kconfig
#
# Synopsys network device configuration
#

config NOVATEK_DWC_ETH_QOS_NA51089
	tristate "Novatek DWC Ethernet QOS support"
	depends on NVT_IVOT_PLAT_NA51089 && NET_VENDOR_NOVATEK
        select PHYLIB
        select CRC32
        select MII
        select INET_LRO
        depends on HAS_DMA
        ---help---
          This driver supports the DWC Ethernet QoS

config TX_DESC
	int
	prompt "Tx Descriptor Number (minimum: 64)"
	default 256
	range 64 256
	depends on NOVATEK_DWC_ETH_QOS_NA51089
	
config RX_DESC
	int
	prompt "Rx Descriptor Number (minimum: 64)"
	default 256
	range 64 256
	depends on NOVATEK_DWC_ETH_QOS_NA51089
```

## drivers/net/ethernet/xmedia/Kconfig
```kconfig
#
# Xmedia device configuration
#

config NET_VENDOR_XMEDIA
	bool "Xmedia devices"
	default y
	depends on (OF || ACPI) && HAS_DMA
	depends on ARM || ARM64 || COMPILE_TEST
	---help---
	  If you have a network (Ethernet) card belonging to this class, say Y.

	  Note that the answer to this question doesn't directly affect the
	  kernel: saying N will just cause the configurator to skip all
	  the questions about Xmedia devices. If you say Y, you will be asked
	  for your specific card in the following questions.

if NET_VENDOR_XMEDIA

config XMEDIA_FEMAC
	tristate "Xmedia Fast Ethernet MAC device support"
	depends on HAS_IOMEM
	select PHYLIB
	select RESET_CONTROLLER
	help
	  This selects the Xmedia Fast Ethernet MAC device(FEMAC).
	  The FEMAC receives and transmits data over Ethernet
	  ports at 10/100 Mbps in full-duplex or half-duplex mode.
	  The FEMAC exchanges data with the CPU, and supports
	  the energy efficient Ethernet (EEE).

endif # NET_VENDOR_XMEDIA
```

## drivers/net/fh_gmac/Kconfig
```kconfig
config FH_GMAC
	tristate "FH 10/100 Ethernet driver"
	select MII
	select PHYLIB
	select CRC32
	depends on NETDEVICES && HAS_IOMEM
	help
	  This is the driver for the Ethernet IPs are built around a
	  Synopsys IP Core.

if FH_GMAC

config FH_GMAC_DA
	bool "FH GMAC DMA arbitration scheme"
	default n
	help
	  Selecting this option, rx has priority over Tx (only for Giga
	  Ethernet device).
	  By default, the DMA arbitration scheme is based on Round-robin
	  (rx:tx priority is 1:1).	  
endif
```

## drivers/net/wireless/esp32/Kconfig
```kconfig
menuconfig ESP32_WLAN
	tristate "ESP32 WLAN support"
	default n
	---help---
	  To compile this code as a module, choose M here.
```

## drivers/net/wireless/rtl8189fs/Kconfig
```kconfig
config RTL8189FS
	tristate "Realtek 8189F SDIO WiFi"
	depends on MMC
	---help---
	  Help message of RTL8189FS
```

## drivers/net/wireless/sd8686_uap/Kconfig
```kconfig
config SD8686_UAP
	tristate "Marvell 8xxx UAP support"
	default y
	---help---
	  A User Access Point driver for Marvell sd8686 devices.
```

## drivers/net/wireless/xr806/Kconfig
```kconfig
config XR806_WLAN
	tristate "XR806 WLAN support"
	default n
	---help---
	  To compile this code as a module, choose M here.
```

## drivers/net/wireless/xr819s/Kconfig
```kconfig
menuconfig XR819S_WLAN
	tristate "XR819S WLAN support"
	default n
	select CFG80211
	select AVERAGE
	select CRYPTO
	select CRYPTO_ARC4
	---help---
	  To compile this code as a module, choose M here.

if XR819S_WLAN

source "drivers/net/wireless/xr819s/umac/Kconfig"
source "drivers/net/wireless/xr819s/wlan/Kconfig"

endif # CONFIG_XR819S_WLAN
```

## drivers/ntb/Kconfig
```kconfig
# SPDX-License-Identifier: GPL-2.0-only
menuconfig NTB
	tristate "Non-Transparent Bridge support"
	depends on PCI
	help
	 The PCI-E Non-transparent bridge hardware is a point-to-point PCI-E bus
	 connecting 2 systems.  When configured, writes to the device's PCI
	 mapped memory will be mirrored to a buffer on the remote system.  The
	 ntb Linux driver uses this point-to-point communication as a method to
	 transfer data from one system to the other.

	 If unsure, say N.

if NTB

config NTB_MSI
	bool "MSI Interrupt Support"
	depends on PCI_MSI
	help
	 Support using MSI interrupt forwarding instead of (or in addition to)
	 hardware doorbells. MSI interrupts typically offer lower latency
	 than doorbells and more MSI interrupts can be made available to
	 clients. However this requires an extra memory window and support
	 in the hardware driver for creating the MSI interrupts.

	 If unsure, say N.
source "drivers/ntb/hw/Kconfig"

source "drivers/ntb/test/Kconfig"

config NTB_TRANSPORT
	tristate "NTB Transport Client"
	help
	 This is a transport driver that enables connected systems to exchange
	 messages over the ntb hardware.  The transport exposes a queue pair api
	 to client drivers.

	 If unsure, say N.

config NTB_VIRTIO
	tristate "NTB VIRTIO"
	help
	 The NTB virtio driver sits between the NTB HW driver and the virtio
	 client driver and lets the virtio client driver to exchange data with
	 the remote vhost driver over the NTB hardware.

	 If unsure, say N.

config NTB_VHOST
	tristate "NTB VHOST"
	help
	 The NTB vhost driver sits between the NTB HW driver and the vhost
	 client driver and lets the vhost client driver to exchange data with
	 the remote virtio driver over the NTB hardware.

	 If unsure, say N.

endif # NTB
```
