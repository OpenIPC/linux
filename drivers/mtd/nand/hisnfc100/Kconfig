## drivers/mtd/nand/hisnfc100/Kconfig
```kconfig
#
# drivers/mtd/nand/hisnfc100/Kconfig
# add by hisilicon 2017.10.26
#

menuconfig MTD_NAND_HISNFC100
	tristate "Hisilicon SPI Nand Controller v100 SPI Nand devices support"
	depends on MTD_SPI_NAND_HISI_BVT && (ARCH_HI3516A)
	select YAFFS_FS
	select MISC_FILESYSTEMS
	select MTD_BLOCK
	select YAFFS_YAFFS2
	help
	  Hisilicon SPI Nand Controller version 100 is called HISNFC100 for
	  short. The controller support registers and DMA transfers while
	  reading or writing the spi nand flash.

if MTD_NAND_HISNFC100

config HISNFC100_MAX_CHIP
	int "number of spi nand flash chip (1, 2)"
	range 1 2
	default 1
	help
	  spi nand controller v100 device only support 1 or 2 spi nand
	  flash chip, your should not config other value.

choice
	prompt "Pagesize and Ecc Type Select"

config HISNFC100_HARDWARE_PAGESIZE_ECC
	bool "Hardware"
	help
	  the configure of page size and ecc type lie on switch
	  on the board.
	  so the page size and ecc type is controlled by Hardware
	  see demo board of SOC.

config HISNFC100_AUTO_PAGESIZE_ECC
	bool "Auto"
	help
	  auto-sensed the page size and ecc type value. driver will
	  try each of page size and ecc type one by one till flash
	  can be read and wrote accurately.
	  so the page size and ecc type is match adaptively without
	  switch on the board

config HISNFC100_PAGESIZE_AUTO_ECC_NONE
	bool "Pagesize Auto, Ecc None"
	help
	  select pagesize 2K, ecc none.

endchoice

endif # MTD_NAND_HISNFC100
```

## drivers/mtd/nand/xmedia_fmc100/Kconfig
```kconfig
#
# xmedia flash memory controller SPI nand device driver version 100
# drivers/mtd/nand/xmedia_fmc100/Kconfig
# add by xmedia 2017.8.7
#

config MTD_SPI_NAND_XMEDIA_FMC100
	bool "Xmedia Flash Memory Controller v100 SPI Nand devices support"
	depends on MFD_XMEDIA_FMC && MTD_SPI_NAND_XMEDIA
	select MISC_FILESYSTEMS
	select MTD_BLOCK
	select YAFFS_FS
	select YAFFS_YAFFS2
	help
	  Xmedia Flash Memory Controller version 100 is called xmedia_fmc100 for
	  short. The controller driver support registers and DMA transfers
	  while reading or writing the SPI nand flash.
```

## drivers/mtd/spi-nand/Kconfig
```kconfig
menuconfig MTD_SPI_NAND
	tristate "SPI-NAND device Support"
	depends on MTD_NAND && SPI
	help
	  This is the framework for the SPI NAND which can be used by the SPI
	  device drivers and the SPI-NAND device drivers.
```

## drivers/mtd/spi-nor/Kconfig
```kconfig
# SPDX-License-Identifier: GPL-2.0-only
menuconfig MTD_SPI_NOR
	tristate "SPI NOR device support"
	depends on MTD
	depends on MTD && SPI_MASTER
	select SPI_MEM
	help
	  This is the framework for the SPI NOR which can be used by the SPI
	  device drivers and the SPI NOR device driver.

if MTD_SPI_NOR

config MTD_SPI_NOR_USE_4K_SECTORS
	bool "Use small 4096 B erase sectors"
	default y
	help
	  Many flash memories support erasing small (4096 B) sectors. Depending
	  on the usage this feature may provide performance gain in comparison
	  to erasing whole blocks (32/64 KiB).
	  Changing a small part of the flash's contents is usually faster with
	  small sectors. On the other hand erasing should be faster when using
	  64 KiB block instead of 16 × 4 KiB sectors.

	  Please note that some tools/drivers/filesystems may not work with
	  4096 B erase size (e.g. UBIFS requires 15 KiB as a minimum).

config XMEDIA_SPI_BLOCK_PROTECT
        bool "Xmedia Spi Nor Device BP(Block Protect) Support"
        depends on SPI_XMEDIA_SFC
        default y if SPI_XMEDIA_SFC
        help
          XMEDIA SFC supports BP(Block Protect) feature to preestablish a series
          area to avoid writing and erasing, except to reading. With this macro
          definition we can get the BP info which was setted before. The
          BOTTOM/TOP bit is setted to BOTTOM, it means the lock area starts
          from 0 address.

source "drivers/mtd/spi-nor/controllers/Kconfig"

endif # MTD_SPI_NOR
```

## drivers/mtd/spi-nor/hisfc350/Kconfig
```kconfig
#
# hisilicon spi flash controller device version 350
#

menuconfig MTD_HISFC350
	tristate "hisilicon spi flash controller device version 350 driver"
	depends on (ARCH_HI3516A)
	default y if (ARCH_HI3516A)
	select MTD_SPI_IDS
	help
	  Hisilicon spi flash controller device version 350.
	  Hisilicon spi flash controller version 350 support
	  DMA transfers while reading and write the spi flash,
	  which will improve the performace very much.

if MTD_HISFC350

config HISFC350_SYSCTRL_ADDRESS
	hex "cpu system control register base address"
	default "0x20030000" if (ARCH_HI3516A)

config HISFC350_CHIP_NUM
	int "hisfc350 spi chip number"
	default 2 if (ARCH_HI3516A)

config HISFC350_SHOW_CYCLE_TIMING
	bool "show spi read/write/erase cycle timing"
	default n if (ARCH_HI3516A)
	help
	  Show spi read/write/erase cycle timing, command, clock.
	  This is a debug option. When enabled, some command and
	  cycles uesed on operations will show for you.
	  If unsure, say no.

config HISFC350_ENABLE_CHIPSELECT_0
	bool "use spi device on chipselect 0"
	default n if (ARCH_HI3516A)

config HISFC350_ENABLE_CHIPSELECT_1
	bool "use spi device on chipselect 1"
	default y if (ARCH_HI3516A)

config HISFC350_ENABLE_INTR_DMA
	bool "use the IRQ mode of spi device R/W"
	default n if (ARCH_HI3516A)

config CMD_SPI_BLOCK_PROTECTION
	bool "enable the SPI nor flash block protection"
	default y if (ARCH_HI3516A)

endif # MTD_HISFC350
```

## drivers/mtd/spiflash/Kconfig
```kconfig
config MTD_SPINAND
	tristate "SPINAND Device Support for Micron/winbond"
	depends on MTD_NAND
	help
	  This enables support for accessing Micron/winbond SPI NAND flash
	  devices.
	  If you have Micron/winbond SPI NAND chip say yes.

	  If unsure, say no here.

config MTD_SPINAND_HWECC
	bool "Use SPINAND Hardware ECC"
	depends on MTD_SPINAND
	help
	  Hardware ECC.
	  Enables Hardware ECC support for SPI NAND.

config FLASH_ONLY_DUAL
	bool "Only Support spi-nand dual mode"
	depends on MTD_SPINAND
	help
	  Dual mode supports.
	  Force flash operations under dual mode.

config MTD_SPINOR
	tristate "SPINOR Device Support"
	depends on (MTD) && (!MTD_SPINAND)
	help
	  This enables support for accessing SPI NOR flash
	  devices.
	  If you have SPI NOR chip say yes.

	  If unsure, say no here.

config MTD_SPI020NAND
	tristate "SPI020 NAND Device Support"
	depends on (MTD_NAND && NVT_IVOT_PLAT_NA51068)
	help
	  This enables support for accessing SPI NAND flash
	  devices.
	  If you have SPI NAND chip say yes.

	  If unsure, say no here.

config MTD_SPI020NOR
	tristate "SPI020 NOR Device Support"
	depends on (MTD && NVT_IVOT_PLAT_NA51068)
	help
	  This enables support for accessing SPI NOR flash
	  devices.
	  If you have SPI NOR chip say yes.

	  If unsure, say no here.

config FLASH_ONLY_DUAL
	bool "Only Support spi-nor dual mode"
	depends on MTD_SPINOR
	help
	  Dual mode supports.
	  Force flash operations under dual mode.

config MTD_EXTERNAL_FLASH_TABLE
	tristate "Using external flash table"
	depends on MTD_SPINOR
	help
	  This enables support for using external flash table
	  If you have requrired external table say yes.

	  If unsure, say no here.
```

## drivers/mtd/spinand/Kconfig
```kconfig
#
# linux/drivers/mtd/spinand/Kconfig
#

menuconfig MTD_SPINAND
	tristate "SPINAND Device Support"
	depends on MTD
	help
	  This enables support for accessing SPI NAND flash device.

if MTD_SPINAND

config MTD_SPINAND_GOKE
	tristate "SPINAND on goke ipc support"
	depends on GK_SFLASH
	help
		Support for a SPINAND flash device connected to GK7101 EVB.

if MTD_SPINAND_GOKE
          
config MTD_SPINAND_INTERECC
	bool "Use internal ECC"
	help
	  Internal ECC

config SELF_START_BLOCK
	bool "Save BBT to the special block"
	help
		save BBT to the special block by user
		
config DEBUG_W
	bool "Open debug mode to write"
	help
	  Debug to write spinand

config DEBUG_R
	bool "Open debug mode to read"
	help
	  Debug to read spinand
	  
endif

endif
```

## drivers/mtd/xmedia/Kconfig
```kconfig
menuconfig MTD_XMEDIA_FMC100
	tristate "Xmedia Flash Memory Controller Ver 100 support"
	depends on !SPI_XMEDIA_SFC
	default n
	select MTD_BLOCK
	help
	  Support Xmedia Flash Memory Controller Version 100.

if MTD_XMEDIA_FMC100

config MTD_XMEDIA_FMC100_SPINOR
	bool "Xmedia Spi-Nor Flash support"
	default y
	help
	  Support Xmedia Spi-Nor Flash Memory.

config MTD_XMEDIA_FMC100_SPINAND
	bool "Xmedia Spi-Nand Flash support"
	default n
	help
	  Support Xmedia Spi-Nand Flash Memory.

config MTD_XMEDIA_FMC100_NAND
	bool "Xmedia Nand Flash support"
	default n
	help
	  Support Xmedia Nand Flash Memory.

endif
```

## drivers/net/ethernet/allwinner/Kconfig
```kconfig
#
# Allwinner device configuration
#

config NET_VENDOR_ALLWINNER
	bool "Allwinner devices"
	default y

	depends on ARCH_SUNXI
	---help---
	  If you have a network (Ethernet) card belonging to this
	  class, say Y here.

	  Note that the answer to this question doesn't directly
	  affect the kernel: saying N will just cause the configurator
	  to skip all the questions about Allwinner cards. If you say Y,
	  you will be asked for your specific card in the following
	  questions.

if NET_VENDOR_ALLWINNER

config SUN4I_EMAC
        tristate "Allwinner A10 EMAC support"
	depends on ARCH_SUNXI
	depends on OF
	select CRC32
	select MII
	select PHYLIB
	select MDIO_SUN4I
        ---help---
          Support for Allwinner A10 EMAC ethernet driver.

          To compile this driver as a module, choose M here.  The module
          will be called sun4i-emac.

config SUNXI_GMAC
        tristate "Allwinner GMAC support"
	depends on ARCH_SUNXI
	depends on OF
	select CRC32
	select MII
	select PHYLIB
	select MDIO_SUNXI
        ---help---
          Support for Allwinner Gigabit ethernet driver.

          To compile this driver as a module, choose M here.  The module
          will be called sunxi-gmac.

config SUNXI_GMAC_HW_MACADDR
		bool "Allwinner GMAC support ChipID Macaddr"
	depends on SUNXI_GMAC
	select CRYPTO_MD5
	default n
        ---help---
          Allwinner Gigabit ethernet driver get ChipID md5 as macaddr.

config SUNXI_GETH
        tristate "Allwinner GETH support"
	depends on ARCH_SUNXI
	depends on !SUNXI_GMAC
	depends on OF
	select CRC32
	select MII
	select PHYLIB
	select MDIO_SUNXI
        ---help---
          Support for Allwinner Gigabit ethernet driver.

          To compile this driver as a module, choose M here.  The module
          will be called sunxi-geth.ko

config SUNXI_EXT_PHY
	bool "Use extern phy"
	depends on SUNXI_GMAC || SUNXI_GETH
	default y
	---help---
	  Allwinnertech SOC support both internal & extern PHY, Say "Y" to
	  choose use extern phy, Say "N" to use internal phy
endif # NET_VENDOR_ALLWINNER
```

## drivers/net/ethernet/ambarella/Kconfig
```kconfig
#
# AMBARELLA network device configuration
#

config NET_VENDOR_AMBARELLA
	tristate "Ambarella 10/100/1000 GMAC Ethernet support"
	depends on PLAT_AMBARELLA
	select CRC32
	select PHYLIB
	select MII
	help
	  This driver supports Ambarella 10/100/1000 GMAC Ethernet.

config NET_VENDOR_AMBARELLA_INTEN_TUE
	bool "Enable Transmit Buffer Unavailable Interrupt"
	default n
	depends on NET_VENDOR_AMBARELLA
	help
	  Enable ETH_DMA_INTEN_TUE will downgrade the performance in most case,
	  but you will get a quick response especially in GMII mode.

	  If you are not sure, say N here.
```

## drivers/net/ethernet/faraday/Kconfig
```kconfig
#
# Faraday device configuration
#

config NET_VENDOR_FARADAY
	bool "Faraday devices"
	default y
	depends on ARM
	---help---
	  If you have a network (Ethernet) card belonging to this class, say Y
	  and read the Ethernet-HOWTO, available from
	  <http://www.tldp.org/docs.html#howto>.

	  Note that the answer to this question doesn't directly affect the
	  kernel: saying N will just cause the configurator to skip all
	  the questions about Faraday cards. If you say Y, you will be asked for
	  your specific card in the following questions.

if NET_VENDOR_FARADAY

config FTGMAC100
	tristate "Faraday FTGMAC100 support"
	help
	  This driver supports Faraday(R) FTGMAC100 gigabit ethernet family of
	  adapters.  
	  For general information and support, go to the Faraday support
	  website at:
	  <http://www.faraday-tech.com>
	 
	  To compile this driver as a module, choose M here and read
	  <file:Documentation/networking/net-modules.txt>.  The module
	  will be called ftgmac100.

if FTGMAC100
if PLATFORM_GM8210

config FTGMAC100_DRIVER_0_MASTER
	bool "Enable GMAC 0 for 726"
	default y
	help
	  If we want to use GMAC driver 0 for 726, say Y; otherwise say N.	  
config FTGMAC100_DRIVER_0_SLAVE
	bool "Enable GMAC 0 for 626"
	default y
	help
	  If we want to use GMAC driver 0 for 626, say Y; otherwise say N.
config FTGMAC100_DRIVER_1_MASTER
	bool "Enable GMAC 1 for 726"
	default y
	help
	  If we want to use GMAC driver 1 for 726, say Y; otherwise say N.
config FTGMAC100_DRIVER_1_SLAVE
	bool "Enable GMAC 1 for 626"
	default y
	help
	  If we want to use GMAC driver 1 for 626, say Y; otherwise say N.
endif	# if PLATFORM_GM8210

if !PLATFORM_GM8210
config FTGMAC100_DRIVER_0_MASTER
	bool "Enable GMAC 0"
	default y
	help
	  If we want to use GMAC driver 0, say Y; otherwise say N.

config FTMAC_TINY
    bool "Less queue number"
    default n
	depends on FTGMAC100_DRIVER_0_MASTER
	help
	    Use less queue number, if user application is not enough,
	    please disable it.
endif

endif	# if FTGMAC100

config FTGMAC030
	tristate "Faraday FTGMAC030 support"
	default n
	help
	  This driver supports Faraday(R) FTGMAC030 gigabit ethernet family of
	  adapters.  
	  For general information and support, go to the Faraday support
	  website at:
	  <http://www.faraday-tech.com>
	 
	  To compile this driver as a module, choose M here and read
	  <file:Documentation/networking/net-modules.txt>.  The module
	  will be called ftgmac030.

if FTGMAC030
if PLATFORM_GM8220

config FTGMAC030_DRIVER_0
	bool "Enable GMAC 0"
	default y
	help
	  If we want to use GMAC driver 0, say Y; otherwise say N.	  
config FTGMAC030_DRIVER_1
	bool "Enable GMAC 1"
	default y
	help
	  If we want to use GMAC driver 1, say Y; otherwise say N.
endif	# if PLATFORM_GM8220

endif	# if FTGMAC030

config FTMAC110
	tristate "Faraday FTMAC110 support"
	select NET_CORE
	select MII
	help
	  This driver supports Faraday(R) FTMAC110 10/100 ethernet family of
	  adapters.  
	  For general information and support, go to the Faraday support
	  website at:
	  <http://www.faraday-tech.com>
	 
	  To compile this driver as a module, choose M here and read
	  <file:Documentation/networking/net-modules.txt>.  The module
	  will be called ftmac110.

if FTMAC110

config FTMAC110_PHYADDR
	int "PHY Address"
	default 1
	depends on FTMAC110
	
config FTMAC110_PHYMON
	bool "PHY Monitor"
	default n
	depends on FTMAC110
	help
	  If ftmac110 is connected with a single phy, say Y; otherwise say N.
	
config FTMAC110_NDESC_TX
	int "Tx Descriptor Number"
	default 256
	depends on FTMAC110
	
config FTMAC110_NDESC_RX
	int "Rx Descriptor Number"
	default 256
	depends on FTMAC110

config FTMAC110_NAPI
	bool "NAPI(New API) support"
	default y
	depends on FTMAC110
	
config FTMAC110_NAPI_LRO
	bool "LRO(Large Receive Offload) support"
	default y
	select INET_LRO
	depends on FTMAC110_NAPI

endif	# if FTMAC110

endif # NET_VENDOR_FARADAY
```
