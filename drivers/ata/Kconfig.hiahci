## drivers/ata/Kconfig.hiahci
```kconfig
menuconfig HISI_SATA
	bool "Hisilicon sata device support"
	depends on (ARCH_HI3536DV100 || ARCH_HI3521A || ARCH_HI3531A)
	default n
	select ATA
	select ATA_VERBOSE_ERROR
	select SATA_PMP
	select SATA_AHCI_PLATFORM

if HISI_SATA
config HISI_SATA_IOBASE
	hex "Hisi sata IO address"
	default "0x10030000" if ARCH_HI3536DV100
	default "0x11010000" if (ARCH_HI3521A || ARCH_HI3531A)
	help
	  hisilicon sata io base address.

config HISI_SATA_FBS
	int "Hisi sata FIS-Based switching"
	default 1
	range 0 1
	help
	  Hisatav200 supports FBS.
	  FBS is FIS-Based switching.
	  Choose y if you want to use it.

config HISI_SATA_NCQ
	int "Hisi sata Native Command Queuing"
	default 1
	range 0 1
	help
	  Hisatav200 supports NCQ.
	  NCQ is Native Command Queuing.
	  Choose y if you want to use it.

config HISI_ESATA
	bool "Support Hisi eSATA"
	default n
	help
	  Hisatav200 supports eSATA.
	  Choose y if you want to use it.

endif
```

## drivers/block/panicpart/Kconfig
```kconfig
config SUNXI_PANICPART
	bool "sunxi panic partition"
	select PSTORE
	select PSTORE_BLK
	select PSTORE_BLKOOPS
	help
	  This enable sunxi panic operations for blkoops.
	  If you want blkoops to record panic log, say Y, otherwise, say N.
```

## drivers/char/sunxi_dspo/Kconfig
```kconfig
config SUNXI_DSPO
	depends on (ARCH_SUNXI)
	tristate "sunxi DSPO driver"
	default n
	help
     Choose Y to enable sunxi DSPO(Display Stream Parallel Output) driver.
```

## drivers/char/sunxi_nna_galcore/Kconfig
```kconfig
config SUNXI_NNA_GALCORE
	depends on (ARCH_SUNXI)
	tristate "sunxi nna galcore driver"
	default n
	help
	 Choose Y to enable sunxi nna galcore driver
```

## drivers/char/sunxi_nna_vip/Kconfig
```kconfig
config SUNXI_NNA_VIP
	depends on (ARCH_SUNXI)
	tristate "sunxi nna vip driver"
	default n
	help
	 Choose Y to enable sunxi nna vip driver
```

## drivers/clk/goke/Kconfig
```kconfig
config COMMON_CLK_GK7205V200
	tristate "GK7205V200 Clock Driver"
	depends on ARCH_GK7205V200 || COMPILE_TEST
	select RESET_GOKE
	default ARCH_GOKE
	help
	  Build the clock driver for GK7205V200.

config COMMON_CLK_GK7205V300
	tristate "GK7205V300 Clock Driver"
	depends on ARCH_GK7205V300 || COMPILE_TEST
	select RESET_GOKE
	default ARCH_GOKE
	help
	  Build the clock driver for GK7205V300.

config COMMON_CLK_GK7202V300
	tristate "GK7202V300 Clock Driver"
	depends on ARCH_GK7202V300 || COMPILE_TEST
	select RESET_GOKE
	default ARCH_GOKE
	help
	  Build the clock driver for GK7202V300.

config COMMON_CLK_GK7605V100
	tristate "GK7605V100 Clock Driver"
	depends on ARCH_GK7605V100 || COMPILE_TEST
	select RESET_GOKE
	default ARCH_GOKE
	help
	  Build the clock driver for GK7605V100.

config RESET_GOKE
	bool "Goke Reset Controller Driver"
	depends on ARCH_GOKE || COMPILE_TEST
	select RESET_CONTROLLER
	help
	  Build reset controller driver for Goke device chipsets.
```

## drivers/clk/ingenic/Kconfig
```kconfig
config COMMON_CLK_INGENIC
	bool
	depends on MACH_XBURST || MACH_XBURST2
	select MFD_SYSCON
	select COMMON_CLK
	select INGENIC_CLK_DEBUG_FS

config INGENIC_CLK_DEBUG_FS
	bool
	depends on DEBUG_FS
	help
	  enable ingenic common clock debugfs


config CLK_X2000_V12
	bool
	depends on SOC_X2000_V12
	select COMMON_CLK_INGENIC
	help
	  build the ingenic x2000-v12 soc clock driver.

config CLK_T40
	bool
	depends on SOC_T40
	select COMMON_CLK_INGENIC
	help
	  build the ingenic t40 soc clock driver.
```

## drivers/clk/novatek/Kconfig
```kconfig
config COMMON_CLK_NA51089
	bool "Clock driver for Novatek NA51089"
	depends on NVT_IVOT_PLAT_NA51089

config COMMON_CLK_NA51068
	bool "Clock driver for Novatek NA51068"
	depends on NVT_IVOT_PLAT_NA51068 || NVT_IVOT_PLAT_NA51068_CA53

config COMMON_CLK_NA51055
	bool "Clock driver for Novatek NA51055"
	depends on NVT_IVOT_PLAT_NA51055
```

## drivers/clk/xmedia/Kconfig
```kconfig
config COMMON_CLK_XM72050200
	tristate "XM72050200 Clock Driver"
	depends on ARCH_XM72050200 || COMPILE_TEST
	select RESET_XMEDIA
	default ARCH_XMEDIA
	help
	  Build the clock driver for XM72050200.

config COMMON_CLK_XM72050300
	tristate "XM72050300 Clock Driver"
	depends on ARCH_XM72050300 || COMPILE_TEST
	select RESET_XMEDIA
	default ARCH_XMEDIA
	help
	  Build the clock driver for XM72050300.

config COMMON_CLK_XM72020300
	tristate "XM72020300 Clock Driver"
	depends on ARCH_XM72020300 || COMPILE_TEST
	select RESET_XMEDIA
	default ARCH_XMEDIA
	help
	  Build the clock driver for XM72020300.

config COMMON_CLK_XM76050100
	tristate "XM76050100 Clock Driver"
	depends on ARCH_XM76050100 || COMPILE_TEST
	select RESET_XMEDIA
	default ARCH_XMEDIA
	help
	  Build the clock driver for XM76050100.

config COMMON_CLK_XM72050500
	tristate "XM72050500 Clock Driver"
	depends on ARCH_XM72050500 || COMPILE_TEST
	select RESET_XMEDIA
	default ARCH_XMEDIA
	help
	  Build the clock driver for XM72050500.

config COMMON_CLK_XM720XXX
	tristate "XM72050500/XM72050510/XM72050530/XM72050230/XM72020330 Clock Driver"
	depends on ARCH_XM720XXX || COMPILE_TEST
	select RESET_XMEDIA
	default ARCH_XMEDIA
	help
	  Build the clock driver for XM72050500/XM72050510/XM72050530/XM72050230/XM72020330.

config RESET_XMEDIA
	bool "Xmedia Reset Controller Driver"
	depends on ARCH_XMEDIA || COMPILE_TEST
	select RESET_CONTROLLER
	help
	  Build reset controller driver for Xmedia device chipsets.
```

## drivers/cmem/Kconfig
```kconfig
config TI_CMEM
    config TI_CMEM
    tristate "TI Contiguous Memory Manager"
    select TI_CMEM_STUB
	help

    
```

## drivers/crypto/hisi-cipher/Kconfig
```kconfig
#
# Copyright (C) Hisilicon 2018
# License terms: GNU General Public License (GPL) version 2
#

menuconfig CRYPTO_DEV_HISILICON
    bool "Hisi Cipher Support"
    depends on CRYPTO_HW
    default n
    help
	  This driver interfaces with the hardware hisi cipher.Supporting
	  aes/des/des3 cipher algorithm(cbc/ecb/ofb/cfb/ctr/ccm/gcm mode avalible),
	  sah1/sha256/hmac1/hmac256, rng, rsa algorithm support.
	  To compile this driver as a module,
	  This select support:the module will be called hisi-cipher.
```

## drivers/crypto/hisi-otp/Kconfig
```kconfig
#
# Copyright (C) Hisilicon 2018
# License terms: GNU General Public License (GPL) version 2
#

menuconfig CRYPTO_DEV_HISI_OTP
    bool "Hisi Otp Support"
    depends on CRYPTO_HW
    default n
    help
	  This driver interfaces with the hardware hisi otp.Supporting
	  otp writekey and crc.
	  To compile this driver as a module,
	  This select support:the module will be called hisi-otp.
```

## drivers/crypto/nvt_ivot/Kconfig
```kconfig
config CRYPTO_DEV_NVT_IVOT_NA51055_CRYPTO
	tristate "Novatek NA51055 crypto hardware engine"
	depends on NVT_IVOT_PLAT_NA51055 && TEE=n && OPTEE=n
	select CRYPTO_AES
	select CRYPTO_DES
	select CRYPTO_CBC
	select CRYPTO_ECB
	select CRYPTO_CFB
	select CRYPTO_OFB
	select CRYPTO_CTR
	select CRYPTO_CCM
	select CRYPTO_GCM
	select CRYPTO_ALGAPI
	select CRYPTO_BLKCIPHER
	help
	  Novatek NA51055 processors have crypto engine accelerator.
	  Select this if you want to use the crypto engine for AES/DES/3DES
	  algorithms.

config CRYPTO_DEV_NVT_IVOT_NA51055_HASH
	tristate "Novatek NA51055 hash hardware engine"
	depends on NVT_IVOT_PLAT_NA51055 && TEE=n && OPTEE=n
	select CRYPTO_HASH
	select CRYPTO_SHA1
	select CRYPTO_SHA256
	select CRYPTO_HMAC
	help
	  Novatek NA51055 processors have hash engine accelerator.
	  Select this if you want to use the hash engine for SHA1/SHA256 algorithms.

config CRYPTO_DEV_NVT_IVOT_NA51055_RSA
	tristate "Novatek NA51055 rsa hardware engine"
	depends on NVT_IVOT_PLAT_NA51055 && TEE=n && OPTEE=n
	select CRYPTO_RSA
	help
	  Novatek NA51055 processors have rsa engine accelerator.
	  Select this if you want to use the rsa engine.

config CRYPTO_DEV_NVT_IVOT_NA51089_CRYPTO
	tristate "Novatek NA51089 crypto hardware engine"
	depends on NVT_IVOT_PLAT_NA51089 && TEE=n && OPTEE=n
	select CRYPTO_AES
	select CRYPTO_DES
	select CRYPTO_CBC
	select CRYPTO_ECB
	select CRYPTO_CFB
	select CRYPTO_OFB
	select CRYPTO_CTR
	select CRYPTO_CCM
	select CRYPTO_GCM
	select CRYPTO_ALGAPI
	select CRYPTO_BLKCIPHER
	help
	  Novatek NA51089 processors have crypto engine accelerator.
	  Select this if you want to use the crypto engine for AES/DES/3DES
	  algorithms.

config CRYPTO_DEV_NVT_IVOT_NA51089_HASH
	tristate "Novatek NA51089 hash hardware engine"
	depends on NVT_IVOT_PLAT_NA51089 && TEE=n && OPTEE=n
	select CRYPTO_HASH
	select CRYPTO_SHA1
	select CRYPTO_SHA256
	select CRYPTO_HMAC
	help
	  Novatek NA51089 processors have hash engine accelerator.
	  Select this if you want to use the hash engine for SHA1/SHA256 algorithms.

config CRYPTO_DEV_NVT_IVOT_NA51089_RSA
	tristate "Novatek NA51089 rsa hardware engine"
	depends on NVT_IVOT_PLAT_NA51089 && TEE=n && OPTEE=n
	select CRYPTO_RSA
	help
	  Novatek NA51089 processors have rsa engine accelerator.
	  Select this if you want to use the rsa engine.
```

## drivers/cryptodev-linux-master/Kconfig
```kconfig
config CRYPTODEV
tristate "Support cryptodev"
default n
help
	Support \dev\crypto
```

## drivers/dsp/Kconfig
```kconfig
# SPDX-License-Identifier: GPL-2.0-only

menuconfig DSP_DEBUG
	bool "Enable linux dsp debug drivers"

if DSP_DEBUG

config DSP_LOG_DEBUG
	tristate "Dsp log save in Linux"
	depends on DSP_DEBUG
	default n

endif
```

## drivers/fence/Kconfig
```kconfig
config XMEDIA_FENCE
	bool "Xmedia fence suppport"
	default y
	select SW_SYNC
	select SYNC_FILE
	help
	  Xmedia fence suppport
```

## drivers/gpu/trace/Kconfig
```kconfig
# SPDX-License-Identifier: GPL-2.0-only

config TRACE_GPU_MEM
	bool "trace GPU memory"
	default n
```

## drivers/hi_fence/Kconfig
```kconfig
config HISILICON_FENCE
	bool "Hisilicon fence suppport"
	default y
	select SW_SYNC
	select SYNC_FILE
	help
	  Hisilicon fence suppport
```

## drivers/hi_vdmav100/Kconfig
```kconfig
menuconfig HI_VDMA_V100
	tristate "Hisilicon VDMA Controller V100"
	depends on ARCH_HI3556AV100 || ARCH_HI3519AV100
	default n if ARCH_HI3556AV100 || ARCH_HI3519AV100
	help
	  This is the driver for hisilicon VDMA controoller
	  IP.

if HI_VDMA_V100

config HI_VDMA_CHN_NUM
	int "HI_VDMAV100 max channel number"
	default 32

config HI_VDMA_TRANSFER_THRESHOLD
        int "Hi VDMA data transfer threshold KBytes"
        range 4 16384
        default "128" if (ARCH_HI3556AV100 || ARCH_HI3519AV100)

config HI_VDMA_MISC_DEV
	bool "HI_VDMAV100 misc dev"
	default y if (ARCH_HI3556AV100 || ARCH_HI3519AV100)
	depends on HI_VDMA_V100


endif
```

## drivers/hidmac/Kconfig
```kconfig
#
# Sensor device configuration
#

config HI_DMAC
	tristate "Hisilicon DMAC Controller support"
	depends on (ARCH_HISI_BVT)
	help
	  The Direction Memory Access(DMA) is a high-speed data transfer
	  operation. It supports data read/write between peripherals and
	  memories without using the CPU.
	  Hisilicon DMA Controller(DMAC) directly transfers data between
	  a memory and a peripheral, between peripherals, or between memories.
	  This avoids the CPU intervention and reduces the interrupt handling
	  overhead of the CPU.

if HI_DMAC
config HI_DMAC_CHANNEL_NUM
	int "hi dmac channel num"
	default "4"
endif
```

## drivers/hiedmac/Kconfig
```kconfig
#
# Sensor device configuration
#

config HIEDMAC
	tristate "Hisilicon EDMAC Controller support"
	depends on (ARCH_HI3559AV100 || ARCH_HI3519AV100 || ARCH_HI3556AV100) || ((ARCH_HI3516CV500 || ARCH_HI3516DV300 || ARCH_HI3556V200 || ARCH_HI3559V200) && !HIEDMACV310) || ((ARCH_HI3516EV200 || ARCH_HI3516EV300 || ARCH_HI3518EV300 || ARCH_HI3516DV200) && !HIEDMACV310)
	help
	  The Direction Memory Access(EDMA) is a high-speed data transfer
	  operation. It supports data read/write between peripherals and
	  memories without using the CPU.
	  Hisilicon EDMA Controller(EDMAC) directly transfers data between
	  a memory and a peripheral, between peripherals, or between memories.
	  This avoids the CPU intervention and reduces the interrupt handling
	  overhead of the CPU.

if HIEDMAC

config HIEDMAC_CHANNEL_NUM
	int "hiedmac channel num"
	default "8"

endif
```

## drivers/iio/imu/inv_mpu9250/Kconfig
```kconfig
#
# inv-mpu9250 drivers for Invensense MPU devices and combos
#

config INV_MPU9250_IIO
	tristate
	select IIO_BUFFER
	select IIO_TRIGGERED_BUFFER

config INV_MPU9250_I2C
	tristate "Invensense MPU9250 devices (I2C)"
	depends on I2C_MUX
	select INV_MPU9250_IIO
	select REGMAP_I2C
	help
	  This driver supports the Invensense MPU9250 motion tracking
	  devices over I2C.
	  This driver can be built as a module. The module will be called
	  inv-mpu9250-i2c.

config INV_MPU9250_SPI
	tristate "Invensense MPU9250 devices (SPI)"
	depends on SPI_MASTER
	select INV_MPU9250_IIO
	select REGMAP_SPI
	help
	  This driver supports the Invensense MPU9250 motion tracking
	  devices over SPI.
	  This driver can be built as a module. The module will be called
	  inv-mpu9250-spi.
```

## drivers/input/misc/sunxi-wiegand/Kconfig
```kconfig
config SUNXI_WIEGAND
	tristate "allwinnertech Wiegand driver"
	default n
	help
	Choose Y to enable wiegand driver
```

## drivers/input/sensor/da380/Kconfig
```kconfig
#
# I2C gsensor chip drivers configuration
#

config SENSORS_DA380
	tristate "DA380 acceleration sensor support"
	depends on I2C
	select INPUT_POLLDEV
	default m
	help
	  If you say yes here you get support for Bosch Sensortec's
	  acceleration sensors DA380.
config DA280
	bool "DA280"
	depends on SENSORS_DA380
	default n
```
