## drivers/sstar/usb/gadget/udc/usb20/Kconfig
```kconfig
config USB_GADGET_SSTAR_DEVICE
        tristate "Sstar USB 2.0 Device Controller"
        help
                Sstar USB device

config USB_AVOID_SHORT_PACKET_IN_BULK_OUT_WITH_DMA_FOR_ETHERNET
        bool "Avoid short packet in bulk out with DMA for ethernet"
        depends on USB_GADGET_SSTAR_DEVICE

config USB_DEBUG_MESSAGE
        bool "Enable debug messages"
        depends on USB_GADGET_SSTAR_DEVICE

config USB_FPGA_VERIFICATION
        bool "FPGA verification only"
        depends on USB_GADGET_SSTAR_DEVICE

config USB_CHARGER_DETECT
        bool "Charger detection"
        depends on USB_GADGET_SSTAR_DEVICE
        #default y
config USB_ENABLE_UPLL
        bool "Enable clock for controller"
        depends on USB_GADGET_SSTAR_DEVICE
```

## drivers/sstar/usb/host/Kconfig
```kconfig
menuconfig EHCI_SSTAR_PATCH
	bool "SigmaStar EHCI HCD(USB 2.0) patch"
	depends on USB_EHCI_HCD && ARCH_SSTAR
	default y

if EHCI_SSTAR_PATCH

config EHCI_SSTAR_HANDSHAKE_CHIRP_PATCH
	bool "Patch to adjust judging handshake chirp K signal by disconnect current"
	default y

config EHCI_SSTAR_RESET_LOCK_PATCH
	bool "Patch for locking host controller registers accessing when utmi reset"
	default y

endif # EHCI_SSTAR_PATCH
```

## drivers/sstar/usb/phy/Kconfig
```kconfig
config SS_USB3_PHY
tristate "Sigmastar USB3 PHY Driver"

select GENERIC_PHY
select USB_PHY
	help
	  Enable this to support Sigmastar USB3.0 PHY driver for Sigmastar
	  SoC. This driver will do the PHY initialization and shutdown.
	  The PHY driver will be used by Sigmastar USB3.0 driver.

	  To compile this driver as a module, choose M here.

config SS_USB2_PHY
tristate "Sigmastar USB2 UTMI Transceiver Driver"

select GENERIC_PHY
select USB_PHY
select REGMAP
select MFD_SYSCON
	help
	  Enable this to support Sigmastar USB2.0 UTMI Transceiver driver
	  for Sigmastar SoC. This driver will do the UTMI initialization and
	  shutdown.The UTMI driver will be used by Sigmastar USB2.0 driver.

	  To compile this driver as a module, choose M here.
```

## drivers/sstar/voltage/Kconfig
```kconfig
config SS_VOLTAGE_CTRL
    bool "SStar Voltage Control"
    depends on MS_GPIO && !ARCH_INFINITY2
    default y

config SS_VOLTAGE_CTRL_WITH_OSC
    bool "SStar Voltage Control With OSC"
    depends on ARCH_INFINITY6C && SS_VOLTAGE_CTRL
    default n
```

## drivers/sstar/voltage_idac/Kconfig
```kconfig
config SS_VOLTAGE_IDAC_CTRL
    bool "SStar Voltage IDAC Control"
    depends on MS_GPIO && !SS_VOLTAGE_CTRL
    default y
```

## drivers/sstar/xor_dma/Kconfig
```kconfig
config XOR_DMA
    tristate "sstar xor_dma driver"
    select DMADEVICES
    select DMA_ENGINE
    select DMA_VIRTUAL_CHANNELS
    select DMA_ENGINE_RAID
    select ASYNC_TX_DMA
    select ASYNC_TX_ENABLE_CHANNEL_SWITCH
    select ASYNC_CORE
    select ASYNC_XOR
    select ASYNC_MEMCPY
    help
      Enable support for the SSTAR SoC DMA controller.
      Say Y here if you enabled BDMA, otherwise say N.
```

## drivers/usb/gadget/udc/msb250x/Kconfig
```kconfig
config USB_GADGET_MSB250X
        tristate "MSB250X USB Device Controller"
        help
                Mstar USB device

config USB_MSB250X
        tristate
        depends on USB_GADGET_MSB250X
        default USB_GADGET
        select USB_GADGET_SELECTED

config USB_MSB250X_BULK_OUT_WITHOUT_DMA
        boolean "Bulk out without DMA for MSB250x udc"

config USB_MSB250X_DEBUG
        boolean "MSB250X udc debug messages"
        depends on USB_GADGET_MSB250X

config USB_MSB250X_PROC
        boolean "MSB250X udc proc system"
        depends on USB_GADGET_MSB250X && PROC_FS

config USB_MSB250X_FPGA
        boolean "MSB250X udc FPGA verification only"
        depends on USB_GADGET_MSB250X

config USB_CHARGER_DETECT
        boolean "MSB250X udc charger detection"
        depends on USB_GADGET_MSB250X
        #default y
```

## drivers/usb/host/fh_otg/fh_otg/Kconfig
```kconfig
config FH_HOST_ONLY
	bool "Host only mode"
	default y
	depends on USB_FH_OTG
	help
		The USB2.0 high-speed host controller
		integrated into many SoCs.

config FH_DEVICE_ONLY
	bool "Device only mode"
	depends on USB_FH_OTG
	help
		The USB2.0 high-speed gadget controller
		integrated into many SoCs.
```

## drivers/usb/nvtusb/Kconfig
```kconfig
#
# USB Monitor configuration
#

config USB_NVTUSB
	tristate "NVT USB Test program V2"
	default n
	help
	  NOVATEK USB test program. V2.0

	  If unsure, say Y, if allowed, otherwise M.
```

## drivers/video/fbdev/ingenic/fb_v10/displays/Kconfig
```kconfig
menuconfig FB_INGENIC_DISPLAYS_X1000
	tristate "Supported lcd panels"
	depends on FB_INGENIC_X1000
	select BACKLIGHT_LCD_SUPPORT
	select LCD_CLASS_DEVICE
	select BACKLIGHT_CLASS_DEVICE


config PANEL_X1000_TRULY_TFT240240_2_E
	tristate "lcd panel truly tft240240"
	depends on FB_INGENIC_DISPLAYS_X1000
	help
		lcd panel truly tft240240, for ingenicfb drivers.
```

## drivers/video/fbdev/ingenic/fb_v11/Kconfig
```kconfig
menuconfig FB_INGENIC_X2000
	tristate "Ingenic Framebuffer Driver for Version 11"
	depends on FB_INGENIC
	select FB_INGENIC_DISPLAYS_X2000
	help
		LCD Driver for X2000

source "drivers/video/fbdev/ingenic/fb_v11/displays/Kconfig"
```

## drivers/video/ingenic_i2d/Kconfig
```kconfig
menuconfig JZ_I2D
    bool "JZ I2D Driver"
    default y
    help
        Support for Ingenic i2d Driver

config INGENIC_I2D
	bool "Ingenic I2D Driver"
    depends on JZ_I2D
    default y
	help
	  Support for Ingenic i2d  operations.
```

## drivers/video/ingenic_ipu/Kconfig
```kconfig
menuconfig JZ_IPU
	bool "JZ IPU Driver"
	default y
	help
	  Support for Ingenic dmmu operations.

config INGENIC_IPU_V13
	bool "IPU V13 Driver"
	depends on JZ_IPU
	default y
	help
	  Support for Ingenic ipu v13 operations.
```

## drivers/xmedia/Kconfig
```kconfig
menu "Xmedia driver support"

config TIMER_XMEDIA_SP804
	bool "Support for xmedia SP804 module"
	depends on GENERIC_SCHED_CLOCK && CLKDEV_LOOKUP && (ARCH_XM72050500 || ARCH_XM720XXX)
	select CLKSRC_MMIO
	select CLKSRC_OF if OF

source "drivers/xmedia/cma/Kconfig"
endmenu
```

## fs/lwfs/Kconfig
```kconfig
config LWFS_FS
	tristate "Lightweight file system support"
	depends on MTD
	help
	  This is a very small read-only file system that prioritizes read
	  performance

	  To compile this file system support as a module, choose M here: the
	  module will be called lwfs.  Note that the file system of your
	  root partition (the one containing the directory /) cannot be a
	  module.

	  If you don't know whether you need it, then you don't need it:
	  answer N.

#
# Select the backing stores to be supported
#
choice
	prompt "LwFS backing stores"
	depends on LWFS_FS
	default LWFS_BACKED_BY_MTD
	help
	  Select the backing stores to be supported.

config LWFS_BACKED_BY_BLOCK
	bool "Block device-backed Lightweight file system support"
	depends on BLOCK
	help
	  This permits LWFS to use block devices buffered through the page
	  cache as the medium from which to retrieve data.  It does not allow
	  direct mapping of the medium.

	  If unsure, answer Y.

config LWFS_BACKED_BY_MTD
	bool "MTD-backed Lightweight file system support"
	depends on MTD=y || (LWFS_FS=m && MTD)
	help
	  This permits LWFS to use MTD based devices directly, without the
	  intercession of the block layer (which may have been disabled).  It
	  also allows direct mapping of MTD devices through lwfs files under
	  NOMMU conditions if the underlying device is directly addressable by
	  the CPU.

	  If unsure, answer Y.

config LWFS_BACKED_BY_BOTH
	bool "Both the above"
	depends on BLOCK && (MTD=y || (LWFS_FS=m && MTD))
endchoice


config LWFS_ON_BLOCK
	bool
	default y if LWFS_BACKED_BY_BLOCK || LWFS_BACKED_BY_BOTH

config LWFS_ON_MTD
	bool
	default y if LWFS_BACKED_BY_MTD || LWFS_BACKED_BY_BOTH
```

## lotus/Kconfig
```kconfig
menu "Lotus Support"

source "lotus/machine/Kconfig"

source "lotus/scripts/Kconfig"

menu "Lotus Device Drivers"
source "lotus/drivers/Kconfig"
endmenu

source "lotus/fs/Kconfig"

source "lotus/self-test/Kconfig"

endmenu
```

## lotus/drivers/Kconfig
```kconfig
source "lotus/drivers/clk/Kconfig"
source "lotus/drivers/clocksource/Kconfig"
source "lotus/drivers/power/Kconfig"
source "lotus/drivers/net/Kconfig"
source "lotus/drivers/mtd/Kconfig"
source "lotus/drivers/mfd/Kconfig"
source "lotus/drivers/i2c/Kconfig"
source "lotus/drivers/pwm/Kconfig"
source "lotus/drivers/spi/Kconfig"
source "lotus/drivers/mmc/Kconfig"
source "lotus/drivers/usb/Kconfig"
source "lotus/drivers/dma/Kconfig"
source "lotus/drivers/rtc/Kconfig"
```

## lotus/drivers/clk/Kconfig
```kconfig
menu "Clock & Reset"

config COMMON_CLK_XMFALCON
	tristate "XMFALCON Clock Driver"
	depends on ARCH_XMFALCON || COMPILE_TEST
	select RESET_LOTUS
	default ARCH_LOTUS
	help
	  Build the clock driver for XMFALCON.

config COMMON_CLK_XMORCA
	tristate "XMORCA Clock Driver"
	depends on ARCH_XMORCA || COMPILE_TEST
	select RESET_LOTUS
	default ARCH_LOTUS
	help
	  Build the clock driver for XMORCA.

config RESET_LOTUS
	bool "Reset Controller Driver"
	depends on ARCH_LOTUS || COMPILE_TEST
	select RESET_CONTROLLER
	help
	  Build reset controller driver for Lotus device chipsets.

endmenu
```

## lotus/drivers/clocksource/Kconfig
```kconfig
config TIMER_LOTUS_SP804
	bool "Support for Lotus SP804 Timer"
	depends on GENERIC_SCHED_CLOCK && CLKDEV_LOOKUP && (ARCH_XMFALCON || ARCH_XMORCA)
	select CLKSRC_MMIO
	select CLKSRC_OF if OF
```

## lotus/drivers/dma/Kconfig
```kconfig
config EDMAC
        tristate "Lotus EDMAC Controller support"
        depends on ARCH_XMFALCON  || ARCH_XMORCA
        select DMA_ENGINE
        select DMA_VIRTUAL_CHANNELS
        help
          The Direction Memory Access(EDMA) is a high-speed data transfer
          operation. It supports data read/write between peripherals and
          memories without using the CPU.
          Lotus EDMA Controller(EDMAC) directly transfers data between
          a memory and a peripheral, or between memories.
          This avoids the CPU intervention and reduces the interrupt handling
          overhead of the CPU.
```

## lotus/drivers/i2c/busses/Kconfig
```kconfig
config I2C_LOTUS
        tristate "Lotus IPC I2C Controller"
        depends on ARCH_LOTUS
        help
          Say Y here to include support for Lotus IPC I2C controller in the
          Lotus IPC SoCs.

          This driver can also be built as a module.  If so, the module
          will be called i2c-lotus.

config DMA_MSG_MIN_LEN
        int "Lotus I2C support DMA minimum LEN"
        depends on I2C_LOTUS
        range 1 4090
        default 5
        help
                The i2c_msg minimum LEN of i2c support DMA,range from 1 to 4091

config DMA_MSG_MAX_LEN
        int "Lotus I2C support DMA maximum LEN"
        depends on I2C_LOTUS
        range DMA_MSG_MIN_LEN 4090
        default 4090
        help
                The i2c_msg maximum LEN of i2c support DMA,range from i2c_msg minimum LEN to 4090,
                because DMA for 0xFFC one-time  largest data transfers;
```
