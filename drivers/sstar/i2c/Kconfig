## drivers/sstar/i2c/Kconfig
```kconfig
config MS_I2C
    tristate "Sstar I2C driver"
    help
        Sstar I2C driver function
```

## drivers/sstar/ir/Kconfig
```kconfig
config MS_IR

tristate "SStar IR driver"
    default n
    select INPUT
    select RC_CORE
    help
      enable support for IR driver
```

## drivers/sstar/isrcb/Kconfig
```kconfig
#config MS_ISRCB
#    bool "Mstar ISRCB driver"
#    help
#        MStar ISRCB driver function

config SS_ISP_ISRCB
    tristate "ISRCB driver support"
```

## drivers/sstar/keypad/Kconfig
```kconfig
config SS_KEYPAD
    tristate "Sstar Keypad driver"
    default n
    help
        Sstar KEYPAD driver function
```

## drivers/sstar/miu/Kconfig
```kconfig
menuconfig MSTAR_MIU

tristate "MSTAR MIU"

help
    MStar miu driver
default n

if MSTAR_MIU
choice
    prompt "Bandwidth measurement"
    default MIU_BW_TO_KMSG
config MIU_BW_TO_KMSG
    bool "show bandwidth report to kernel message"
config MIU_BW_TO_SYSFS
    bool "show bandwidth report to sysfs buffer"
config MIU_BW_TO_KMSG_OR_SYSFS
    bool "run-time config bandwidth report to kmsg or sysfs"
endchoice

config MSYS_MIU_PROTECT
	bool "sysfs:MSYS MIU protect"
	default n

config MIU_PROTECT_SYSFS
	bool "sysfs:MIU protect"
	default n

config MIU_SUPPORT_SYNOPSYS
	bool "Support Synopsys miu-control"
	default n

config MIU_RWCLIENT
	bool "Support read/write client ID"
	default n

config MIU_ARBITRATION
	bool "Support arbitration adjustment"
	default n

config MIU_FLOWCTRL
	bool "Support arb flow control"
	depends on MIU_ARBITRATION && MIU_RWCLIENT
	default n

config MSYS_MIU_UT
    bool "sysfs:MIU ut"
    default n

config TEST_ALL_LINUX_MMU_MAP
	bool "Test: sstar_mmu map linux to over 4Gb"
	default n

config TEST_ALL_LINUX_MMU_MAP_ADDRESS
	hex "linux sstar_mmu map address(VPA)"
	depends on TEST_ALL_LINUX_MMU_MAP
	default 0xF00000000

config TEST_ALL_LINUX_MMU_PAGE_SIZE
	int "linux sstar_mmu map page size (unit KB)"
	depends on TEST_ALL_LINUX_MMU_MAP
	default 1024

config TEST_ALL_LINUX_MMU_ENTRY_COUNT
	int "linux sstar_mmu map entry count"
	depends on TEST_ALL_LINUX_MMU_MAP
	default 4096

endif #MSTAR_MIU
```

## drivers/sstar/miu/ut/Kconfig
```kconfig
config MSTAR_MIU

if MSTAR_MIU
config MSYS_MIU_UT
    bool "sysfs:MIU ut"
    default n
endif
```

## drivers/sstar/mspi/Kconfig
```kconfig
config SS_MSPI
    tristate "SStar MSPI driver"
    default n
    help
    Enable support for SPI master driver
```

## drivers/sstar/msys/Kconfig
```kconfig
config MS_MSYS
    bool "msys api"
    default y

config MS_ZEN
    bool
    depends on MS_MSYS
    default y

config MS_MSYS_LOG
    bool "Log Redirection"
    depends on MS_MSYS
    default n

config MSYS_PERF_TEST
    bool "sysfs:perf test"
    depends on MS_MSYS
    default n

config MSYS_BENCH_MEMORY_FUNC
    bool "ioctl:bench memory function"
    depends on MS_MSYS
    default n

config MSYS_MIU_PROTECT
    bool "sysfs:MIU protest"
    depends on MS_MSYS
    default n

config MSYS_DMEM_SYSFS_ALL
    bool "add more dmem sysfs node"
    depends on MS_MSYS
    default n

config MSYS_DMA_SYSFS
    bool "add dma sysfs node"
    depends on MS_MSYS
    default n

config MSYS_DDR_SELFREFRESH_REBOOT
    bool "test for reboot with DDR selfrefresh"
    depends on MS_MSYS
    default n

config MSYS_PADMUX
    bool "support padmux modify and verify"
    depends on MS_MSYS
    default n

config MSYS_GPIO
    bool "support GPIO pull and driving modify"
    depends on MS_MSYS
    default n

config SS_PROFILING_TIME
        bool "Record timestamp in sram"
        default y

config SSTAR_IRQ_DEBUG_TRACE
        bool "IRQ debug trace"
        help
          To measure and record the irq time cost
        default n
```

## drivers/sstar/nandflash/Kconfig
```kconfig
config SS_NAND_ONEBIN
    select MTD_NAND
    tristate "NAND_ONEBIN Flash driver"
    default n
```

## drivers/sstar/netphy/Kconfig
```kconfig
config SSTAR_NETPHY
    bool
    default y
    ---help---
        Currently supports the SSTAR ALBANY(10/100)
```

## drivers/sstar/pcie/Kconfig
```kconfig
menu "Sigmastar PCIe Support"

config SSTAR_PCIEIF
	bool

config SSTAR_PCIE
	bool

config SSTAR_PCIE_HOST
	bool "Sigmastar PCIe Controller - Host mode"
	select PCI
	select PCI_MSI
	select PCI_MSI_IRQ_DOMAIN
	select PCIE_DW_HOST
	select SSTAR_PCIE
	select SSTAR_PCIEIF
	help
	  Sigmastar PCIe controller can work either as EP or RC.
	  Please select PCIE_SS_PLAT_HOST to enable RC features.
	  This uses the DesignWare core.

config SSTAR_PCIE_EP
	bool "Sigmastar PCIe Controller - Endpoint mode"
	select PCI
	select PCI_MSI
	select PCI_MSI_IRQ_DOMAIN
	select PCI_ENDPOINT
	select PCIE_DW_EP
	select SSTAR_PCIE
	select SSTAR_PCIEIF
	help
	  Sigmastar PCIe controller can work either as EP or RC.
	  Please select PCIE_SS_PLAT_EP to enable EP features.
	  This uses the DesignWare core.

config SSTAR_EDMA
	tristate "Sigmastar eDMA Controller driver"
	depends on SSTAR_PCIE
	select SSTAR_PCIEIF
	help
	  Support the Sigmastar eDMA controller.

menu "Sigmastar PCIe Verify"
config SSTAR_FPGA_LPBK
	bool "Sigmastar FPGA loopback mode"
	depends on SSTAR_PCIE_HOST && SSTAR_PCIE_EP
	help
	  Support loopback mode for FPGA verification.

config SSTAR_PCI_ENDPOINT_TEST
	depends on SSTAR_PCIE_HOST
	depends on !PCI_ENDPOINT_TEST
	select CRC32
	tristate "Sigmastar Test Endpoint driver"
	help
	  Enable the RC side test driver for PCI Endpoint.

config SSTAR_PCI_EPF_TEST
	tristate "Sigmastar Endpoint Function Test driver"
	depends on SSTAR_PCIE_EP
	depends on !PCI_EPF_TEST
	select CRC32
	help
	   Enable the test Endpoint Function driver for PCI Endpoint.

config SSTAR_PCIE_BENCH
	tristate "Sigmastar PCIE Bench SelfLoopback"
	depends on SSTAR_PCIE
	help
	   Build KO for PCIE Behch verification
endmenu

endmenu
```

## drivers/sstar/proxyfs/Kconfig
```kconfig
config SS_PROXYFS
    tristate "SStar Proxyfs Server"
    depends on SS_DUALOS
    default n
```

## drivers/sstar/pwm/Kconfig
```kconfig
config MS_PWM
    tristate "SSTAR_PWM"
    select PWM
    help
       Say Y here to enable the driver for the PWM.

       If unsure, say Y.

       To compile this driver as a module, choose M here: the
       module will be called mdrv_ts.

config PWM_NEW
    bool "Support NEW PWM configuration"
    depends on MS_PWM
    default y
    help
      Support NEW PWM configuration
```

## drivers/sstar/rpmsg/Kconfig
```kconfig
config SSTAR_DUALOS_DRIVER
        bool "SSTAR RPMSG-based dualos driver"
        default n

config SSTAR_CA7_VIRTIO
	bool "SSTAR ca7 virtio driver"
	default n
	select RPMSG
	select RPMSG_VIRTIO
	select SSTAR_RPMSG
	depends on ENABLE_CA7
	help
	  Say y here to enable I7 CA7 virtio device driver

config SSTAR_RPMSG
	def_bool n
```

## drivers/sstar/rtc/Kconfig
```kconfig
config RTCPWC_INNER
    select RTC_CLASS
    tristate "SStar RTCWC driver"
    default n

config RTCPWC_SW_RST_OFF
    bool "SStar RTCPWC driver no SW-reset on Set-Base-Time"
    depends on RTCPWC_INNER
    default y

config RTCPWC_INNER_EHHE
    bool "SStar RTCPWC driver Error Handle on Hw Exception"
    depends on RTCPWC_INNER
    default y

config RTC_WITH_PWC
    bool "SStar RTC with power controller"
    depends on RTCPWC_INNER
    default n
```

## drivers/sstar/sar_key/Kconfig
```kconfig
config MS_SARKEY
        tristate "sar key driver"
        help
          Say Y here to enable the driver for the sar key.

          If unsure, say Y.

          To compile this driver as a module, choose M here: the
          module will be called mdrv_sar.
```

## drivers/sstar/sata_host/Kconfig
```kconfig
config SS_SATA_HOST
    tristate "SStar SATA HOST"
    help
        SStar SATA Host driver function

menu "Support Linux Ahci Platfrom Driver"
    depends on SS_SATA_HOST
config SS_SATA_AHCI_PLATFORM_HOST
    tristate "SSTAR SATA AHCI PLATFORM"
    default y
        help
          Sstar sata driver supports linux ahci platform driver
endmenu

menu "Select Sata Host Port"
    depends on SS_SATA_HOST
config SATA_HOST_0
    tristate "SStar SATA HOST Port 0"
    default n
        help
          Sstar sata host port number selection

config SATA_HOST_1
    depends on ARCH_INFINITY7 || ARCH_MERCURY6P
    tristate "SStar SATA HOST Port 1"
    default n
        help
          Sstar sata host port number selection
endmenu

menu "Sata Host Bringup Program"
    depends on SS_SATA_HOST
config SS_SATA_BRING_UP
    tristate "Sstar sata host bringup"
    default n
        help
          Sstar sata host bringup
endmenu


menu "Sata Host Apply Hd Link"
    depends on SS_SATA_HOST
config SSTAR_APPLY_HD_LINK
    tristate "Sstar sata apply hd link"
    default y
        help
          Sstar sata apply hd link
endmenu
```

## drivers/sstar/sdmmc/Kconfig
```kconfig
config MS_SDMMC
        tristate "SStar SD/MMC Card Interface Support"
        depends on MMC
        default n
  help
        Enable SD/MMC Driver Support for SStar Product

config SUPPORT_SD30
        bool "Support SD30"
        depends on MS_SDMMC
        default n

config SUPPORT_UT_VERIFY
        bool "Support SD UT verify"
        depends on MS_SDMMC
        default n
```

## drivers/sstar/swtoe/Kconfig
```kconfig
config SS_SWTOE
select NET
select NET_ETHERNET
select MII
select PACKET
select USE_POLICY_FWD
select INET
select NETDEVICES
select MS_EMAC_TOE

tristate "SWTOE"
default n

help
Enable compilation option for driver SSTAR SW TOE
```

## drivers/sstar/sysdesc/Kconfig
```kconfig
config SYSDESC
    tristate "Sstar SYSDESC driver"
    default n

config SYSDESC_NAME
	string "SYSDESC source file"
	depends on SYSDESC
```

## drivers/sstar/usb/Kconfig
```kconfig
config MS_USB_OLD_PLATFORM
    tristate "USB support for platform"
    depends on CONFIG_USB_SUPPORT
menuconfig SSTAR_USB_SUPPORT
    bool "SStar USB support"
    depends on USB_SUPPORT
if (SSTAR_USB_SUPPORT)
source "drivers/sstar/usb/dwc3/Kconfig"
source "drivers/sstar/usb/phy/Kconfig"
source "drivers/sstar/usb/host/Kconfig"
endif
```

## drivers/sstar/usb/dwc3/Kconfig
```kconfig
config SSTAR_USB_DWC3_OF_SIMPLE
        tristate "Simple Glue Layer Of SStar For DWC3"
        depends on OF && COMMON_CLK && USB_DWC3
        select MFD_SYSCON
        help
          Support USB3 functionality in simple SoC integrations.
          Currently supports SStar DWC USB3 IP.
          Say 'Y' or 'M' if you have one such device.
```

## drivers/sstar/usb/gadget/function/Kconfig
```kconfig
if ARCH_SSTAR

config USB_GADGET_SSTAR_FUNCTION
	bool
	default y if ARCH_SSTAR

config USB_U_SSTAR_AUDIO
	tristate

config USB_F_SSTAR_UAC1
	tristate

config USB_F_SSTAR_UVC
	tristate

config USB_F_SSTAR_DFU
	tristate

config USB_CONFIGFS_F_SSTAR_UAC1
	bool "Audio Class 1.0"
	depends on USB_CONFIGFS
	depends on SND
	select USB_LIBCOMPOSITE
	select SND_PCM
	select USB_U_SSTAR_AUDIO
	select USB_F_SSTAR_UAC1
	help
	  This Audio function implements 1 AudioControl interface,
	  1 AudioStreaming Interface each for USB-OUT and USB-IN.
	  This driver doesn't expect any real Audio codec to be present
	  on the device - the audio streams are simply sinked to and
	  sourced from a virtual ALSA sound card created. The user-space
	  application may choose to do whatever it wants with the data
	  received from the USB Host and choose to provide whatever it
	  wants as audio data to the USB Host.

config USB_CONFIGFS_F_SSTAR_UAC2
	bool "Audio Class 2.0"
	depends on USB_CONFIGFS
	depends on SND
	select USB_LIBCOMPOSITE
	select SND_PCM
	select USB_U_SSTAR_AUDIO
	select USB_F_UAC2
	help
	  This Audio function is compatible with USB Audio Class
	  specification 2.0. It implements 1 AudioControl interface,
	  1 AudioStreaming Interface each for USB-OUT and USB-IN.
	  This driver doesn't expect any real Audio codec to be present
	  on the device - the audio streams are simply sinked to and
	  sourced from a virtual ALSA sound card created. The user-space
	  application may choose to do whatever it wants with the data
	  received from the USB Host and choose to provide whatever it
	  wants as audio data to the USB Host.

config USB_CONFIGFS_F_SSTAR_UVC
	bool "USB Webcam function"
	depends on USB_CONFIGFS
	depends on VIDEO_V4L2
	depends on VIDEO_DEV
	select VIDEOBUF2_VMALLOC
	select USB_F_SSTAR_UVC
	help
	  The Webcam function acts as a composite USB Audio and Video Class
	  device. It provides a userspace API to process UVC control requests
	  and stream video data to the host.

config UVC_STREAM_ERR_SUPPORT
	bool "Set UVC_STREAM_ERR bit in header to indicate an error frame"
	depends on USB_CONFIGFS_F_SSTAR_UVC
	default n
	help
	  If udc controller reports NOSNR (Out of streams resources) error, it means
	  there are data lost during frame data transmission.
	  Indicate host that the sending frame might be corrupted and should be drop by
	  set UVC_STREAM_ERR bit in payload header.

config UVC_VER150_SUPPORT
	bool "UVC 1.5 Support"
	depends on USB_CONFIGFS_F_SSTAR_UVC
	default n
	help
	  Support uvc 1.5 for sstar uvc

config USB_CONFIGFS_F_SSTAR_DFU
	bool "DFU function"
	depends on USB_CONFIGFS
	select USB_F_SSTAR_DFU
	help
	  The DFU function driver enables the Device Firmware
	  Upgrade(DFU) mode for the platform USB device.

endif
```

## drivers/sstar/usb/gadget/legacy/Kconfig
```kconfig
if ARCH_SSTAR

config USB_GADGET_SSTAR_LEGACY
	bool
	default y if ARCH_SSTAR

config USB_G_SSTAR_GADGET
	tristate "USB SigmaStar Gadget"
	select USB_LIBCOMPOSITE
	help
		SigmaStar Gadget Configuration

config USB_SSTAR_UVC
	bool "Include configuration with UVC (Video)"
	depends on USB_G_SSTAR_GADGET && VIDEO_V4L2
	select VIDEOBUF2_VMALLOC
	select VIDEOBUF2_DMA_SG
	select USB_F_SSTAR_UVC
	help
		external uvc function for sstar_gadget

config MULTI_STREAM_FUNC_NUM
	int "Multi Stream Under One Function"
	depends on USB_SSTAR_UVC
	default 1
	help
	  Support Multi Stream Under One Function

config UVC_STREAM_ERR_SUPPORT
	bool "Set UVC_STREAM_ERR bit in header to indicate an error frame"
	depends on USB_SSTAR_UVC
	default n
	help
	  If udc controller reports NOSNR (Out of streams resources) error, it means
	  there are data lost during frame data transmission.
	  Indicate host that the sending frame might be corrupted and should be drop by
	  set UVC_STREAM_ERR bit in payload header.

config UVC_VER150_SUPPORT
	bool "UVC 1.5 Support"
	depends on USB_SSTAR_UVC
	default n
	help
	  Support uvc 1.5 for sstar_gadget uvc

config WINDOWS_HELLO_SUPPORT
	bool "Windows Hello Support"
	depends on USB_SSTAR_UVC
	default n
	help
	  Support windows hello for sstar_gadget uvc

config USB_SSTAR_UAC1
	bool "Include configuration with UAC (Audio)"
	depends on USB_G_SSTAR_GADGET && SND
	select SND_PCM
	select USB_F_SSTAR_UAC1
	select USB_U_SSTAR_AUDIO
	help
	  external uac1 function for sstar_gadget

config USB_SSTAR_RNDIS
	bool "Include configuration with RNDIS"
	depends on USB_G_SSTAR_GADGET && NET
	select USB_U_ETHER
	select USB_F_RNDIS
	select CRC32
	help
	  external rndis function for sstar_gadget

config USB_SSTAR_DFU
	bool "Include configuration with (DFU)"
	depends on USB_G_SSTAR_GADGET
	select USB_F_SSTAR_DFU
	help
		external dfu function for sstar_gadget

endif
```
