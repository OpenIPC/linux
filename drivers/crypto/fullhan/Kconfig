## drivers/net/ethernet/anyka-gmac/Kconfig
```kconfig
config AK_GMAC
	tristate "Anyka EV200/EV300/EV330 Synopsys GMAC Ethernet"
	depends on ARCH_AK && OF
	depends on MACH_AK39EV330 || MACH_AK3918EV200
	select CRC32
	help
	  The Synopsys GMAC in the AK3918EV200, AK3918EV300 and AK39EV330
	  parts (anyka,ak39ev330-ethernet), from the Cloud39EV300 SDK's
	  driver. The MAC interface comes from the device tree's phy-mode,
	  RMII unless "mii" is given. The module is ak_gmac.

	  The first AK39 generation's older MAC is AK_ETHERNET instead.
```

## drivers/pinctrl/axera/Kconfig
```kconfig
# SPDX-License-Identifier: GPL-2.0-only

config PINCTRL_AXERA
	bool "AXERA pinctrl driver"
	depends on OF && HAS_IOMEM
	depends on ARCH_AXERA || COMPILE_TEST
	select PINMUX
	select PINCONF
	select GENERIC_PINCONF
	select GENERIC_PINCTRL_GROUPS
	select GENERIC_PINMUX_FUNCTIONS
	select MFD_SYSCON
	select RESET_CONTROLLER
	help
	  This enables the Axera pin controller core.

config PINCTRL_AX620E
	bool "AX620E pinctrl driver"
	depends on PINCTRL_AXERA
	default ARCH_AXERA
	help
	  This enables the Axera AX620E / AX630C pin controller.
```

## drivers/soc/anyka/Kconfig
```kconfig
# SPDX-License-Identifier: GPL-2.0-only
# 
menu "Anyka SoC drivers"

config ANYKA_SOCINFO
	bool "Anyka SoC Information driver"
	select SOC_BUS
	help
	  Say yes to support decoding of Anyka SoC family
	  information about the type and version.

endmenu
```

## drivers/soc/axera/Kconfig
```kconfig
# SPDX-License-Identifier: GPL-2.0-only

config AXERA_VPU
	bool "Axera VPU clock, reset, and frequency"
	depends on ARCH_AXERA
	select PM_OPP
	default y
	help
	  Turn on the AX630C Hantro VENC, JENC, and VDEC clocks and resets
	  and switch their muxes across the vendor OPP rates.
	  The vendor command-queue driver is not in the public SDK.
```

## drivers/soc/fullhan/Kconfig
```kconfig
config FH8626_ARC_ISOLATION
	tristate "Fullhan FH8626 ARC Companion Core Isolation Driver"
	depends on ARCH_FULLHAN
	help
	  Isolates the ARC companion on the FH8626V100 by
	  holding it in reset and gating its clock, so it
	  cannot access the system bus. The device node has
	  no register window of its own.
```

## sound/soc/fullhan/Kconfig
```kconfig
config SND_SOC_FH8626
	tristate "Fullhan FH8626 audio controller and codec"
	depends on ARCH_FULLHAN && OF
	depends on SND_SOC && DMA_ENGINE && HAS_DMA
	depends on COMMON_CLK && FH_CLK && GPIOLIB
	select SND_DMAENGINE_PCM
	help
	  ASoC driver for the FH8626 audio controller and integrated
	  codec. PCM capture and playback use the DMAengine channels
	  described in the device tree.

	  To compile this driver as a module, choose M here: the module
	  will be called fh8626-audio.
```
