## drivers/crypto/fullhan/Kconfig
```kconfig
# SPDX-License-Identifier: GPL-2.0
config CRYPTO_DEV_FULLHAN_AES
	tristate "Fullhan FH8626 Hardware AES Accelerator"
	depends on ARCH_FULLHAN
	select CRYPTO_AES
	select CRYPTO_BLKCIPHER
	help
	  Support for the Fullhan FH8626 AES/DES/3DES engine. AES supports
	  ECB, CBC, CTR, OFB and CFB with 128, 192 and 256-bit keys.
	  DES and 3DES support ECB, CBC, OFB and CFB.

	  To compile this driver as a module, choose M here: the module
	  will be called fh_aes.
```

## drivers/media/platform/axera/Kconfig
```kconfig
# SPDX-License-Identifier: GPL-2.0-only

comment "Axera media platform drivers"

config VIDEO_AX630C_TDP
	tristate "Axera AX630C TDP V4L2 scaler and colour converter"
	depends on V4L_PLATFORM_DRIVERS && VIDEO_DEV && OF && HAS_DMA
	select DMA_SHARED_BUFFER
	select V4L2_MEM2MEM_DEV
	select VIDEOBUF2_DMA_CONTIG
	help
	  Standard V4L2 mem2mem YUYV/NV12 to RGB565 conversion and scaling.
	  Supports reusable MMAP and DMA-BUF queues with crop and colourimetry.
	  The command engine and main video encoder remain independent.

config VIDEO_AX630C_CSI2RX
	tristate "Axera AX630C MIPI CSI-2 receiver"
	depends on V4L_PLATFORM_DRIVERS
	depends on VIDEO_DEV && OF
	select MEDIA_CONTROLLER
	select VIDEO_V4L2_SUBDEV_API
	select V4L2_FWNODE
	select MFD_SYSCON
	help
	  V4L2 subdev for the MIPI CSI-2 receiver and its D-PHY on the Axera
	  AX630C. On the Sipeed NanoKVM-Pro it takes four data lanes of
	  YUV422-8 from an LT6911UXC HDMI-to-MIPI bridge and feeds the VIN
	  capture block.

	  Open replacement for the vendor ax_mipi_rx blob. To compile this
	  driver as a module, choose M here: the module will be called
	  open_vin_csi2.

config VIDEO_AX630C_VIN
	tristate "Axera AX630C VIN/IFE capture"
	depends on V4L_PLATFORM_DRIVERS
	depends on VIDEO_DEV && OF
	select MEDIA_CONTROLLER
	select VIDEO_V4L2_SUBDEV_API
	select V4L2_FWNODE
	select VIDEOBUF2_CORE
	select VIDEOBUF2_V4L2
	select VIDEOBUF2_MEMOPS
	select DMA_SHARED_BUFFER
	select MFD_SYSCON
	help
	  V4L2 capture video node for the Axera AX630C's VIN front end, in the
	  IFE-bypass configuration: whole frames of packed YUV422 straight
	  from the CSI-2 receiver to DDR through the IFE write-DMA, with no
	  ISP processing. Buffers come from a reserved-memory pool and can be
	  exported as dma-bufs for a zero-copy hand-off to the encoder.

	  Open replacement for the vendor ax_proton blob. To compile this
	  driver as a module, choose M here: the module will be called
	  open_vin_capture.

config VIDEO_AX630C_VC8000E
	tristate "Axera AX630C VC8000E encoder command engine"
	depends on V4L_PLATFORM_DRIVERS
	depends on OF && HAS_DMA
	select DMA_SHARED_BUFFER
	help
	  The VeriSilicon VC8000E command engine (VCMD) as wired on the Axera
	  AX630C, with the frame-buffer allocator and dma-buf import path the
	  open encoder userspace uses. This is the Hantro-lineage character
	  device, not a V4L2 codec driver.

	  Open replacement for the vendor ax_venc blob. To compile this driver
	  as a module, choose M here: the module will be called
	  ax630c_venc_vcmd.
```

## drivers/media/platform/fh8626/Kconfig
```kconfig
config VIDEO_FH8626_BGM
	tristate "Fullhan FH8626 background model engine"
	depends on ARCH_FULLHAN && OF
	depends on VIDEO_V4L2 && MEDIA_CONTROLLER
	depends on HAS_DMA && COMMON_CLK && FH_CLK
	select VIDEOBUF2_VMALLOC
	select VIDEOBUF2_V4L2
	select V4L2_MEM2MEM_DEV
	help
	  Memory-to-memory V4L2 driver for the FH8626 background model
	  engine. It writes a foreground mask from a luminance frame.

	  To compile this driver as a module, choose M here: the
	  module will be called fh8626-bgm.


config VIDEO_FH8626_PAE
	tristate "Fullhan FH8626 H.264 encoder"
	depends on ARCH_FULLHAN && OF
	depends on VIDEO_V4L2 && MEDIA_CONTROLLER
	depends on HAS_DMA && COMMON_CLK && FH_CLK
	select VIDEOBUF2_DMA_CONTIG
	select VIDEOBUF2_VMALLOC
	select VIDEOBUF2_V4L2
	select V4L2_MEM2MEM_DEV
	help
	  Memory-to-memory V4L2 driver for the FH8626 H.264 encoder.

	  To compile this driver as a module, choose M here: the
	  module will be called fh8626-encoder.


config VIDEO_FH8626_CAPTURE
	tristate "Fullhan FH8626 capture pipeline"
	depends on ARCH_FULLHAN && OF
	depends on VIDEO_V4L2 && MEDIA_CONTROLLER
	depends on VIDEO_V4L2_SUBDEV_API
	depends on HAS_DMA && COMMON_CLK && FH_CLK
	depends on PHY_FH8626_MIPI
	select V4L2_FWNODE
	select VIDEOBUF2_DMA_CONTIG
	select VIDEOBUF2_VMALLOC
	select VIDEOBUF2_V4L2
	help
	  Driver for the FH8626 capture pipeline: MIPI CSI-2 receiver,
	  ISP and VPU. Video is exposed through a V4L2 capture node.

	  To compile this driver as a module, choose M here: the
	  module will be called fh8626-capture.


config VIDEO_FH8626_JPEG
	tristate "Fullhan FH8626 JPEG encoder"
	depends on ARCH_FULLHAN && OF
	depends on VIDEO_V4L2 && MEDIA_CONTROLLER
	depends on HAS_DMA && COMMON_CLK && FH_CLK
	select VIDEOBUF2_DMA_CONTIG
	select VIDEOBUF2_VMALLOC
	select VIDEOBUF2_V4L2
	select V4L2_MEM2MEM_DEV
	help
	  Memory-to-memory V4L2 driver for the FH8626 JPEG encoder.

	  To compile this driver as a module, choose M here: the
	  module will be called fh8626-jpeg.
```

## drivers/media/platform/soc_camera/Kconfig
```kconfig
config SOC_CAMERA
	tristate "SoC camera support"
	depends on VIDEO_V4L2 && HAS_DMA && I2C
	select VIDEOBUF_GEN
	select VIDEOBUF2_CORE
	help
	  SoC Camera is a common API to several cameras, not connecting
	  over a bus like PCI or USB. For example some i2c camera connected
	  directly to the data bus of an SoC.

config SOC_CAMERA_SCALE_CROP
	tristate

config SOC_CAMERA_PLATFORM
	tristate "platform camera support"
	depends on SOC_CAMERA
	help
	  This is a generic SoC camera platform driver, useful for testing

config VIDEO_MX3
	tristate "i.MX3x Camera Sensor Interface driver"
	depends on VIDEO_DEV && MX3_IPU && SOC_CAMERA
	depends on MX3_IPU || COMPILE_TEST
	depends on HAS_DMA
	select VIDEOBUF2_DMA_CONTIG
	---help---
	  This is a v4l2 driver for the i.MX3x Camera Sensor Interface

config VIDEO_PXA27x
	tristate "PXA27x Quick Capture Interface driver"
	depends on VIDEO_DEV && PXA27x && SOC_CAMERA
	select VIDEOBUF_DMA_SG
	---help---
	  This is a v4l2 driver for the PXA27x Quick Capture Interface

config VIDEO_RCAR_VIN
	tristate "R-Car Video Input (VIN) support"
	depends on VIDEO_DEV && SOC_CAMERA
	depends on ARCH_SHMOBILE || COMPILE_TEST
	depends on HAS_DMA
	select VIDEOBUF2_DMA_CONTIG
	select SOC_CAMERA_SCALE_CROP
	---help---
	  This is a v4l2 driver for the R-Car VIN Interface

config VIDEO_SH_MOBILE_CSI2
	tristate "SuperH Mobile MIPI CSI-2 Interface driver"
	depends on VIDEO_DEV && SOC_CAMERA && HAVE_CLK
	depends on ARCH_SHMOBILE || SUPERH || COMPILE_TEST
	---help---
	  This is a v4l2 driver for the SuperH MIPI CSI-2 Interface

config VIDEO_SH_MOBILE_CEU
	tristate "SuperH Mobile CEU Interface driver"
	depends on VIDEO_DEV && SOC_CAMERA && HAS_DMA && HAVE_CLK
	depends on ARCH_SHMOBILE || SUPERH || COMPILE_TEST
	depends on HAS_DMA
	select VIDEOBUF2_DMA_CONTIG
	select SOC_CAMERA_SCALE_CROP
	---help---
	  This is a v4l2 driver for the SuperH Mobile CEU Interface

config VIDEO_OMAP1
	tristate "OMAP1 Camera Interface driver"
	depends on VIDEO_DEV && SOC_CAMERA
	depends on ARCH_OMAP1
	depends on HAS_DMA
	select VIDEOBUF_DMA_CONTIG
	select VIDEOBUF_DMA_SG
	---help---
	  This is a v4l2 driver for the TI OMAP1 camera interface

config VIDEO_MX2
	tristate "i.MX27 Camera Sensor Interface driver"
	depends on VIDEO_DEV && SOC_CAMERA
	depends on SOC_IMX27 || COMPILE_TEST
	depends on HAS_DMA
	select VIDEOBUF2_DMA_CONTIG
	---help---
	  This is a v4l2 driver for the i.MX27 Camera Sensor Interface

config VIDEO_ATMEL_ISI
	tristate "ATMEL Image Sensor Interface (ISI) support"
	depends on VIDEO_DEV && SOC_CAMERA
	depends on ARCH_AT91 || COMPILE_TEST
	depends on HAS_DMA
	select VIDEOBUF2_DMA_CONTIG
	---help---
	  This module makes the ATMEL Image Sensor Interface available
	  as a v4l2 device.

config VIDEO_AK
	tristate "AK Camera Interface driver"
	depends on VIDEO_DEV && SOC_CAMERA && AK_ISP_CHAR
	select VIDEOBUF_DMA_CONTIG
	---help---
	  This is a v4l2 driver for the AK Platform Camera Interface. It uses
	  the ISP2 interface provided by AK_ISP_CHAR.


config AK_ISP_CORE
	bool "Anyka ISP core, built from source"
	depends on ARCH_AK
	help
	  The ak_isp_* implementation behind /dev/isp_char.

	  If unsure, say N.

config SENSOR_GC1084
	bool "GalaxyCore GC1084 sensor support (DVP)"
	depends on AK_ISP_CHAR
	help
	  GC1084 on a DVP bus, 1280x720 at 30fps.

	  If unsure, say N.

config SENSOR_AR0130_ISP2
	bool "OnSemi AR0130 (ISP2) sensor support"
	depends on AK_ISP_CHAR
	help
	  OnSemi AR0130 (ISP2) on the ISP2 sensor framework, from the Cloud39EV300 SDK
	  (drivers/media/video/plat-anyka/). Detected at run time against
	  the other selected sensors by ID.

	  If unsure, say N.

config SENSOR_BF3703
	bool "BYD BF3703 sensor support"
	depends on AK_ISP_CHAR
	help
	  BYD BF3703 on the ISP2 sensor framework, from the Cloud39EV300 SDK
	  (drivers/media/video/plat-anyka/). Detected at run time against
	  the other selected sensors by ID.

	  If unsure, say N.

config SENSOR_F22_F23_F28_F35_F37
	bool "SOI JX-F22/F23/F28/F35/F37 sensor support"
	depends on AK_ISP_CHAR
	help
	  SOI JX-F22/F23/F28/F35/F37 on the ISP2 sensor framework, from the Cloud39EV300 SDK
	  (drivers/media/video/plat-anyka/). Detected at run time against
	  the other selected sensors by ID.

	  If unsure, say N.

config SENSOR_GC1054
	bool "GalaxyCore GC1054 sensor support"
	depends on AK_ISP_CHAR
	help
	  GalaxyCore GC1054 on the ISP2 sensor framework, from the Cloud39EV300 SDK
	  (drivers/media/video/plat-anyka/). Detected at run time against
	  the other selected sensors by ID.

	  If unsure, say N.

config SENSOR_GC2053
	bool "GalaxyCore GC2053 sensor support"
	depends on AK_ISP_CHAR
	help
	  GalaxyCore GC2053 on the ISP2 sensor framework, from the Cloud39EV300 SDK
	  (drivers/media/video/plat-anyka/). Detected at run time against
	  the other selected sensors by ID.

	  If unsure, say N.

config SENSOR_H63
	bool "SOI JX-H63 sensor support"
	depends on AK_ISP_CHAR
	help
	  SOI JX-H63 on the ISP2 sensor framework, from the Cloud39EV300 SDK
	  (drivers/media/video/plat-anyka/). Detected at run time against
	  the other selected sensors by ID.

	  If unsure, say N.

config SENSOR_H65
	bool "SOI JX-H65 sensor support"
	depends on AK_ISP_CHAR
	help
	  SOI JX-H65 on the ISP2 sensor framework, from the Cloud39EV300 SDK
	  (drivers/media/video/plat-anyka/). Detected at run time against
	  the other selected sensors by ID.

	  If unsure, say N.

config SENSOR_IMX307
	bool "Sony IMX307 sensor support"
	depends on AK_ISP_CHAR
	help
	  Sony IMX307 on the ISP2 sensor framework, from the Cloud39EV300 SDK
	  (drivers/media/video/plat-anyka/). Detected at run time against
	  the other selected sensors by ID.

	  If unsure, say N.

config SENSOR_PS5260
	bool "PrimeSensor PS5260 sensor support"
	depends on AK_ISP_CHAR
	help
	  PrimeSensor PS5260 on the ISP2 sensor framework, from the Cloud39EV300 SDK
	  (drivers/media/video/plat-anyka/). Detected at run time against
	  the other selected sensors by ID.

	  If unsure, say N.

config SENSOR_SC1235
	bool "SmartSens SC1235 sensor support"
	depends on AK_ISP_CHAR
	help
	  SmartSens SC1235 on the ISP2 sensor framework, from the Cloud39EV300 SDK
	  (drivers/media/video/plat-anyka/). Detected at run time against
	  the other selected sensors by ID.

	  If unsure, say N.

config SENSOR_SC1245
	bool "SmartSens SC1245 sensor support"
	depends on AK_ISP_CHAR
	help
	  SmartSens SC1245 on the ISP2 sensor framework, from the Cloud39EV300 SDK
	  (drivers/media/video/plat-anyka/). Detected at run time against
	  the other selected sensors by ID.

	  If unsure, say N.

config SENSOR_SC2232H_SC2135E
	bool "SmartSens SC2232H/SC2135E sensor support"
	depends on AK_ISP_CHAR
	help
	  SmartSens SC2232H/SC2135E on the ISP2 sensor framework, from the Cloud39EV300 SDK
	  (drivers/media/video/plat-anyka/). Detected at run time against
	  the other selected sensors by ID.

	  If unsure, say N.

config SENSOR_SC2235
	bool "SmartSens SC2235 sensor support"
	depends on AK_ISP_CHAR
	help
	  SmartSens SC2235 on the ISP2 sensor framework, from the Cloud39EV300 SDK
	  (drivers/media/video/plat-anyka/). Detected at run time against
	  the other selected sensors by ID.

	  If unsure, say N.

config SENSOR_SC2239_SC2332_SC2335
	bool "SmartSens SC2239/SC2332/SC2335 sensor support"
	depends on AK_ISP_CHAR
	help
	  SmartSens SC2239/SC2332/SC2335 on the ISP2 sensor framework, from the Cloud39EV300 SDK
	  (drivers/media/video/plat-anyka/). Detected at run time against
	  the other selected sensors by ID.

	  If unsure, say N.

config SENSOR_SP2305
	bool "SuperPix SP2305 sensor support"
	depends on AK_ISP_CHAR
	help
	  SuperPix SP2305 on the ISP2 sensor framework, from the Cloud39EV300 SDK
	  (drivers/media/video/plat-anyka/). Detected at run time against
	  the other selected sensors by ID.

	  If unsure, say N.

config LINUX_AKSENSOR
	tristate "Anyka legacy sensor stack (aksensor)"
	depends on SOC_CAMERA && I2C && OF_GPIO
	depends on !AK_ISP_CHAR
	help
	  The first AK39 generation's SCCB/I2C sensor stack (aksensor.c/
	  wrap_sensor.c) and its camera_*.c client drivers below, used by
	  the ISP v1 host (VIDEO_AK_ISP1). It binds the same
	  "anyka,sensor0" node and driver name as the ISP2 sensor glue that
	  AK_ISP_CHAR builds, so only one of the two can be selected.

	  If unsure, say N.

config SENSOR_GC0308
	tristate "gc0308 sensor support"
	depends on LINUX_AKSENSOR
	help
	  This is a gc0308 sensor driver

config SENSOR_OV2643
	tristate "ov2643 sensor support"
	depends on LINUX_AKSENSOR
	help
	  This is a ov2643 sensor driver

config SENSOR_OV7725
	tristate "ov7725 sensor support"
	depends on LINUX_AKSENSOR
	help
	  This is a ov7725 sensor driver

config SENSOR_HM1375
	tristate "hm1375 sensor support"
	depends on LINUX_AKSENSOR
	help
	  This is a hm1375 sensor driver

config SENSOR_OV9712
	tristate "ov9712 sensor support"
	depends on LINUX_AKSENSOR
	help
	  This is a ov9712 sensor driver

config SENSOR_OV2710
	tristate "ov2710 sensor support"
	depends on LINUX_AKSENSOR
	help
	  This is a ov2710 sensor driver

config SENSOR_AR0130
	tristate "ar0130 sensor support"
	depends on LINUX_AKSENSOR
	help
	  This is a ar0130 sensor driver

config SENSOR_H22
	tristate "jx-h22 sensor support"
	depends on LINUX_AKSENSOR
	help
	  This is a jx-h22 sensor driver

config SENSOR_NT99141
	tristate "nt99141 sensor support"
	depends on LINUX_AKSENSOR
	help
	  This is a nt99141 sensor driver
```

## drivers/mtd/mtdsplit/Kconfig
```kconfig
config MTD_SPLIT
	def_bool n
	help
	  Generic MTD split support.

config MTD_SPLIT_SUPPORT
	def_bool MTD = y

comment "Rootfs partition parsers"

config MTD_SPLIT_SQUASHFS_ROOT
	bool "Squashfs based root partition parser"
	depends on MTD_SPLIT_SUPPORT
	select MTD_SPLIT
	default n
	help
	  This provides a parsing function which allows to detect the
	  offset and size of the unused portion of a rootfs partition
	  containing a squashfs.

comment "Firmware partition parsers"


config MTD_SPLIT_UIMAGE_FW
	bool "uImage based firmware partition parser"
	depends on MTD_SPLIT_SUPPORT
	select MTD_SPLIT
	help
	  Splits a firmware partition holding a legacy uImage followed, at the
	  next erase block, by a squashfs into "kernel" and "rootfs". Any
	  bootloader that can bootm a uImage boots such an image.
```

## drivers/net/ethernet/ak-ethernet/Kconfig
```kconfig
config AK_ETHERNET
	tristate "Anyka AK3918 (Aimer39) Ethernet support"
	depends on ARCH_AK && OF
	depends on MACH_AK3918
	help
	  The older Anyka 10/100 MAC of the AK3910/AK3916/AK3918 (Aimer39),
	  from the Aimer39 SDK. The module is ak_ethernet. EV200, EV300 and
	  EV330 have a Synopsys GMAC instead (AK_GMAC).
```
