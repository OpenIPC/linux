## drivers/mtd/nand/hifmc100_nand/Kconfig
```kconfig
#
# drivers/mtd/nand/hifmc100_nand/Kconfig
# add by hisilicon 2017.10.26
#

menuconfig MTD_NAND_HIFMC100
	bool "Hisilicon Flash Memory Controller v100 Nand devices support"
	depends on MFD_HISI_FMC && !MTD_SPI_NAND_HISI_BVT
	select MISC_FILESYSTEMS
	select MTD_BLOCK
	select YAFFS_FS
	select YAFFS_YAFFS2
	help
	  Hisilicon Flash Memory Controller version 100 is called hifmc100 for
	  short. The controller support DMA transfers while reading or writing
	  the Nand flash.

if MTD_NAND_HIFMC100

config HIFMC100_NAND_EDO_MODE
	bool "the Extended Data Out(EDO) mode"
	help
	  In Extended data out (EDO), a new data cycle is started while the data
	  output of the previous cycle is still active. This process of cycle
	  overlapping, called pipelining, increases processing speed by about
	  10 nanoseconds per cycle,increasing computer performance by about 5
	  percent compared to performance using FMP.

config RW_H_WIDTH
	int "the width of Read/Write HIGH Hold Time (0 to 15)"
	range 0 15
	default 10 if ARCH_HI3559AV100
	help
	  the Read/Write HIGH Hold Time of nand flash

config R_L_WIDTH
	int "the Read pulse width (0 to 15)"
	range 0 15
	default 10 if ARCH_HI3559AV100
	help
	  the Read/Write LOW Hold Time of nand flash

config W_L_WIDTH
	int "the Write pulse width (0 to 15)"
	range 0 15
	default 10 if ARCH_HI3559AV100
	help
	  the Read/Write LOW Hold Time of nand flash

endif # End of MTD_NAND_HIFMC100
```

## drivers/mtd/nand/hinfc610/Kconfig
```kconfig
menuconfig MTD_NAND_HINFC610
	tristate "Hisilicon NAND Controller v610 Nand devices Support"
	depends on !MTD_SPI_NAND_HISI_BVT && (ARCH_HI3516A || ARCH_HI3531A)
	select YAFFS_FS
	select MISC_FILESYSTEMS
	select MTD_BLOCK
	select YAFFS_YAFFS2
	help
	  When the config is set, the kernel will support Hisilicon
	  NAND Controller v610 devices. It means that the kernel would
	  control the nand flash with the nand controller v610 device
	  in operation.

if MTD_NAND_HINFC610

config HINFC610_MAX_CHIP
	int "number of nand flash chip (1,4)"
	range 1 4
	default 1
	help
	  nand controller v610 device only support 1 or 2 nand flash chip,
	  your should not config other value.

config HINFC610_DBG_NAND_DEBUG
	bool "Debug: create debug file to control debug type"
	default y
	help
	  When the config is set, the kernel will add the "debug" file
	  to control debug type. When the config is set, we could choose
	  the debugging type to display the informations of the nand controller
	  v610 device in operation.

config HINFC610_DBG_NAND_DUMP
	bool "Debug: display read/write/erase process nand data"
	depends on HINFC610_DBG_NAND_DEBUG
	default y
	default n if (ARCH_HI3516A)
	help
	  When the config is set, the kernel will add "dump" file to
	  display all nand operation and data.When the "HINFC610_DBG_NAND_DEBUG"
	  has been set, the nand controller v610 device will display
	  all the operations and data.

config HINFC610_DBG_NAND_ERASE_COUNT
	bool "Debug: display last erase count"
	depends on HINFC610_DBG_NAND_DEBUG
	default y
	default n if (ARCH_HI3516A)
	help
	  When the config is set, the kernel will add "erase_count" file
	  to display last erase count. When the "HINFC610_DBG_NAND_DEBUG"
	  has been set, the nand controller v610 device will display
	  the last erase count.

config HINFC610_DBG_NAND_ECC_COUNT
	bool "Debug: display last ecc count."
	depends on HINFC610_DBG_NAND_DEBUG
	default y
	default n if (ARCH_HI3516A)
	help
	  When the config is set, the kernel will add "ecc_count"
	  to display last ecc count. When the "HINFC610_DBG_NAND_DEBUG"
	  has been set, the nand controller v610 device will display
	  the last ecc count.

config HINFC610_DBG_NAND_READ_RETRY
	bool "Debug: display read_retry process"
	depends on HINFC610_DBG_NAND_DEBUG
	default y
	default n if (ARCH_HI3516A)
	help
	  When the config is set, the kernel will add read_retry file
	  to display read_retry process.

choice
	prompt "Pagesize and Ecc Type Select"
	default HINFC610_AUTO_PAGESIZE_ECC if ARCH_HI3516A

config HINFC610_AUTO_PAGESIZE_ECC
	bool "Auto"
	help
	  When the config is set, pagesize and ecc type will use
	  hardware config. When we replace the flash, the
	  controller will identify the pagesize and ecc type of
	  the flash.

config HINFC610_PAGESIZE_AUTO_ECC_NONE
	bool "Pagesize Auto, Ecc None"
	help
	  select pagesize 2K, ecc none.

endchoice

endif # MTD_NAND_HINFC610
```
