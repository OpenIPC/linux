## drivers/mstar/i2c/Kconfig
```kconfig
config MS_I2C
    tristate "Mstar I2C driver"
    help
        MStar I2C driver function
        
config MS_I2C_CEDRIC
    tristate "I2C driver support for Cedric"
    depends on MS_I2C    
    depends on ARCH_CEDRIC 		

config MS_I2C_INFINITY
    tristate "I2C driver support for iNfinity"
    depends on MS_I2C        
    depends on ARCH_INFINITY    	

config MS_I2C_INFINITY3
    tristate "I2C driver support for iNfinity3"
    depends on MS_I2C
    depends on ARCH_INFINITY3
```

## drivers/mstar/isp/Kconfig
```kconfig
config MS_ISP
    boolean "ISP driver"
    default y
    help
    Enable support for ISP Driver
    
config MS_ISP_CEDRIC
    tristate "ISP support for Cedric"
    depends on MS_ISP
    depends on ARCH_CEDRIC
    help
    To compile this driver as a module, choose M here: the
    module will be called drv_isp hal_isp.
    
    
config MS_ISP_INFINITY
    tristate "ISP support for iNfinity"
    depends on MS_ISP
    depends on ARCH_INFINITY
    default y
    help
    To compile this driver as a module, choose M here: the
    module will be called drv_isp hal_isp.
    
config MS_ISP_INFINITY3
    tristate "ISP support for iNfinity3"
    depends on MS_ISP
    depends on ARCH_INFINITY3
    default y
    help
    To compile this driver as a module, choose M here: the
    module will be called drv_isp hal_isp.
```

## drivers/mstar/msys/Kconfig
```kconfig
config MS_MSYS
    bool 
    default y
    
config MS_ZEN
    bool
    default y
```

## drivers/mstar/pwm/Kconfig
```kconfig
config MS_PWM

tristate "MSTAR_PWM"

        help
          Say Y here to enable the driver for the PWM.

          If unsure, say Y.

          To compile this driver as a module, choose M here: the
          module will be called mdrv_ts.

select PWM

help
    MStar PWM driver function

	
```

## drivers/mstar/scl/Kconfig
```kconfig
config MS_SCL
	bool "SCL driver"
	help
    		To enable MSTAR SCL driver.

config MS_SCL_INFINITY
  bool "support I1 driver"
	depends on MS_SCL
	depends on ARCH_INFINITY

config MS_SCL_INFINITY3
  bool "support I3 driver"
	depends on MS_SCL
	depends on ARCH_INFINITY3
```

## drivers/mstar/sdmmc/Kconfig
```kconfig
config MS_SDMMC
	tristate "Mstar SD/MMC Card Interface Support"
	depends on MMC
	default n
  ---help---
        Enable SD/MMC Driver Support for MStar Product

config MS_SDMMC_SLOTNUMS
  int "Mstar SD/MMC Total Slot Number"
	depends on MS_SDMMC
  default 1
  range 1 3
  ---help---
        How many SDMMC Slots

config MS_SDMMC1_IP
  int "Mstar IP Select Order of SD/MMC1"
  depends on MS_SDMMC
  default 0
  range 0 2
  ---help---
     The IP Select Order of SDMMC1

config MS_SDMMC2_IP
  int "Mstar IP Select Order of SD/MMC2"
  depends on MS_SDMMC
  default 1
  range 0 2
  ---help---
     The IP Select Order of SDMMC2

 config MS_SDMMC3_IP
  int "Mstar IP Select Order of SD/MMC3"
  depends on MS_SDMMC
  default 2
  range 0 2
  ---help---
     The IP Select Order of SDMMC3

config MS_SDMMC1_PAD
  int "Mstar PAD Select Order of SD/MMC1"
  depends on MS_SDMMC
  default 0
  range 0 2
  ---help---
     The PAD Select Order of SDMMC1

config MS_SDMMC2_PAD
  int "Mstar PAD Select Order of SD/MMC2"
  depends on MS_SDMMC
  default 1
  range 0 2
  ---help---
     The PAD Select Order of SDMMC2

config MS_SDMMC3_PAD
  int "Mstar PAD Select Order of SD/MMC3"
  depends on MS_SDMMC
  default 2
  range 0 2
  ---help---
     The PAD Select Order of SDMMC1


config MS_SDMMC_REVCDZ
	bool "Mstar SD/MMC Reverse CDZ Pin"
	depends on MS_SDMMC
	default n
  ---help---
        For SD Socket Type, Revert the CDZ pin Value for Card Detection

config MS_SDMMC_TCARD
	bool "Mstar SD/MMC T-Flash Card Using"
	depends on MS_SDMMC
	default n
  ---help---
        For T-Flash Socket, We don't use WP Pin

config MS_SDMMC_REVWP
	bool "Mstar SD/MMC Reverse WP Pin"
	depends on !MS_SDMMC_TCARD && MS_SDMMC
	default n
  ---help---
        For SD Socket Type, Revert the WP pin Value for Write Protection

config MS_SDMMC1_MAXCLK
    int "Mstar SD/MMC1 Maximum Clock"
	depends on MS_SDMMC
    default 32000000
    range 300000 50000000
  ---help---
      The maximun Clock of SDMMC1

config MS_SDMMC1_MAXDLVL
    int "Mstar SD/MMC1 Maximum DownLevel"
    depends on MS_SDMMC
    default 0
    range 0 5
    ---help---
      The maximun Clock Downgrade Level of SDMMC1

config MS_SDMMC1_PASSLVL
    int "Mstar SD/MMC1 Pass Level"
    depends on MS_SDMMC
    default 0
    range 0 5
    ---help---
      The maximun Clock Pass Level of SDMMC1

config MS_SDMMC1_INTCDZ
	bool "Mstar SD/MMC1 Int CDZ Support"
	depends on MS_SDMMC
	default n
  ---help---
        For SD1, Whether we need to run hotplug funciton (HW consideration)

config MS_SDMMC1_FAKECDZ
	bool "Mstar SD/MMC1 Fake CDZ"
	depends on !MS_SDMMC1_INTCDZ && MS_SDMMC
	default n
  ---help---
        For SD1, Whether we need to assume card detection always true (HW consideration)


config MS_SDMMC2_MAXCLK
    int "Mstar SD/MMC2 Maximum Clock"
    depends on MS_SDMMC
    default 32000000
    range 300000 50000000
    ---help---
      The maximun Clock of SDMMC2

config MS_SDMMC2_MAXDLVL
    int "Mstar SD/MMC2 Maximum DownLevel"
    depends on MS_SDMMC
    default 0
    range 0 5
    ---help---
      The maximun Clock Downgrade Level of SDMMC2

config MS_SDMMC2_PASSLVL
    int "Mstar SD/MMC2 Pass Level"
    depends on MS_SDMMC
    default 0
    range 0 5
    ---help---
      The maximun Clock Pass Level of SDMMC2

config MS_SDMMC2_INTCDZ
	bool "Mstar SD/MMC2 Int CDZ Support"
	depends on MS_SDMMC
	default n
  ---help---
        For SD2, Whether we need to run hotplug funciton (HW consideration)

config MS_SDMMC2_FAKECDZ
	bool "Mstar SD/MMC2 Fake CDZ"
	depends on !MS_SDMMC2_INTCDZ && MS_SDMMC
	default n
  ---help---
        For SD2, Whether we need to assume card detection always true (HW consideration)

config MS_SDMMC3_MAXCLK
    int "Mstar SD/MMC3 Maximum Clock"
    depends on MS_SDMMC
    default 32000000
    range 300000 50000000
    ---help---
      The maximun Clock of SDMMC3

config MS_SDMMC3_MAXDLVL
    int "Mstar SD/MMC3 Maximum DownLevel"
    depends on MS_SDMMC
    default 0
    range 0 5
    ---help---
      The maximun Clock Downgrade Level of SDMMC3

config MS_SDMMC3_PASSLVL
    int "Mstar SD/MMC3 Pass Level"
    depends on MS_SDMMC
    default 0
    range 0 5
    ---help---
      The maximun Clock Pass Level of SDMMC3

config MS_SDMMC3_INTCDZ
	bool "Mstar SD/MMC3 Int CDZ Support"
	depends on MS_SDMMC
	default n
  ---help---
        For SD3, Whether we need to run hotplug funciton (HW consideration)

config MS_SDMMC3_FAKECDZ
	bool "Mstar SD/MMC3 Fake CDZ"
	depends on !MS_SDMMC3_INTCDZ && MS_SDMMC
	default n
  ---help---
        For SD3, Whether we need to assume card detection always true (HW consideration)
```

## drivers/mstar/sound/Kconfig
```kconfig
menuconfig MS_SOUND
	tristate "Audio driver"
	select SOUND
	select SND
	select SND_SOC
	select SND_PCM
	help
	  Say Y or M if you want to add support for codecs attached to
	  the iNfinity3e Bach Aduio driver.


config MS_SOUND_INFINITY3
    tristate "Audio support for iNfinity3e"
    depends on MS_SOUND
    depends on ARCH_INFINITY3
```

## drivers/mstar/unfd/Kconfig
```kconfig
config MS_NAND
	tristate "NAND driver"
	depends on MTD_NAND
	default n
	help
    		To enable MSTAR UNFD NAND driver.
```

## drivers/mstar/usb/Kconfig
```kconfig
config MS_USB_CEDRIC
    tristate "USB support for Cedric"
    depends on ARCH_CEDRIC    		

    
config MS_USB_CHICAGO
    tristate "USB support for Chicago"
    depends on ARCH_CHICAGO

config MS_USB_INFINITY
    tristate "USB support for INFINITY"
    depends on ARCH_INFINITY
```

## drivers/mtd/awnand/Kconfig
```kconfig
menu "sunxi-nand"
choice
	prompt "AWNAND CHOICE"
	default AW_MTD_SPINAND
	optional

config AW_MTD_SPINAND
	tristate "Allwinner MTD SPINAND Device Support"
	depends on MTD
	depends on ARCH_SUNXI
	select AW_SPINAND_PHYSICAL_LAYER
	select AW_SPINAND_SECURE_STORAGE
	select MTD_UBI
	help
	  Enables support for SPINAND Flash chips on Allwinner SoCs.
	  It's different with Allwinner's privately nand driver that it use
	  ubi system rather than Allwinner's NFTL.

config AW_MTD_RAWNAND
	tristate "Allwinner MTD RAWNAND Device Support"
	depends on MTD
	depends on ARCH_SUNXI
	depends on !SUNXI_NAND
	select AW_RAWNAND_SECURE_STORAGE
	select MTD_UBI
	help
	  Enables support for RAWNAND Flash chips on Allwinner SoCs.
	  It's different with Allwinner's privately nand driver that it use
	  ubi system rather than Allwinner's NFTL.
endchoice

if AW_MTD_SPINAND
source "drivers/mtd/awnand/spinand/Kconfig"
endif

if AW_MTD_RAWNAND
source "drivers/mtd/awnand/rawnand/Kconfig"
endif
endmenu
```

## drivers/mtd/awnand/spinand/Kconfig
```kconfig
config AW_SPINAND_PHYSICAL_LAYER
	bool
	help
	  Enable support for Allwinner's physical layer for spinand.
	  It's a command physical layer, used by both AW-nand with nftl and
	  MTD-nand with ubi.

config AW_SPINAND_SECURE_STORAGE
	bool
	help
	  Enable secure storage for Allwinner's spinand.

	  If unsure, say no.

config AW_SPINAND_PSTORE_MTD_PART
	bool "create pstore mtd partition for aw ubi spinand"
	depends on AW_MTD_SPINAND
	select MTD_PSTORE
	help
	  Whether create pstore mtd partition, which is need by pstroe-blk.
	  If you want linux kernel dump log to spinand when oops/panic, you
	  should create pstreo mtd partition by this configure.

	  If unsure, say no.

config AW_SPINAND_ENABLE_PHY_CRC16
	bool "check crc16 for each page on spinand physical layer"
	depends on AW_SPINAND_PHYSICAL_LAYER
	help
	  It is experimental.
	  To check crc16 for each page on spinand physical layer.

	  If unsure, say no.

config AW_SPINAND_SIMULATE_MULTIPLANE
	bool "enable simulate multiplane"
	depends on AW_SPINAND_PHYSICAL_LAYER
	default y
	help
	  spinand do not support multiplane. In order to adapt to aw nand
	  we simulate multiplane. If set, the common physical layer should
	  merge two continuous physical block to 'super block' for logical
	  layer.

	  Merge pages in two adjacent blocks with the same page num to super
	  page. Merge adjacent blocks to super block.

	  *   phy-block0   phy-block1    = super block 0
	  * |------------|------------|
	  * | phy-page 0 | phy-page 0 |  = super page 0 on super block 0
	  * | phy-page 1 | phy-page 1 |  = super page 1 on super block 0
	  * |     ...    |     ...    |
	  * |------------|------------|

	  If unsure, say Y.

config AW_MTD_SPINAND_OOB_RAW_SPARE
	bool "support mtd read oob raw spare data"
	depends on AW_MTD_SPINAND
	default n
	help
		aw spinand do not support read raw spare data by default, say yes to
		support mtd read oob raw spare data.

		if enable AW_MTD_SPINAND_OOB_RAW_SPARE, the oob is equivalent to spare area,
		otherwise oob is the user data spare area in ecc protected.
```

## drivers/mtd/devices/ingenic_sfc_v1/Kconfig
```kconfig
config INGENIC_SFC_V1
	tristate "Ingenic series SFC driver v1"
	depends on MACH_XBURST || MACH_XBURST2
	help
		SFC driver version v1.0 for Ingenic series SoCs

if INGENIC_SFC_V1

choice
	prompt "the SFC external memory (nor or nand)"
	help
	  Select the SFC external memory

config MTD_INGENIC_SFC_V1_NORFLASH
	bool "Support ingenic sfc-nor"
	depends on INGENIC_SFC_V1

config MTD_INGENIC_SFC_V1_NANDFLASH
	bool "Support ingenic sfc-nand"
	depends on INGENIC_SFC_V1
	select MTD_NAND

endchoice

choice
	prompt "sfc Mode"
	help
	  Select sfc Mode

config SPI_STANDARD
	bool "standard spi mode"
	depends on INGENIC_SFC_V1
	help
	  Say Y here to enable spi STANDARD MODE

config SPI_QUAD
	bool "quad spi mode"
	depends on INGENIC_SFC_V1
	help
	  Say Y Here to enable spi QUAD MODE
endchoice

endif
```

## drivers/mtd/devices/ingenic_sfc_v2/Kconfig
```kconfig
config INGENIC_SFC_V2
	tristate "Ingenic series SFC driver v2"
	depends on MACH_XBURST || MACH_XBURST2
	help
		SFC driver version v2.0 for Ingenic series SoCs

if INGENIC_SFC_V2

choice
	prompt "the SFC external memory (nor or nand)"
	help
	  Select the SFC external memory

config MTD_INGENIC_SFC_V2_NORFLASH
	bool "Support ingenic sfc-nor"
	depends on INGENIC_SFC_V2

config MTD_INGENIC_SFC_V2_NANDFLASH
	bool "Support ingenic sfc-nand"
	depends on INGENIC_SFC_V2
	select MTD_NAND

endchoice

choice
	prompt "sfc Mode"
	help
	  Select sfc Mode

config SPI_STANDARD_MODE
	bool "standard spi mode"
	depends on INGENIC_SFC_V2
	help
	  Say Y here to enable spi standard mode

config SPI_QUAD_MODE
	bool "quad spi mode"
	depends on INGENIC_SFC_V2
	help
	  Say Y Here to enable spi QUAD MODE
endchoice

endif
```

## drivers/mtd/devices/xmsfc/Kconfig
```kconfig
config MTD_XMSFC
	tristate "xm spi flash controller device  driver"
	depends on  ARCH_XM530 || ARCH_XM580
	default y if  ARCH_XM530 || ARCH_XM580
	help
		xm spi flash controller device  driver
```

## drivers/mtd/nand/Kconfig
```kconfig
# SPDX-License-Identifier: GPL-2.0-only

menu "NAND"

config MTD_NAND_CORE
	tristate

source "drivers/mtd/nand/onenand/Kconfig"
source "drivers/mtd/nand/raw/Kconfig"
source "drivers/mtd/nand/spi/Kconfig"
source "drivers/mtd/nand/xmedia_fmc100/Kconfig"

menu "ECC engine support"

config MTD_NAND_ECC
       bool
       depends on MTD_NAND_CORE

config XMEDIA_NAND_ECC_STATUS_REPORT
	tristate "Report the ecc status to MTD for Xmedia Nand Driver"
	depends on MTD_NAND_CORE && ARCH_XMEDIA
	default n
	help
	  Flash Memory Controller reports the ecc status include ECC error
	  and ECC corrected to MTD to monitor the aging of devices.
endmenu

config MTD_SPI_NAND_XMEDIA
    tristate "Support for SPI NAND controller on Xmedia SoCs"
    depends on MTD_NAND_CORE
    help
      Enables support for the SPI NAND device drivers.


config XMEDIA_NAND_FS_MAY_NO_YAFFS2
    bool "Remove the restraintion of 16bit ecc type on yaffs2 to Xmedia"
	depends on MFD_XMEDIA_FMC
    default n
    help
      The ecc type: 16bit is limited by the Xmedia flash memory controller,
      as the yaffs2 tag of xmedia rootfs limits the min size of CTRL len is 28.
endmenu
```

## drivers/mtd/nand/gkfmc100/Kconfig
```kconfig
#
# goke flash memory controller SPI nand device driver version 100
# drivers/mtd/nand/gkfmc100/Kconfig
# add by goke 2017.8.7
#

config MTD_SPI_NAND_FMC100
	bool "Goke Flash Memory Controller v100 SPI Nand devices support"
	depends on MFD_GOKE_FMC && MTD_SPI_NAND_GOKE
	select MISC_FILESYSTEMS
	select MTD_BLOCK
	select YAFFS_FS
	select YAFFS_YAFFS2
	help
	  Goke Flash Memory Controller version 100 is called fmc100 for
	  short. The controller driver support registers and DMA transfers
	  while reading or writing the SPI nand flash.
```

## drivers/mtd/nand/hifmc100/Kconfig
```kconfig
#
# hisilicon flash memory controller SPI nand device driver version 100
# drivers/mtd/nand/hifmc100/Kconfig
# add by hisilicon 2017.8.7
#

config MTD_SPI_NAND_HIFMC100
	bool "Hisilicon Flash Memory Controller v100 SPI Nand devices support"
	depends on MFD_HISI_FMC && MTD_SPI_NAND_HISI_BVT
	select MISC_FILESYSTEMS
	select MTD_BLOCK
	select YAFFS_FS
	select YAFFS_YAFFS2
	help
	  Hisilicon Flash Memory Controller version 100 is called hifmc100 for
	  short. The controller driver support registers and DMA transfers
	  while reading or writing the SPI nand flash.
```
