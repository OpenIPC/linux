## drivers/pci/endpoint/functions/Kconfig
```kconfig
# SPDX-License-Identifier: GPL-2.0
#
# PCI Endpoint Functions
#

config PCI_EPF_TEST
	tristate "PCI Endpoint Test driver"
	depends on PCI_ENDPOINT
	select CRC32
	help
	   Enable this configuration option to enable the test driver
	   for PCI Endpoint.

	   If in doubt, say "N" to disable Endpoint test driver.

config PCI_EPF_VHOST
	tristate "PCI Endpoint VHOST driver"
	depends on PCI_ENDPOINT && ARCH_SSTAR
	help
	   Select this configuration option to enable the VHOST driver
	   for PCI Endpoint. EPF VHOST driver implements VIRTIO backend
	   for EPF and uses the VHOST framework to bind any VHOST driver
	   to the VHOST device created by this driver.
	   If in doubt, say "N" to disable Endpoint VHOST driver.
```

## drivers/pci/hipcie/Kconfig
```kconfig
menuconfig HIPCIE
	bool "Hisilicon PCI Express support"
	depends on PCI && (ARCH_HI3559AV100 || ARCH_HI3531A || ARCH_HI3519AV100)
	default y if PCI
	default n if ! PCI
	help
	Hisilicon PCI Express support
	Choose this selection to support PCI Express uses.

if HIPCIE

menu "PCI Express configs"


config LIMIT_MAX_RD_REQ_SIZE
	bool "limit pcie max read request size"
	default y
	depends on PCI && (ARCH_HI3559AV100 || ARCH_HI3531A || ARCH_HI3519AV100)
	help
	The default max read request size of pcie device is 512 Byte. When pcie use
	the card of pcie-to-sata to connect to the sata disk, with the default max read
	request size value of 512 byte, would cause the low bandwidth of VDP. If you enable
	the LIMIT_MAX_RD_REQ_SIZE config, the max read request size of pcie device would be
	set to 128 byte, and the problem of VDP low band width also be avoided.

endmenu

endif
```

## drivers/phy/goke/Kconfig
```kconfig
config PHY_GOKE_USBP2
	tristate "GOKE USBP2 PHY Driver"
	select GENERIC_PHY
	default n
	help
	  Support for PHY on goke Socs. This Phy supports
	  USB 1.5Mb/s, USB 12Mb/s, USB 480Mb/s speeds. It suppots one
	  USB host port to accept one USB device. Support init the phy
	  and adjust phy Eye Diagram.

menuconfig USB_MODE_OPTION
	bool "goke USB related configuration"

if USB_MODE_OPTION

config USB_DRD0_IN_HOST
	bool "USB DRD0 Mode Select HOST"
	help
	  Select whether the USB drd0 is working in host mode.

config USB_DRD0_IN_DEVICE
	bool "USB DRD0 Mode Select DEVICE"
	help
	  Select whether the USB drd0 is working in device mode.

endif # USB_MODE_OPTION
```

## drivers/phy/hibvt/Kconfig
```kconfig
config PHY_HISI_SATA
	tristate "Hisilicon sata phy support"
	depends on (ARCH_HI3536DV100 || ARCH_HI3521A || ARCH_HI3531A) && OF && HAS_IOMEM
	default n
	select GENERIC_PHY
	help
	  Enable this to support the sata phy that is part of
	  sata driver for hisilicon

config HISI_SATA_MODE
	int "Hisi sata interworking speed mode(1.5G:0/3G:1/6G:2)"
	depends on PHY_HISI_SATA
	range 0 1 if ARCH_HI3536DV100
	range 0 2 if (ARCH_HI3521A || ARCH_HI3531A)
	default "1" if (ARCH_HI3536DV100 || ARCH_HI3521A || ARCH_HI3531A)
	help
	  Hisilicon sata interworking speed mode

config PHY_HISI_USB2
	tristate "HISI USB2 PHY Driver"
	depends on ARCH_HISI_BVT
	default y
	select GENERIC_PHY
	help
	Support for PHY on Hisilicon Socs. This Phy supports
	USB 1.5Mb/s, USB 12Mb/s, USB 480Mb/s speeds. It suppots one
	USB host port to accept one USB device. Support init the phy
	and adjust phy Eye Diagram.

config PHY_HISI_USB3
	tristate "HISI USB3 PHY Driver"
	depends on ARCH_HI3531A
	default y
	select GENERIC_PHY
	help
	Support for PHY on Hisilicon Socs. This Phy supports
	USB3.0 and Compatible with USB2.0. It suppots one
	USB host port to accept one USB device. Support init the phy
	and adjust phy Eye Diagram.
```

## drivers/phy/xmedia/Kconfig
```kconfig
config PHY_XMEDIA_USBP2
	tristate "XMEDIA USBP2 PHY Driver"
	select GENERIC_PHY
	default n
	help
	  Support for PHY on Xmedia Socs. This Phy supports
	  USB 1.5Mb/s, USB 12Mb/s, USB 480Mb/s speeds. It suppots one
	  USB host port to accept one USB device. Support init the phy
	  and adjust phy Eye Diagram.

menuconfig USB_MODE_OPTION
	bool "Xmedia USB related configuration"

if USB_MODE_OPTION

config USB_DRD0_IN_HOST
	bool "USB DRD0 Mode Select HOST"
	help
	  Select whether the USB drd0 is working in host mode.

config USB_DRD0_IN_DEVICE
	bool "USB DRD0 Mode Select DEVICE"
	help
	  Select whether the USB drd0 is working in device mode.

endif # USB_MODE_OPTION
```

## drivers/pinctrl/anyka/Kconfig
```kconfig
#
# Broadcom pinctrl drivers
#
config PINCTRL_AK
	bool "AK GPIO (with PINCONF) driver"
	depends on OF_GPIO && ARCH_AK
	select GPIOLIB_IRQCHIP
	select PINCONF
	select PINMUX
	help
	  The Anyka GPIO driver.
```

## drivers/pinctrl/novatek/Kconfig
```kconfig
config PINCTRL_NA51089
	bool "Novatek NA51089 pin control"
	depends on NVT_IVOT_PLAT_NA51089

config PINCTRL_NA51068
	bool "Novatek NA51068 pin control"
	depends on NVT_IVOT_PLAT_NA51068 || NVT_IVOT_PLAT_NA51068_CA53

config PINCTRL_NA51055
	bool "Novatek NA51055 pin control"
	depends on NVT_IVOT_PLAT_NA51055
```

## drivers/pwm/Kconfig
```kconfig
menuconfig PWM
	bool "Pulse-Width Modulation (PWM) Support"
	help
	  Generic Pulse-Width Modulation (PWM) support.

	  In Pulse-Width Modulation, a variation of the width of pulses
	  in a rectangular pulse signal is used as a means to alter the
	  average power of the signal. Applications include efficient
	  power delivery and voltage regulation. In computer systems,
	  PWMs are commonly used to control fans or the brightness of
	  display backlights.

	  This framework provides a generic interface to PWM devices
	  within the Linux kernel. On the driver side it provides an API
	  to register and unregister a PWM chip, an abstraction of a PWM
	  controller, that supports one or more PWM devices. Client
	  drivers can request PWM devices and use the generic framework
	  to configure as well as enable and disable them.

	  This generic framework replaces the legacy PWM framework which
	  allows only a single driver implementing the required API. Not
	  all legacy implementations have been ported to the framework
	  yet. The framework provides an API that is backward compatible
	  with the legacy framework so that existing client drivers
	  continue to work as expected.

	  If unsure, say no.

if PWM

config PWM_FULLHAN
	tristate "FH PWM support"
	help
	  To compile this driver as a module, choose M here: the module will
	  be called fh_pwm.
	  
if PWM_FULLHAN
config FH_PWM_NUM
	int
	prompt "Number of PWMs, range: 1~8"
	default 2
	range 1 8
	help
	  Number of PWMs
endif

endif
```

## drivers/remoteproc/ambarella/Kconfig
```kconfig
config RPROC_SUPPORT
	bool
	select REMOTEPROC
        select RPMSG
	default n

config RPROC_CA9_A
	tristate "Enable RPROC Host on CA9-A"
	depends on MACH_HYACINTH_0
	select RPROC_SUPPORT
	help
	  TBD:

config RPROC_CA9_B
	tristate "Enable RPROC Host on CA9-B"
	depends on MACH_HYACINTH_1
	select RPROC_SUPPORT
	help
	  TBD:

config RPROC_S2
    tristate "Enable RPROC Host on S2"
    depends on MACH_GINKGO
    select RPROC_SUPPORT
    help
      TBD:
    default n

config RPCLNT_SUPPORT
	bool
	select REMOTEPROC
        select RPMSG
	default n

config RPCLNT_CA9_B
	tristate "Enable RPROC Clnt on CA9-B"
	depends on MACH_HYACINTH_1
	select RPCLNT_SUPPORT
	help
	  TODO:

config RPMSG_VRING_BASE
	hex "Base address (Physical) used for the rpmsg & remoteproc"
	depends on REMOTEPROC
	default 0x5C000000 if MACH_HYACINTH_0 || MACH_HYACINTH_1
	default 0x20000000 if MACH_GINKO

config RPMSG_NUM_BUFS
	int "Number of buffers for each RPMSG bus"
	depends on REMOTEPROC
	default 4096
	help
	  The buffers are partitioned into dedicated halves for TX
	  and RX.

config RPMSG_BUF_SIZE
	int "Buffer size (in bytes) for each RPMSG message"
	depends on REMOTEPROC
	default 4096
	help
	  The first 16 bytes are used by the rpmsg header internally.
	  So only N - 16 bytes is available for the message payload.
```

## drivers/rpbuf/Kconfig
```kconfig
# SPDX-License-Identifier: GPL-2.0

menu "RPBuf drivers"

config RPBUF
	tristate
	help
	  The RPBuf (Remote Processor Buffer) framework provides mechanisms to
	  allocate buffers and transmit/receive their references to/from remote
	  processor. This allows user to exchange large data with the remote
	  processor.

config RPBUF_DEV
	tristate "RPBuf device interface"
	select RPBUF
	default n
	help
	  Say y here to export rpbuf buffers as device files, usually found in
	  /dev. They make it possible for user-space programs to use rpbuf
	  buffers.

comment "Service"

config RPBUF_SERVICE_RPMSG
	tristate "RPMsg-based RPBuf service driver"
	select RPBUF
	default n
	help
	  Say y here to enable support for the RPMsg-based RPBuf service driver.
	  This is one kind of RPBuf service backend implemented with RPMsg.

comment "Controller"

config RPBUF_CONTROLLER_SUNXI
	tristate "Allwinner RPBuf controller driver"
	select RPBUF
	select RPBUF_DEV
	default n
	help
	  Say y here to enable support for the Allwinner RPBuf controller driver.

comment "Sample"

config RPBUF_SAMPLE_SUNXI
	tristate "Allwinner RPBuf sample driver"
	select RPBUF
	default n
	help
	  Say y here to enable support for the Allwinner RPBuf sample driver.
	  This is a sample driver to introduce how to use RPBuf framework.

endmenu
```

## drivers/rpmsg/Kconfig
```kconfig
menu "Rpmsg drivers"

# RPMSG always gets selected by whoever wants it
config RPMSG
	tristate

config SUNXI_MSGBOX
	tristate "allwinnertech msgbox"
	default n
	select RPMSG
	help
	  Say y here to enable support for the allwinnertech providing
	  communication channels to remote processors in allwinnertech
	  platforms.

config SUNXI_RPMSG_E907
	tristate "allwinnertech rpmsg driver for v853-e907"
	default n
	select RPMSG
	help
	  Say y here to enable support for the v853-e907 rpmsg driver.

config SUNXI_RPMSG_SPEEDTEST
	tristate "allwinnertech rpmsg speedtest driver"
	default n
	select RPMSG
	help
	  Say y here to enable support for the rpmsg speedtest simple.

config SUNXI_RPMSG_HEARBEAT
	tristate "allwinnertech rpmsg hearbeat driver"
	default n
	select RPMSG
	help
	  Say y here to enable support for the rpmsg hearbeat simple.

config RPMSG_CTRL
	tristate "sunxi rpmsg ctrl driver"
	default n
	select RPMSG
	help
	  Say Y here to export rpmsg ctrl device files, usually found in /dev.
	  They make it possible for user-space programs to create rpmsg
	  endpoints device, it can be found in /dev/rpmsg%d.

config RPMSG_NOTIFY
	tristate "sunxi rpmsg notify driver"
	default n
	select RPMSG
	help
	  Say Y here to enable rpmsg notify  driver.It provides notification
	  mechanism base on rpmsg.

config RPMSG_CHAR
	tristate "RPMSG device interface"
	default n
	depends on RPMSG
	help
	  Say Y here to export rpmsg endpoints as device files, usually found
	  in /dev. They make it possible for user-space programs to send and
	  receive rpmsg packets.

config RPMSG_QCOM_SMD
	tristate "Qualcomm Shared Memory Driver (SMD)"
	depends on QCOM_SMEM
	depends on QCOM_SMD=n
	select RPMSG
	help
	  Say y here to enable support for the Qualcomm Shared Memory Driver
	  providing communication channels to remote processors in Qualcomm
	  platforms.

config RPMSG_VIRTIO
	tristate "Virtio RPMSG bus driver"
	depends on HAS_DMA
	select RPMSG
	select VIRTIO

endmenu
```

## drivers/rpmsg/ambarella/Kconfig
```kconfig
menu "RPMSG Host Programs"
depends on RPROC_SUPPORT
source "drivers/rpmsg/ambarella/host/ambxc/Kconfig"
source "drivers/rpmsg/ambarella/host/aservice/Kconfig"
source "drivers/rpmsg/ambarella/host/echo/Kconfig"
source "drivers/rpmsg/ambarella/host/rsh/Kconfig"
source "drivers/rpmsg/ambarella/host/veth/Kconfig"
source "drivers/rpmsg/ambarella/host/wnfs/Kconfig"
source "drivers/rpmsg/ambarella/host/rnfs/Kconfig"
source "drivers/rpmsg/ambarella/host/vgpio/Kconfig"

endmenu

menu "RPMSG Client Programs"
depends on RPCLNT_SUPPORT

source "drivers/rpmsg/ambarella/clnt/rsh/Kconfig"
source "drivers/rpmsg/ambarella/clnt/echo/Kconfig"
source "drivers/rpmsg/ambarella/clnt/veth/Kconfig"

endmenu

source "drivers/rpmsg/ambarella/common/rsh/Kconfig"
source "drivers/rpmsg/ambarella/common/veth/Kconfig"
```

## drivers/rpmsg/ambarella/clnt/echo/Kconfig
```kconfig
config RPDEV_ECHO
	tristate "Echo"
	help
	  A sample of rpmsg program which implement an "echo client".
```

## drivers/rpmsg/ambarella/clnt/rsh/Kconfig
```kconfig
config RPDEV_RSH
	tristate "Remote Shell"
	select AMBARELLA_RSH
	help
	  A Remote shell server for CA9-B to accept remote
	  connection from CA9-A
```

## drivers/rpmsg/ambarella/clnt/veth/Kconfig
```kconfig
config RPDEV_VETH
	tristate "Virtual Ethernet"
	select AMBARELLA_VETH
	help
	  A virtualized ethernet device over RPMSG bus.
```

## drivers/rpmsg/ambarella/host/ambxc/Kconfig
```kconfig
config RPMSG_AMBXC
	tristate "Ambarella A8 Codec driver"
	depends on RPMSG
	select VIDEO_V4L2
	select V4L2_MEM2MEM_DEV
	select VIDEOBUF2_CORE
	select VIDEOBUF2_MEMOPS
	select VIDEOBUF2_VMALLOC
	default n
	---help---
	  V4L2 Display driver support for Ambarella A8.
```

## drivers/rpmsg/ambarella/host/aservice/Kconfig
```kconfig
config RPMSG_AUDIOSERVICE
	tristate "audio service"
	depends on RPMSG
	help
	  A audio service client for interacting with Itron on ARM11
```

## drivers/rpmsg/ambarella/host/echo/Kconfig
```kconfig
config RPMSG_ECHO
	tristate "Echo"
	depends on RPMSG
	help
	  A sample of rpmsg program which implement an echo server
```

## drivers/rpmsg/ambarella/host/rnfs/Kconfig
```kconfig
config RPMSG_RNFS
	tristate "Read from NFS Server"
	depends on RPMSG
	depends on !RPMSG_AMBXC
	help
		A sample of read file from NFS Server
```

## drivers/rpmsg/ambarella/host/rsh/Kconfig
```kconfig
config RPMSG_RSH
	tristate "Remote Shell"
	depends on RPMSG
	select AMBARELLA_RSH
	help
	  A Remote shell client for interacting with Itron on ARM11
	  and Linux on CA9-B
```

## drivers/rpmsg/ambarella/host/veth/Kconfig
```kconfig
config RPMSG_VETH
	tristate "Virtual Ethernet"
	depends on RPMSG
	select AMBARELLA_VETH
	help
	  A virtualized ethernet device over RPMSG bus.
```

## drivers/rpmsg/ambarella/host/vgpio/Kconfig
```kconfig
config RPMSG_VGPIO
	tristate "Virtual GPIO"
	depends on RPMSG
	select AMBARELLA_VGPIO
	help
	  A virtualized GPIO device over RPMSG bus.
```

## drivers/rpmsg/ambarella/host/wnfs/Kconfig
```kconfig
config RPMSG_WNFS
	tristate "Write to NFS Server"
	depends on RPMSG
	depends on !RPMSG_AMBXC
	help
	  A sample of rpmsg program which implement an echo server
```
