## drivers/input/touchscreen/cf11xx/Kconfig
```kconfig
#
# Touchscreen driver configuration
#
config TOUCHSCREEN_CF11XX_SITRONIX_TS
    tristate "sitronix Ts for TOUCHSCREEN"
    depends on I2C
    default n
    help
      Say Y here if you have hynitorn touch panel.
      If unsure, say N.
```

## drivers/input/touchscreen/gt911/Kconfig
```kconfig
#
#  Touchscreen driver configuration
#
config INPUT_TOUCHSCREEN_GT911
    tristate  "gt911 touchscreen driver"      
    depends on INPUT && I2C
    select INPUT_SENSORINIT
    default n
    help
        gt911 touchscreen driver    

choice 
	prompt "Select GT911 Firmware"
    depends on INPUT_TOUCHSCREEN_GT911
    default GTP_FW_NONE

    config GTP_FW_NONE
        bool "None"

    config GTP_FW_720JC
        bool "GT911 Firmware for 720JC"

    config GTP_FW_720LX
        bool "GT911 Firmware for 720LX"
endchoice
```

## drivers/input/touchscreen/tlsc6x/Kconfig
```kconfig
#
#  Touchscreen driver configuration
#
config  TOUCHSCREEN_TLSC6X_TS
       tristate  "tlsc6x touchscreen driver"
       depends on INPUT && I2C
       default m
       help
         tlsc6x touchscreen driver
```

## drivers/lzma/Kconfig
```kconfig
#
# LZMA  device configuration
#

config LZMADEVICE
   bool "LZMA support"
   default y
```

## drivers/media/cedar-ve/Kconfig
```kconfig
config VIDEO_ENCODER_DECODER_SUNXI
	tristate "sunxi video encoder and decoder support"
    select DMA_SHARED_BUFFER
    default y
	---help---
	  This is the driver for sunxi video decoder, including h264/
	  mpeg4/mpeg2/vc1/rmvb.
	  To compile this driver as a module, choose M here: the
	  module will be called cedar_dev.

config VIDEO_KERNEL_DEC_SUNXI
	depends on (VIDEO_ENCODER_DECODER_SUNXI)
	bool "sunxi video dec kernel module"
	default n
	---help---
     Choose Y to enable sunxi video dec kernel module

config VIDEO_KERNEL_ENC_SUNXI
	depends on (VIDEO_ENCODER_DECODER_SUNXI)
	bool "sunxi video enc kernel module"
	default n
	---help---
     Choose Y to enable rotate video enc kernel module
```

## drivers/media/platform/davinci/Kconfig
```kconfig
config VIDEO_DAVINCI_VPIF_DISPLAY
	tristate "DaVinci Video VPIF Display"
	depends on VIDEO_DEV && (MACH_DAVINCI_DM6467_EVM || MACH_DAVINCI_DA850_EVM)
	select VIDEOBUF_DMA_CONTIG
	select VIDEO_DAVINCI_VPIF
	select VIDEO_ADV7343
	select VIDEO_THS7303
	help
	  Support for DaVinci VPIF Display on DM6467 EVM and/or DA850/OMAP-L138/AM18xx EVM.
	  To compile this driver as a module, choose M here: the
	  module will be called vpif_display.

config VIDEO_DM355_AF
	tristate "DM355 Auto Focus Driver"
	depends on ARCH_DAVINCI_DM355
	default y
	help
	   Support for dm355 AF hardware.

	   Auto Focus programming functions which are used to support
	   control loop for Auto Focus. It collects metrics about the
	   image or video data,

config VIDEO_DM355_AEW
	tristate "DM355 Auto exposure /White Balance Driver"
	depends on ARCH_DAVINCI_DM355
	help
	  Support for dm355 hardware.

	  DM355 Auto Exposure and Auto White Balance programming functions
	  which are used to support the control loops for Auto Exposure and
	  Auto White Balance. It collects metrics about the image or video data

config VIDEO_DM365_3A_HW
	tristate "DM365 Auto Focus, Auto Exposure/ White Balance HW module"
	depends on ARCH_DAVINCI_DM365
	help
	  DM365 Auto Focus, Auto Exposure and Auto White Balancing HW module

	  This module has functions which configure AEW/AF hardware, high level
	  AF module and AEW module use these functionalities. It collects metrics
	  about the image or video data

config VIDEO_DM365_AF
	tristate "DM365 Auto Focus Driver"
	depends on ARCH_DAVINCI_DM365
	select VIDEO_DM365_3A_HW
	help
	  DM365 Auto Focus hardware module.

	  Auto Focus driver is used to support control loop for Auto Focus.
	  It collects metrics about the image or video data. This provides
	  hooks to AF subdevice driver.

config VIDEO_DM365_AEW
	tristate "DM365 Auto exposure /White Balance Driver"
	depends on ARCH_DAVINCI_DM365
	select VIDEO_DM365_3A_HW
	help
	  DM365 Auto Exposure and Auto White Balance hardware module.

	  This is used to support the control loops for Auto Exposure
	  and Auto White Balance. It collects metrics about the image
	  or video data

config DM365_IPIPE
	depends on ARCH_DAVINCI && ARCH_DAVINCI_DM365
	tristate "DM365 IPIPE"
	help
	  dm365 IPIPE hardware module.

	  This is the hardware module that implements imp_hw_interface
	  for DM365. This hardware module provides previewer and resizer
	  functionality for image processing.

config IMP_DEBUG
	depends on (DM355_IPIPE || DM365_IPIPE)
	bool "IMP Debug support"
	default n
	help
	  Enable dumping of Image PIPE configuration to console

	  This option enables debug information to be dumped onto console,
	  helps user in finding the contents of registers during the failing
	  case and rootcause the issue.

config VIDEO_DAVINCI_VPIF_CAPTURE
	tristate "DaVinci Video VPIF Capture"
	depends on VIDEO_DEV && (MACH_DAVINCI_DM6467_EVM || MACH_DAVINCI_DA850_EVM)
	select VIDEOBUF_DMA_CONTIG
	select VIDEO_DAVINCI_VPIF
	help
	  Support for DaVinci VPIF Capture on DM6467 EVM and/or DA850/OMAP-L138/AM18xx EVM.

	  To compile this driver as a module, choose M here: the
	  module will be called vpif_capture.

config VIDEO_DAVINCI_VPIF
	tristate "DaVinci VPIF Driver"
	depends on VIDEO_DAVINCI_VPIF_DISPLAY
	help
	  Support for DaVinci VPIF Driver.

	  To compile this driver as a module, choose M here: the
	  module will be called vpif.

config VIDEO_VPSS_SYSTEM
	tristate "VPSS System module driver"
	depends on ARCH_DAVINCI
	help
	  Support for vpss system module for video driver

config VIDEO_VPFE_CAPTURE
	tristate "VPFE Video Capture Driver"
	depends on VIDEO_V4L2 && (ARCH_DAVINCI || ARCH_OMAP3)
	select VIDEOBUF_DMA_CONTIG
	help
	  Support for DMx/AMx VPFE based frame grabber. This is the
	  common V4L2 module for following DMx/AMx SoCs from Texas
	  Instruments:- DM6446, DM365, DM355 & AM3517/05.

	  To compile this driver as a module, choose M here: the
	  module will be called vpfe-capture.
	  
config VIDEO_YCBCR
	depends on (VIDEO_VPFE_CAPTURE)
	bool "VPFE YCBCR format support"
	default y
	help
	  Enables support for YCbCr camera

	  This is temporary option that enables to support YCbCr camera with resolution 640x480.
	  Later image format will be detected automatically
	  
config VIDEO_DM6446_CCDC
	tristate "DM6446 CCDC HW module"
	depends on VIDEO_VPFE_CAPTURE && ARCH_DAVINCI_DM644x
	select VIDEO_VPSS_SYSTEM
	default y
	help
	   Enables DaVinci CCD hw module. DaVinci CCDC hw interfaces
	   with decoder modules such as TVP5146 over BT656 or
	   sensor module such as MT9T001 over a raw interface. This
	   module configures the interface and CCDC/ISIF to do
	   video frame capture from slave decoders.

	   To compile this driver as a module, choose M here: the
	   module will be called vpfe.

config VIDEO_DM355_CCDC
	tristate "DM355 CCDC HW module"
	depends on ARCH_DAVINCI_DM355 && VIDEO_VPFE_CAPTURE
	select VIDEO_VPSS_SYSTEM
	default y
	help
	   Enables DM355 CCD hw module. DM355 CCDC hw interfaces
	   with decoder modules such as TVP5146 over BT656 or
	   sensor module such as MT9T001 over a raw interface. This
	   module configures the interface and CCDC/ISIF to do
	   video frame capture from a slave decoders

	   To compile this driver as a module, choose M here: the
	   module will be called vpfe.
	   
config VIDEO_DM365_ISIF
	tristate "DM365 CCDC/ISIF HW module"
	depends on ARCH_DAVINCI_DM365 && VIDEO_VPFE_CAPTURE
	default y
	help
	   Enables DM365 ISIF hw module. This is the hardware module for
	   configuring ISIF in VPFE to capture Raw Bayer RGB data  from
	   a image sensor or YUV data from a YUV source.

config DM355_IPIPE
	depends on ARCH_DAVINCI && ARCH_DAVINCI_DM355
	tristate "DM355 IPIPE"
	help
	  dm355 IPIPE hw programming module.

	  This is the hardware module that implements imp_hw_interface
	  for DM355. This hardware module provides previewer and resizer
	  configuration functionality for image processing.

config VIDEO_ISIF
	tristate "DM365 ISIF HW module"
	depends on ARCH_DAVINCI_DM365 && VIDEO_VPFE_CAPTURE
	select VIDEO_VPSS_SYSTEM
	default y
	help
	   Enables ISIF hw module. This is the hardware module for
	   configuring ISIF in VPFE to capture Raw Bayer RGB data  from
	   a image sensor or YUV data from a YUV source.

	   To compile this driver as a module, choose M here: the
	   module will be called vpfe.

config VIDEO_DM644X_VPBE
	tristate "DM644X VPBE HW module"
	select VIDEO_VPSS_SYSTEM
	select VIDEOBUF_DMA_CONTIG
	help
	    Enables VPBE modules used for display on a DM644x
	    SoC.

	    To compile this driver as a module, choose M here: the
	    module will be called vpbe.
config VIDEO_DAVINCI_DISPLAY
	tristate "Davinci V4L2 Video Display"
	depends on VIDEO_DEV && ARCH_DAVINCI
	select VIDEOBUF_VMALLOC
	select DAVINCI_OSD
	help
	  V4L2 Display driver support for davinci.

	  To compile this driver as a module, choose M here: the
	  module will be called davinci_display.

config DAVINCI_ENC_MNGR
	tristate "Davinci Encoder Manager support"
	depends on ARCH_DAVINCI
	default y
	help
	  Enable support for the DaVinci Encoder Manager. This is responsible
	  for managing output and video/graphics modes for davinci video drivers.

	  To compile this driver as a module, choose M here: the
	  module will be called davinci_enc_mngr

config ENC_MNGR_MAX_CHANNELS
	int "Max number of channels for Encoder Manager"
	depends on DAVINCI_ENC_MNGR
	default "2"
	help
	  Used to give max number of channels supported by encoder manager
	  driver.

config DAVINCI_OSD
	tristate "Davinci Display Manager"
	help
	  Support for Davinci On-Screen Display Manager.

	  To compile this driver as a module, choose M here: the
	  module will be called davinci_osd.

config DAVINCI_VPBE_ENCODER
	tristate "Davinci VPBE Encoder support"
	depends on DAVINCI_ENC_MNGR
	default y
	help
	  Enable support for the DaVinci VPBE internal encoder. DaVinci VPBE
	  has internal VENC and DAC to output analog SD outputs (composite,
	  S-Video and Component video outputs).

	  To compile this driver as a module, choose M here: the
	  module will be called vpbe_encoder.
	    
```

## drivers/media/platform/soc_camera/ingenic/Kconfig
```kconfig
config VIDEO_INGENIC
	tristate "Ingenic Camera Sensor Interface driver"
	depends on VIDEO_DEV && SOC_CAMERA
	depends on HAS_DMA
	select VIDEOBUF2_DMA_CONTIG
	---help---
	  This is a v4l2 driver for the ingenic Camera Sensor Interface

if VIDEO_INGENIC
source "drivers/media/platform/soc_camera/ingenic/x1000/Kconfig"
source "drivers/media/platform/soc_camera/ingenic/x2000/Kconfig"
endif
```

## drivers/media/platform/soc_camera/ingenic/x1000/Kconfig
```kconfig
config VIDEO_INGENIC_X1000
	tristate "Ingenic Soc camera Driver for X1000"
	depends on VIDEO_INGENIC
	help
		CIM Driver for X1000
```

## drivers/media/platform/soc_camera/ingenic/x2000/Kconfig
```kconfig
config VIDEO_INGENIC_X2000
	tristate "Ingenic Soc Camera Driver for X2000"
	depends on VIDEO_INGENIC
	help
		CIM Driver for X2000

config CAMERA_USE_SNAPSHOT
	bool "Sensor support snapshot function"
	depends on VIDEO_INGENIC_X2000
	help
		Sensor support snapshot function

config SNAPSHOT_PULSE_WIDTH
        int "Snapshot pulse width"
        depends on CAMERA_USE_SNAPSHOT
        default 8
        help
          Snapshot pulse width

config SNAPSHOT_FRAME_DELAY
        int "One frame end delay"
        depends on CAMERA_USE_SNAPSHOT
        default 100
        help
          One frame end delay
```

## drivers/media/platform/sunxi-vin/modules/sensor/Kconfig
```kconfig
config SENSOR_AR0238
	tristate "use ar0238 driver"
	default n

config SENSOR_AR0238_HISPI
	tristate "use ar0238_hispi driver"
	default n

config SENSOR_OV5640
	tristate "use ov5640 driver"
	default n

config SENSOR_OV2775_MIPI
	tristate "use ov2775_mipi driver"
	default n

config SENSOR_OV2710_MIPI
	tristate "use ov2710_mipi driver"
	default n

config SENSOR_OV2718_MIPI
	tristate "use ov2718_mipi driver"
	default n

config SENSOR_OV7251_MIPI
	tristate "use ov7251_mipi driver"
	default n

config SENSOR_OV2735_MIPI
	tristate "use ov2735_mipi driver"
	default n

config SENSOR_OV7750_MIPI
	tristate "use ov7750_mipi driver"
	default n

config SENSOR_OV5648
	tristate "use ov5658 driver"
	default n

config SENSOR_GC2145
	tristate "use gc2145 driver"
	default n

config SENSOR_GC0310_MIPI
	tristate "use gc0310_mipi driver"
	default n

config SENSOR_GC2355_MIPI
	tristate "use gc2355_mipi driver"
	default n

config SENSOR_GC2053_MIPI
	tristate "use gc2053_mipi driver"
	default n

config SENSOR_GC4663_MIPI
	tristate "use gc4663_mipi driver"
	default n

config SENSOR_GC0403_MIPI
	tristate "use gc0403_mipi driver"
	default n

config SENSOR_GC5025_MIPI
	tristate "use gc5025_mipi driver"
	default n

config SENSOR_GC5035_MIPI
	tristate "use gc5035_mipi driver"
	default n

config SENSOR_GC02M1_MIPI
	tristate "use gc02m1_mipi driver"
	default n

config SENSOR_SC2232_MIPI
	tristate "use sc2232_mipi driver"
	default n

config SENSOR_SC031GS_MIPI
	tristate "use sc031gs_mipi driver"
	default n

config SENSOR_SC530AI_MIPI
	tristate "use sc530ai_mipi driver"
	default n

config SENSOR_IMX214
	tristate "use imx214 driver"
	default n

config SENSOR_IMX219
	tristate "use imx219 driver"
	default n

config SENSOR_IMX274_SLVDS
	tristate "use imx274_slvds driver"
	default n

config SENSOR_IMX291_DVP
	tristate "use imx291_dvp driver"
	default n

config SENSOR_IMX291_MIPI
	tristate "use imx291_mipi driver"
	default n

config SENSOR_IMX307_MIPI
	tristate "use imx307_mipi driver"
	default n

config SENSOR_IMX317_MIPI
	tristate "use imx317_mipi driver"
	default n

config SENSOR_IMX335_MIPI
	tristate "use imx335_mipi driver"
	default n

config SENSOR_IMX326_MIPI
	tristate "use imx326_mipi driver"
	default n

config SENSOR_IMX477_MIPI
	tristate "use imx477_mipi driver"
	default n

config SENSOR_IMX278_MIPI
	tristate "use imx278_mipi driver"
	default n

config SENSOR_IMX258_MIPI
	tristate "use imx258_mipi driver"
	default n

config SENSOR_IMX386_MIPI
	tristate "use imx386_mipi driver"
	default n

config SENSOR_IMX386_2LANE_MIPI
	tristate "use imx386_2lane_mipi driver"
	default n

config SENSOR_S5K3H5XA
	tristate "use s5k3h5xa driver"
	default n

config SENSOR_TP9950
	tristate "use tp9950 driver"
	default n

config SENSOR_TP9953
	tristate "use tp9953 driver"
	default n

config SENSOR_OFILM0092
	tristate "use ofilm0092 driver"
	default n
```

## drivers/media/rc/novatek_ir/Kconfig
```kconfig
config IR_NVT_BK
	tristate "Novatek IR remote receiver for BK platform"
	depends on RC_CORE
	depends on ARCH_NVT_IVOT_V7 && (NVT_IVOT_PLAT_NA51068 || NVT_IVOT_PLAT_NA51068_CA53)
	---help---
	   Say Y if you want to use Novatek IR remote receiver

config IR_NVT_FR
	tristate "Novatek IR remote receiver for FR platform"
	depends on RC_CORE
	depends on ARCH_NVT_IVOT_V7 && !(NVT_IVOT_PLAT_NA51068 || NVT_IVOT_PLAT_NA51068_CA53)
	---help---
	   Say Y if you want to use Novatek IR remote receiver
```

## drivers/media/rt-media/Kconfig
```kconfig
config VIDEO_RT_MEDIA
	tristate "sunxi rt-media support"
    select DMA_SHARED_BUFFER
	default n
	---help---
	  This is the driver for sunxi video decoder, including h264/
	  mpeg4/mpeg2/vc1/rmvb.
	  To compile this driver as a module, choose M here: the
	  module will be called cedar_dev.
```

## drivers/media/sunxi_nna/Kconfig
```kconfig
config SUNXI_NNA
    depends on (ARCH_SUNXI)
    tristate "sunxi nna driver"
    default N
    help
```
