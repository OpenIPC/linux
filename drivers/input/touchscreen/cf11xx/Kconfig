## drivers/media/video/plat-anyka/Kconfig
```kconfig
config AK_SENSOR_I2C
	bool "ak sensor i2c interface"
	default y
	help
	  This is a sensor i2c interface 

config AK_SENSOR_COMMON
	bool "ak sensor common interface"
	default y
	help
	  This is sensor common interface 

config SENSOR_AR0130
	tristate "ar0130 sensor support"
	depends on LINUX_AKSENSOR
	help
	  This is a ar0130 sensor driver  

config SENSOR_BF3703
	tristate "bf3703 sensor support"
	depends on LINUX_AKSENSOR
	help
	  This is a bf3703 sensor driver 

config SENSOR_F22_F23_F28_F35_F37
	tristate "f22 f23 f35 f37 sensor support"
	depends on LINUX_AKSENSOR
	help
	  This is a sensor driver amongst model f22 f23 f28 f35 f37

config SENSOR_GC1054
	tristate "gc1054 sensor support"
	depends on LINUX_AKSENSOR
	help
	  This is a gc1054 sensor driver
	  
config SENSOR_GC2053
	tristate "gc2053 sensor support"
	depends on LINUX_AKSENSOR
	help
	  This is a gc2053 sensor driver

config SENSOR_H63
	tristate "H63 sensor support"
	depends on LINUX_AKSENSOR
	help
	  This is a H63 sensor driver
      
config SENSOR_H65
	tristate "h65 sensor support"
	depends on LINUX_AKSENSOR
	help
	  This is a h65 sensor driver

config SENSOR_IMX307
	tristate "imx307 sensor support"
	depends on LINUX_AKSENSOR
	help
	  This is a imx307 sensor driver

config SENSOR_PS5260
	tristate "ps5260 sensor support"
	depends on LINUX_AKSENSOR
	help
	  This is a ps5260 sensor driver

config SENSOR_SC1235
	tristate "sc1235 sensor support"
	depends on LINUX_AKSENSOR
	help
	  This is a sc1235 sensor driver

config SENSOR_SC1245
	tristate "sc1245 sensor support"
	depends on LINUX_AKSENSOR
	help
	  This is a sc1245 sensor driver

config SENSOR_SC2232H_SC2135E
	tristate "sc2232h & sc2135e sensor support"
	depends on LINUX_AKSENSOR
	help
	  This is a sc2232h & sc2135e sensor driver

config SENSOR_SC2235
	tristate "sc2235 sensor support"
	depends on LINUX_AKSENSOR
	help
	  This is a sc2235 sensor driver

config SENSOR_SC2239_SC2332_SC2335
	tristate "SC2239 SC2332 SC2335 SCsensor support"
	depends on LINUX_AKSENSOR
	help
	  This is a SC2239 SC2332 SC2335 sensor driver
      
config SENSOR_SP2305
	tristate "sc2305 sensor support"
	depends on LINUX_AKSENSOR
	help
	  This is a sc2305 sensor driver
```

## drivers/misc/akpcm/Kconfig
```kconfig
config AK39_PCM
	tristate "Anyka pcm cdev"
	depends on ARCH_AK39
	---help---
		akpcm cdev	  
```

## drivers/misc/leds/Kconfig
```kconfig
#
#  PWM LED driver configuration
#
config  MISC_PWM_LEDS
	tristate "LEDs by PWM Control driver, 3 PWMs control 3 colors"
	depends on PWM
	default n
	help
		Generic PWM framework driver for LEDS about breathing,and so on.

config MISC_PWM_GPIO_LEDS
	tristate "LEDs by PWM Control driver, 2 PWMs control 2 color and gpio control another one"
	depends on PWM
	default n
	help
		Generic PWM framework driver for LEDS about breathing,and so     on.

config MISC_AXP_LEDS
	tristate "LEDS show for AXP"
	depends on PWM
	default n
	help
		Support show led for AXP, such low capacity warning, and so on.
```

## drivers/misc/sc7a20/Kconfig
```kconfig
#
# I2C gsensor chip drivers configuration
#

menuconfig SC7A20 
	bool "SC7A20 support"

if SC7A20
	  
config SENSORS_SC7A20
	tristate "SC7A20 acceleration sensor support"
	depends on I2C
	default m
	help
	  If you say yes here you get support for silan's 
	  acceleration sensors SC7A20.
endif
```

## drivers/mmc/host/himci/Kconfig
```kconfig
#
#  himci family SD/MMC device configuration
#
menuconfig HIMCI
	tristate "himciv100 driver support"
	depends on (ARCH_HI3516A || ARCH_HI3518EV20X)
	default y
	select MMC_UNSAFE_RESUME
	select MMC_EMBEDDED_SDIO
	select MMC_BLOCK
	select MMC_BLOCK_BOUNCE
	help
	  This selects the Hisilicon Synopsys MultiMedia Card Driver
	  support. If you want use SD/MMC/SDIO driver,
	  Say Y or M here.

	  default is Y.

config SEND_AUTO_STOP
	bool "Send Auto Stop to terminate data transfer between host and SD card"
	depends on (ARCH_HI3516A || ARCH_HI3518EV20X) && HIMCI
	default y
```

## drivers/mstar/Kconfig
```kconfig
source "drivers/mstar/irqchip/Kconfig"
source "drivers/mstar/clocksource/Kconfig"
source "drivers/mstar/msys/Kconfig"
source "drivers/mstar/serial/Kconfig"
source "drivers/mstar/clk/Kconfig"


if (ARCH_INFINITY) || (ARCH_CEDRIC) || (ARCH_INFINITY3)
source "drivers/mstar/isp/Kconfig"
endif

if (ARCH_CEDRIC) || (ARCH_INFINITY) || (ARCH_INFINITY3)
source "drivers/mstar/unfd/Kconfig"
endif

if (ARCH_CEDRIC) || (ARCH_CHICAGO) || (ARCH_INFINITY3)
source "drivers/mstar/emmc/Kconfig"
endif

if (ARCH_CEDRIC) || (ARCH_CHICAGO) || (ARCH_INFINITY) || (ARCH_INFINITY3)
source "drivers/mstar/sdmmc/Kconfig"
endif

if (ARCH_CEDRIC) || (ARCH_CHICAGO) || (ARCH_INFINITY) || (ARCH_INFINITY3)
source "drivers/mstar/sound/Kconfig"
endif


if (ARCH_CEDRIC) || (ARCH_CHICAGO) || (ARCH_INFINITY)
source "drivers/mstar/usb/Kconfig"
endif

if (ARCH_CEDRIC)
source "drivers/mstar/dip/Kconfig"
endif

if (ARCH_CEDRIC)
source "drivers/mstar/mfe/Kconfig"
endif

if (ARCH_CEDRIC) || (ARCH_CHICAGO) || (ARCH_INFINITY) || (ARCH_INFINITY3)
source "drivers/mstar/fb/Kconfig"
endif

if (ARCH_INFINITY3)
source "drivers/mstar/fb1/Kconfig"
endif

if (ARCH_INFINITY3)
source "drivers/mstar/fb2/Kconfig"
endif

if (ARCH_INFINITY)|| (ARCH_INFINITY3)
source "drivers/mstar/scl/Kconfig"
endif

if (ARCH_INFINITY)  || (ARCH_INFINITY3)
source "drivers/mstar/emac/Kconfig"
endif


if (ARCH_CEDRIC) || (ARCH_INFINITY)|| (ARCH_INFINITY3)
source "drivers/mstar/ir/Kconfig"
endif

if (ARCH_CEDRIC) || (ARCH_INFINITY) || (ARCH_INFINITY3)
source "drivers/mstar/i2c/Kconfig"
endif

if (ARCH_CEDRIC) || (ARCH_INFINITY) || (ARCH_INFINITY3)
source "drivers/mstar/gpio/Kconfig"
endif

if (ARCH_INFINITY)|| (ARCH_INFINITY3)
source "drivers/mstar/watchdog/Kconfig"
endif

if (ARCH_INFINITY)|| (ARCH_INFINITY3)
source "drivers/mstar/sar/Kconfig"
endif

if (ARCH_INFINITY)|| (ARCH_INFINITY3)
source "drivers/mstar/ircut/Kconfig"
endif

if (ARCH_INFINITY) || (ARCH_INFINITY3)
source "drivers/mstar/vhe/Kconfig"
endif

if (ARCH_INFINITY) || (ARCH_INFINITY3)
source "drivers/mstar/mfev5/Kconfig"
endif

if (ARCH_INFINITY) || (ARCH_INFINITY3)
source "drivers/mstar/rtc/Kconfig"
endif

if (ARCH_INFINITY) || (ARCH_INFINITY3)
source "drivers/mstar/jpe/Kconfig"
endif

if (ARCH_CEDRIC) || (ARCH_CHICAGO) || (ARCH_INFINITY) || (ARCH_INFINITY3)
source "drivers/mstar/flash_isp/Kconfig"
endif

if (ARCH_INFINITY)|| (ARCH_INFINITY3)
source "drivers/mstar/xpm/Kconfig"
endif

if (ARCH_INFINITY)|| (ARCH_INFINITY3)
source "drivers/mstar/crypto/Kconfig"
endif

if (ARCH_INFINITY) || (ARCH_INFINITY3)
source "drivers/mstar/cpufreq/Kconfig"
endif

if (ARCH_INFINITY)|| (ARCH_INFINITY3)
source "drivers/mstar/pwm/Kconfig"
endif

if (ARCH_INFINITY)|| (ARCH_INFINITY3)
source "drivers/mstar/spinand/Kconfig"
endif

if (ARCH_INFINITY)|| (ARCH_INFINITY3)
source "drivers/mstar/spi/Kconfig"
endif

if (ARCH_INFINITY) || (ARCH_INFINITY3)
source "drivers/mstar/pm/Kconfig"
endif

if (ARCH_INFINITY3)
source "drivers/mstar/ive/Kconfig"
endif

if (ARCH_INFINITY3)
source "drivers/mstar/notify/Kconfig"
endif
```

## drivers/mstar/crypto/Kconfig
```kconfig
config MS_CRYPTO
	tristate "Support for the iNfinity AES engine"
	select CRYPTO_AES
	select CRYPTO_ECB
	select CRYPTO_CBC
	select CRYPTO_SHA256
	select CRYPTO_CTR
	select CRYPTO_ALGAPI
	help
	  Say 'Y' here to use the iNfinity AES
	  engine for the CryptoAPI AES algorithm.

	  To compile this driver as a module, choose M here: the module
	  will be called infinity-aes.

#config MS_CRYPTO_INFINITY
#    tristate "CRYPTO driver support for iNfinity"
#    depends on MS_CRYPTO
#    depends on ARCH_INFINITY
```

## drivers/mstar/emac/Kconfig
```kconfig
config MS_EMAC
select NET
select NET_ETHERNET
select MII
select PACKET
select USE_POLICY_FWD
select INET
select NETDEVICES

tristate "EMAC"
default n

---help---
Enable compilation option for driver EMAC

if MS_EMAC
config EMAC_SUPPLY_RNG
bool "Supply to random number generator device"
default n
help
    Supply to random number generator device

config ETHERNET_ALBANY
bool "Supply to internel PHY"
default n
help
    Supply to internel PHY

config MSTAR_HW_TX_CHECKSUM
bool "Supply to hardware TX checksum"
default n
help
    Supply to hardware TX checksum
    
config K3_RX_SWPATCH
bool "Supply to K3 RX SW Patch"
default n
help
    Supply to K3 RX frame drop due to padding 4 bytes issue

config DISCONNECT_DELAY_S
int "Disconnect delay in second"
default 1
help
    Disconnect delay in second

config MSTAR_EEE
bool "Supply to EEE function"
default n
help
    Supply to EEE function
endif
```

## drivers/mstar/fb/Kconfig
```kconfig
config MS_FB
	tristate "FB driver"	
	default y
	select FB
	select FB_SYS_FILLRECT
    select FB_SYS_COPYAREA
    select FB_SYS_IMAGEBLIT
    select FB_SYS_FOPS
	help
   		
config MS_FB_CEDRIC
    tristate "FB driver support for Cedric"
    depends on MS_FB
    depends on ARCH_CEDRIC    		

config MS_FB_CHICAGO
    tristate "FB driver support for Chicago"
    depends on MS_FB
    depends on ARCH_CHICAGO

config MS_FB_INFINITY
    tristate "FB driver support for iNfinity"
    depends on MS_FB
    depends on ARCH_INFINITY
config MS_FB_INFINITY3
    tristate "FB driver (GOP0) support for iNfinity3"
    depends on MS_FB
    depends on ARCH_INFINITY3
```

## drivers/mstar/fb2/Kconfig
```kconfig
config MS_FB
	tristate "FB driver"
	default y
	select FB
	select FB_SYS_FILLRECT
    select FB_SYS_COPYAREA
    select FB_SYS_IMAGEBLIT
    select FB_SYS_FOPS
	help

config MS_FB2_INFINITY3
    tristate "FB driver (GOP2) support for iNfinity3"
    depends on MS_FB
    depends on ARCH_INFINITY3
```

## drivers/mstar/flash_isp/Kconfig
```kconfig
config MS_FLASH_ISP

  select MTD
  #select MTD_CHAR
  #select MTD_BLKDEVS
  #select NFTL
  #select NFTL_RW
  #select MTD_OOPS
  
  #select MTD_COMPLEX_MAPPINGS
  #select MTD_BLOCK2MTD
  #select MTD_CMDLINE_PARTS
  #select SCSI_LOWLEVEL
  #select AUTOFS_FS
  
  #select FAT_FS
  #select MSDOS_FS
  #select VFAT_FS
  
  #select MTD_DEBUG
  #select MTD_DEBUG_VERBOSE
  #select MTD_CONCAT
  #select MTD_PARTITIONS
  #select MTD_NAND
  #select JFFS2_FS
  #select JFFS2_FS_DEBUG
  #select JFFS2_FS_WRITEBUFFER

bool "Serial Flash driver"
default n
---help---
    Enable compilation option for Serial Flash.
    FSP support Quadread/Daulread/write with BDMA.
    
if MS_FLASH_ISP
config MS_FLASH_ISP_MXP_PARTS
    bool
    default y

choice
    prompt "Target select"
    default MS_FLASH_ISP_INFINITY
    
config MS_FLASH_ISP_CEDRIC
    bool "support for Cedric"
    depends on ARCH_CEDRIC
    
config MS_FLASH_ISP_CHICAGO
    bool "support for Chicago"
    depends on ARCH_CHICAGO

config MS_FLASH_ISP_INFINITY
    bool "support for iNfinity"
    depends on ARCH_INFINITY

config MS_FLASH_ISP_INFINITY3
    bool "support for iNfinity3"
    depends on ARCH_INFINITY3
endchoice
endif

	
```
