## drivers/sstar/gmac/Kconfig
```kconfig
menu "SSTAR GMAC"
config SSTAR_GMAC
	select NET
	select NET_ETHERNET
	select MII
	select PACKET
	select USE_POLICY_FWD
	select INET
	select NETDEVICES
	select ETHERNET
	select STMMAC_ETH
	bool "SSTAR GMAC"
	default y

config SSTAR_SNPS_GMAC_RX_ZERO_COPY
	depends on SSTAR_GMAC
	bool "SSTAR_SNPS_GMAC_RX_ZERO_COPY"
	default y
	help
		SSTAR GMAC Rx Zero copy

config SSTAR_SNPS_GMAC_RXIC
	depends on SSTAR_GMAC
	bool "SSTAR_SNPS_GMAC_RXIC"
	default n
	help
		SSTAR GMAC Rx adaptive RX Interrupt

config SSTAR_SNPS_GMAC_CODING_OPTIMIZE
	depends on SSTAR_GMAC
	bool "SSTAR_SNPS_GMAC_CODING_OPTIMIZE"
	default y
	help
		SSTAR GMAC coding optimization

config SSTAR_SNPS_GMAC_SET_AFFINITY
	depends on SSTAR_GMAC
	bool "SSTAR_SNPS_GMAC_SET_AFFINITY"
	default n
	help
		GMAC interrupt separate on each CPU

config SSTAR_GMAC_DELAY_SCALE
	depends on SSTAR_GMAC
	int "SSTAR_GMAC_DELAY_SCALE"
	default 1
	help
		SSTAR GMAC delay time scale

config SSTAR_SNPS_GMAC_STORM_PROTECT
	depends on SSTAR_GMAC
	bool "SSTAR_SNPS_GMAC_DYN_STORM_PROTECT"
	default n
	help
		SSTAR GMAC Dynamic Storm Protect for Bcast and Mcast Packet

config SSTAR_SNPS_GMAC_EEE_REDUCTION
	depends on SSTAR_GMAC
	bool "SSTAR_SNPS_GMAC_EEE_REDUCTION"
	default n
	help
		SSTAR GMAC EEE : reduce number of enter/exit LPI mode

config SSTAR_SNPS_GMAC_TEST
	depends on SSTAR_GMAC
	bool "SSTAR_SNPS_GMAC_TEST"
	default n
	help
		SSTAR GMAC Test function

config SSTAR_SNPS_SW_TX_FLOW_CTL
	depends on SSTAR_GMAC
	bool "SSTAR_SNPS_SW_TX_FLOW_CTL"
	default n
	help
		SSTAR GMAC SW Tx flow control

endmenu
```

## drivers/sstar/gpio/Kconfig
```kconfig
config MS_GPIO
    tristate "GPIO driver"
    default y

config MS_SW_I2C
    tristate "SW I2C via GPIO support"
    depends on MS_GPIO

config MS_GPIC
    tristate "GPI Counter Driver"
    depends on MS_GPIO
```

## drivers/sstar/gyro/Kconfig
```kconfig
menuconfig SS_GYRO
    tristate "SStar Gyro Driver Support"
    default n
    help
        Support gyro for disalgo.

if SS_GYRO

choice
    prompt "GYRO transfer choice"
    default SS_GYRO_TRANSFER_I2C

config SS_GYRO_TRANSFER_I2C
	bool "Use I2C"
    depends on I2C
	help
		Use i2c to transfer data.

config SS_GYRO_TRANSFER_SPI
	bool "Use SPI"
    depends on SPI_MASTER
	help
		Use spi to transfer data.

endchoice

choice
    prompt "GYRO chip choice"
    default SS_GYRO_CHIP_ICM40607

config SS_GYRO_CHIP_ICG20660
    bool "ICG20660"
    help
        Use ICG20660

config SS_GYRO_CHIP_ICM40607
    bool "ICM40607"
    help
        Use ICM40607

endchoice

config SS_GYRO_CDEV
    bool "Enable gyro cdev"
    default n
    help
        Enable gyro cdev for user mode

config SS_GYRO_SYSFS
    bool "Enable gyro sysfs"
    default n
    help
        Enable gyro sysfs nodes for debug

config SS_GYRO_DEBUG_ON
    bool "Show debug info"
    default n
    help
        Show debug info

endif # SS_GYRO #
```
