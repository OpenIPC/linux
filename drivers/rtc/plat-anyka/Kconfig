## drivers/rtc/plat-anyka/Kconfig
```kconfig
menuconfig AK39_RTC_SELECT_CLOCK 
	bool "ANYKA ak39 rtc select clock support"
	help
	  Enable this to be able to choose the drivers for using the internal or external CLOCK.

if AK39_RTC_SELECT_CLOCK


config AK39_RTC_INTERNAL_RC_OSC
	bool "RTC_INTERNAL_RC_OSC"
	depends on ARCH_AK39
	help
	  Say Y here if you are using the RTC_INTERNAL_RC_OSC

config AK39_RTC_EXTERNAL_XTAL
	bool "RTC_EXTERNAL_XTAL"
	depends on ARCH_AK39
	help
	  Say Y here if you are using the RTC_EXTERNAL_XTAL
	  
endif 

#AK39_RTC_SELECT_CLOCK
```

## drivers/soc/nvt/Kconfig
```kconfig
#
# MediaTek SoC drivers
#
menu "NovaTek SoC drivers"
	depends on ARCH_NVT_IVOT_V7

config NVT_OTP_SUPPORT
	bool "NVT OTP(one time programmable) support"
	depends on ARCH_NVT_IVOT_V7
	default y
	help
	  This option will configure the NVT OTP(one time programmable) function which can be used call OTP api.

config NVT_HDAL_BUILD_IN
	bool "Novatek IVOT HDAL for Media device drivers support"
	depends on ARCH_NVT_IVOT_V7
	select NVT_VOS_KWRAP
	select NVT_HDAL_KDRV_BUILTIN
	default n
	help
	  Enable this option will let a part of your hdal driver link to uImage
	  You could select which module want to link in the submenu.

config NVT_PROFILER
	bool "Novatek Profilers"
	depends on PLAT_NOVATEK
	depends on ARM || ARM64
	depends on FTRACE
	select KPROBES
	select KRETPROBES
	select EVENT_TRACING
	default n

config NVT_PERF_MEASURE
        bool "Enable nvt_perf driver for ivot Linux kernel performance measurement"
        depends on ARCH_NVT_IVOT_V7 || ARCH_NVT_IVOT_V8
        default n
        help
                Enable nvt_perf driver for ivot Linux kernel performance measurement

source "drivers/soc/nvt/nvt_hdal/Kconfig"

endmenu
```

## drivers/soc/nvt/nvt_hdal/Kconfig
```kconfig
menu "Novatek HDAL Drivers"

config NVT_DMA_MONITOR
	bool "NVT dma channel monitor"
	depends on ARCH_NVT_IVOT_V7	
	default y
	help
	  This option will configure dma channel monitor for debug.
	  
config NVT_SMALL_HDAL
	bool "NVT small HDAL"
	depends on ARCH_NVT_IVOT_V7	
	default n
	help
	  This option will configure fewer HDAL paths.		   

if NVT_HDAL_BUILD_IN
config NVT_VOS_KWRAP
	bool "Novatek vos basic handling API"
	default y
	depends on NVT_HDAL_BUILD_IN
	help
	  Novatek VOS api to provide basic multi-OS interface.

config NVT_HDAL_KDRV_BUILTIN
	bool "Novatek hdal k-driver built-in part"
	default y
	depends on NVT_HDAL_BUILD_IN
	help
	  Novatek hdal k-driver's built-in

config NVT_FAST_ISP_FLOW
	bool "NVT fast boot isp flow"
	depends on NVT_HDAL_BUILD_IN	
	default y
	help
	  This option will configure fast boot isp table and flow.
endif

endmenu
```

## drivers/soc/sstar/Kconfig
```kconfig
# SPDX-License-Identifier: GPL-2.0
#
# Sigmastar SoC drivers
#
menuconfig SOC_SSTAR
	bool "Sigmastar SOC drivers"

if SOC_SSTAR
config CNTVOFF_INITED
	bool "cntvoff has inited"
	default n
config SS_DTB_NAME
	string "Sstar DTB NAME"
	default ""
	depends on SS_BUILTIN_DTB

config SS_BUILTIN_DTB
	bool "Sstar Builtin DTB"
	default y

config MS_KERNEL_TYPE
	string
	default ""

config SSTAR_CHIP_NAME
	string
	default $(SSTAR_CHIP_NAME)

config SSTAR_SHORT_NAME
	string "Short Name"
	default ""

config SKIP_SQUASHFS_BAD_BLOCK
	bool "Skip squashfs bad block"
	depends on MTD
	default y

config UIMAGE_LOAD_ADDR
	hex "The value of load address in uImage header"
	default 0x20200000

config UIMAGE_ARCH
	string "The CPU architecture specified in uImage header"
	default "arm"

source "drivers/soc/sstar/$(SSTAR_CHIP_NAME)/Kconfig"

endif
```

## drivers/soc/sstar/infinity7/Kconfig
```kconfig
config ARCH_INFINITY7
	bool "SoC infinity7 (ARCH_MULTI_V8)"
	select SOC_BUS
	select ARM_GIC_V3
	select CNTVOFF_INITED
	select VFP
	select VFPv3
	select WIRELESS_EXT if WIRELESS && NET
	select WEXT_PRIV    if WIRELESS && NET
	help
	  Support for infinity7 SoC cortext-a55

config ARCH_INFINITY7_CA7
	bool "SoC infinity7 ca7 (ARCH_MULTI_V7)"
	help
	  Support for infinity7 SoC cortext-a7

config SS_MIU_ARBITRATION
	bool "SigmaStar MIU arbitration"
	default y

config NO_SMP
	bool "Not support SMP, just runing one core"
	default n

config SELECT_MIU0_BUS_BASE
	bool "Select MIU0 bus base address"
	default y

choice
	prompt "CPU view of physical memory start address"
	depends on SELECT_MIU0_BUS_BASE
	default MIU0_AT_20000000

config MIU0_AT_20000000
	bool "0x2000_0000"
	help
	  The MIU0 base address is 0x20000000

config MIU0_AT_1000000000
	bool "0x10_0000_0000"
	help
	  The MIU0 base address is 0x1000000000

endchoice

config MIU0_BUS_BASE
	hex
	default 0x1000000000 if MIU0_AT_1000000000
	default 0x20000000

config ENABLE_METHOD_PSCI
	bool "Core 2/3 enable method with PSCI"
	default y
```

## drivers/soc/sunxi/Kconfig
```kconfig
#
# Allwinner sunXi SoC drivers
#
menuconfig SOC_SUNXI
	bool "SUNXI SoC drivers support"

config SUNXI_ARISC_INF
	tristate "Sunxi arisc driver support"
	default y
	help
	  Say y here to enable the sunxi arisc support.

config SUNXI_FASTBOOT
	tristate "Sunxi fastboot support"
	default n
	help
	  Say y here to enable the sunxi fastboot support.

if SOC_SUNXI

config SUNXI_SRAM
	tristate "Sunxi sram support"
	help
	  Say y here to enable the SRAM controller support. This
	  device is responsible on mapping the SRAM in the sunXi SoCs
	  whether to the CPU/DMA, or to the devices.

config SUNXI_SUSPEND
	tristate "Sunxi suspend support"
	default ARCH_SUNXI
	depends on PM_SLEEP
	help
	  Say y here to enable the sunxi standby support.

config SUNXI_SUSPEND_NONARISC
	tristate "Sunxi suspend support without arisc"
	depends on SUNXI_SUSPEND && !SUNXI_ARISC
	default !SUNXI_ARISC
	help
	  Say y here to enter standby without arisc.

config GPU_PM_DOMAINS
	bool "Allwinner gpu power domain"
	depends on PM
	depends on ARCH_SUN50IW10
	select PM_GENERIC_DOMAINS
	select PM_GENERIC_DOMAINS_OF
	help
	 Say y here to enable power domain support.
	 In order to meet high performance and low power requirements, a power
	 management unit is designed or saving power when gpu in low power
	 mode. The PPU is dedicated for managing the power of the GPU.

	 If unsure, say N.

config SUNXI_PM_DOMAINS
	tristate "Allwinner power domain"
	depends on PM
	select PM_GENERIC_DOMAINS
	select PM_GENERIC_DOMAINS_OF
	select MFD_SYSCON
	help
	 Say y here to enable power domain support.
	 In order to meet high performance and low power requirements, a power
	 management unit is designed or saving power when domain in low power
	 mode. The PPU is dedicated for managing the power of the domain.

	 If unsure, say N.

config SUNXI_POWER_DOMAIN_TEST
	tristate "Allwinner power domain test"
	depends on PM
	depends on SUNXI_PM_DOMAINS
	help
	 Say y here to enable power domain test driver.

config SUNXI_CPUFREQ_TEST
	tristate "Allwinner cpufreq test"
	default m
	help
	 Say y here to enable cpufreq test driver.

source "drivers/soc/sunxi/arisc/Kconfig"
endif # SOC_SUNXI
```

## drivers/sstar/Kconfig
```kconfig
menuconfig MSTAR_DRIVERS
    bool "SStar SoC platform drivers"
    depends on ARCH_SSTAR
    default n

menuconfig CAM_DRIVERS
    bool "SStar Cam drivers"
    depends on MSTAR_DRIVERS
    default n
if ( CAM_DRIVERS )
source "drivers/sstar/camdriver/Kconfig"
endif

menuconfig DLA_DRIVER
    bool "SStar DLA driver"
    depends on MSTAR_DRIVERS
    default n
if ( DLA_DRIVER )
source "drivers/sstar/cambricon/Kconfig"
endif

menuconfig DSP_DRIVER
    bool "SStar Dsp driver"
    depends on MSTAR_DRIVERS
    default n

if ( DSP_DRIVER )
source "drivers/sstar/dsp/Kconfig"
endif

if ( MSTAR_DRIVERS )
source "drivers/sstar/irqchip/Kconfig"
source "drivers/sstar/clocksource/Kconfig"
source "drivers/sstar/msys/Kconfig"
source "drivers/sstar/serial/Kconfig"
source "drivers/sstar/clk/Kconfig"
source "drivers/sstar/flash_isp/Kconfig"
source "drivers/sstar/pwm/Kconfig"
source "drivers/sstar/xor_dma/Kconfig"
source "drivers/sstar/spinand/Kconfig"
source "drivers/sstar/mspi/Kconfig"
source "drivers/sstar/camclk/Kconfig"
source "drivers/sstar/include/mercury6/Kconfig"

source "drivers/sstar/ir/Kconfig"
source "drivers/sstar/i2c/Kconfig"
source "drivers/sstar/gpio/Kconfig"
source "drivers/sstar/padmux/Kconfig"
source "drivers/sstar/rtc/Kconfig"
source "drivers/sstar/watchdog/Kconfig"
source "drivers/sstar/sar/Kconfig"
source "drivers/sstar/sar_key/Kconfig"
source "drivers/sstar/mma_heap/Kconfig"
source "drivers/sstar/netphy/Kconfig"
source "drivers/sstar/voltage/Kconfig"
source "drivers/sstar/voltage_idac/Kconfig"
source "drivers/sstar/iopower/Kconfig"
source "drivers/sstar/gmac/Kconfig"
source "drivers/sstar/swtoe/Kconfig"
source "drivers/sstar/emac_toe/Kconfig"
source "drivers/sstar/adaptor/Kconfig"
source "drivers/sstar/proxyfs/Kconfig"
source "drivers/sstar/gyro/Kconfig"
source "drivers/sstar/keypad/Kconfig"
source "drivers/sstar/sysdesc/Kconfig"
source "drivers/sstar/rpmsg/Kconfig"
source "drivers/sstar/fsp_qspi/Kconfig"
source "drivers/sstar/flash/Kconfig"
source "drivers/sstar/pcie/Kconfig"
source "drivers/sstar/copro/Kconfig"
source "drivers/sstar/drm/Kconfig"
source "drivers/sstar/usb/Kconfig"
source "drivers/sstar/wakeup_source/Kconfig"
endif

config TRACE_CAM_OS_MEM
    bool "SStar trace cam_os_wrapper memory function"
    depends on MSTAR_DRIVERS
    default n
```

## drivers/sstar/adaptor/Kconfig
```kconfig
config SS_RTK_MI_ADAPTOR
depends on SS_DUALOS && !(SS_SWTOE)

bool "SS_RTK_MI_ADAPTOR"
default n

help
Enable compilation option for DualOS RTK MI Adaptor
```

## drivers/sstar/bdma/Kconfig
```kconfig
config MS_BDMA
	bool "Mstar BDMA driver"
	default n

config MS_BDMA_LINE_OFFSET_ON
	bool "BDMA Line-Offset Enable"
	depends on MS_BDMA
	default n

config MS_BDMA_BLIT_WRAPPER
	bool "msys_dma_blit use bdma"
	depends on MS_BDMA
	default n
```

## drivers/sstar/camclk/Kconfig
```kconfig
config CAM_CLK
	bool "CamClk driver driver"
	default n

config CAM_CLK_SYSFS
	bool "CamClk support for sysfs"
	depends on CAM_CLK

config CAMCLK_AUTOENABLE
	bool "CamClk support for auto enable all clk"
	depends on CAM_CLK

config CAM_CLK_PROFILING
	bool "CamClk support for initial profiling"
	depends on CAM_CLK
	depends on SS_PROFILING_TIME

config NOTTOGATED
	bool "CamClk support for not to gated clk gen"
	depends on CAM_CLK
```

## drivers/sstar/copro/infinity7/Kconfig
```kconfig
config ENABLE_CA7
	tristate "SStar copro CA7 driver"
	help
	  SStar copro CA7 driver

if ENABLE_CA7
source "drivers/sstar/copro/infinity7/ca7/Kconfig"
endif
```

## drivers/sstar/copro/infinity7/ca7/Kconfig
```kconfig
config CA7_RTOS_PATH
	string "CA7 RTOS path"
	default "/data/infinity7_ca7.bin"
	help
	  CA7 RTOS path

config CA7_MEM_PHY_ADDR
	hex "CA7 memory physical address"
	default 0x7E000000
	help
	  CA7 memory physical address

config CA7_MEM_PHY_SIZE
	hex "CA7 memory physical size"
	default 0x02000000
	help
	  CA7 memory physical size
```

## drivers/sstar/crypto/Kconfig
```kconfig
config SSTAR_CRYPTO
	tristate "Crypto driver"
	select CRYPTO_AES
	select CRYPTO_ECB
	select CRYPTO_CBC
	select CRYPTO_SHA256
	select CRYPTO_CTR
	select CRYPTO_ALGAPI

help
	Say 'Y' here to use the sstar AES engine
	for the CryptoAPI AES algorithm.
	To compile this driver as a module, choose M here: the module


config SSTAR_AESDMA_INTR
depends on SSTAR_CRYPTO
bool "Enable AES DMA interrupt"
default n
help
	Support interrupt mode for AES operations

config SSTAR_RNG
    bool "HW_RANDOM Random Number Generator support"
    select HW_RANDOM
    depends on SSTAR_CRYPTO

config CRYPTODEV
tristate "Support cryptodev"
default m
help
	Support \dev\crypto
```

## drivers/sstar/drm/Kconfig
```kconfig
config SSTAR_DRM
	tristate "DRM Support for Sigmastar"
	select DRM_KMS_HELPER
	select VIDEOMODE_HELPERS
	select DRM_GEM_CMA_HELPER
	select DRM_KMS_CMA_HELPER
	select DRM_PANEL
	select DRM_DW_HDMI
	select DRM_KMS_FB_HELPER
	depends on DRM
	help
	  enable sigmastar drm graphics support
```

## drivers/sstar/dsp/Kconfig
```kconfig
config SSTAR_DSP
	tristate "Dsp Driver"
	default m
config SSTAR_DSP_UT
	bool "Dsp Ut"
	default y
```

## drivers/sstar/dsp/xrp-kernel/Kconfig
```kconfig
#
# Xtensa Remote Processing kernel driver
#

config XRP
	tristate "XRP driver"
	help
	  This is the core of Cadence Xtensa Remote Processing driver.
	  It should be enabled to support applications communicating with
	  Xtensa DSPs through the XRP API.

	  If unsure, say N.

	  To compile this driver as a module, choose M here: the
	  module will be called xrp.

config XRP_DEBUG
	bool "Debug XRP"
	depends on XRP
	help
	  This enables verbose debug output of the XRP driver.

	  If unsure, say N.

config XRP_HW_SIMPLE
	tristate "XRP for simple hardware"
	depends on XRP
	help
	  This is hardware-specific XRP kernel driver for the simple
	  hardware. It should be enabled to support XRP on simple hardware
	  platforms.

	  If unsure, say N.

	  To compile this driver as a module, choose M here: the
	  module will be called xrp_hw_simple.

config XRP_HW_HIKEY960
	tristate "XRP for HiKey960"
	depends on XRP
	help
	  This is hardware-specific XRP kernel driver for the HiKey960
	  hardware. It should be enabled to support XRP on HiKey960
	  platform.

	  If unsure, say N.

	  To compile this driver as a module, choose M here: the
	  module will be called xrp_hw_hikey960.
```

## drivers/sstar/emac_toe/Kconfig
```kconfig
config MS_EMAC_TOE
select NET
select NET_ETHERNET
select MII
select PACKET
select USE_POLICY_FWD
select INET
select NETDEVICES

tristate "EMAC_TOE"
default n

help
Enable compilation option for driver EMAC

if MS_EMAC
config EMAC_SUPPLY_RNG
bool "Supply to random number generator device"
default n
help
    Supply to random number generator device

config MSTAR_HW_TX_CHECKSUM
bool "Supply to hardware TX checksum"
default n
help
    Supply to hardware TX checksum
    
config K3_RX_SWPATCH
bool "Supply to K3 RX SW Patch"
default n
help
    Supply to K3 RX frame drop due to padding 4 bytes issue

config DISCONNECT_DELAY_S
int "Disconnect delay in second"
default 1
help
    Disconnect delay in second

config MSTAR_EEE
bool "Supply to EEE function"
default n
help
    Supply to EEE function
endif
```

## drivers/sstar/emmc/Kconfig
```kconfig
config MS_EMMC
	tristate "EMMC driver"
	depends on MMC
	help
	  To enable MSTAR EMMC driver.

config MS_EMMC_UNIFY_DRIVER
	tristate "UNIFY EMMC DRIVER"
	depends on MS_EMMC

config MS_EMMC_UT_VERIFY
        bool "Support eMMC UT verify"
        depends on MS_EMMC
        default n
```

## drivers/sstar/flash/Kconfig
```kconfig
config SS_NOR_ONEBIN
    tristate "NOR_ONEBIN Flash driver"
    select MTD

config SS_NAND_ONEBIN
    select MTD_NAND
    tristate "NAND_ONEBIN Flash driver"
    default n

config SS_SOCECC
    tristate "SUPPORT SOC ECC"
    depends on SS_NAND_ONEBIN
    default n
```

## drivers/sstar/flash_isp/Kconfig
```kconfig
config MS_FLASH_ISP

  select MTD
  #select MTD_CHAR
  #select MTD_BLKDEVS
  #select NFTL
  #select NFTL_RW
  #select MTD_OOPS
  
  #select MTD_COMPLEX_MAPPINGS
  #select MTD_BLOCK2MTD
  #select MTD_CMDLINE_PARTS
  #select SCSI_LOWLEVEL
  #select AUTOFS_FS
  
  #select FAT_FS
  #select MSDOS_FS
  #select VFAT_FS
  
  #select MTD_DEBUG
  #select MTD_DEBUG_VERBOSE
  #select MTD_CONCAT
  #select MTD_PARTITIONS
  #select MTD_NAND
  #select JFFS2_FS
  #select JFFS2_FS_DEBUG
  #select JFFS2_FS_WRITEBUFFER

tristate "Serial Flash driver"
default n
help
    Enable compilation option for Serial Flash.
    FSP support Quadread/Daulread/write with BDMA.

if (MS_FLASH_ISP)

config FLASH_ISP_AS_STORAGE
    bool "As Storage Media Only"
    default n
    help
    Use serial flash as a storage medium rather than as boot media

    If you don't know what to do here, say N.

endif
```

## drivers/sstar/fsp_qspi/Kconfig
```kconfig
config SS_FSP_QSPI
    tristate "FSP_QSPI"
    default n

config FSP_QSPI_DUAL_BANK
    bool "FSP QSPI DUAL BANK"
    depends on SS_FSP_QSPI
    default n
```
