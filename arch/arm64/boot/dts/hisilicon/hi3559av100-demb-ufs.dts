/* Copyright (c) 2017 HiSilicon Technologies Co., Ltd.
 *
 * This program is free software; you can redistribute  it and/or modify it
 * under  the terms of  the GNU General  Public License as published by the
 * Free Software Foundation;  either version 2 of the  License, or (at your
 * option) any later version.
 *
 * This program is distributed in the hope that it will be useful,
 * but WITHOUT ANY WARRANTY; without even the implied warranty of
 * MERCHANTABILITY or FITNESS FOR A PARTICULAR PURPOSE. See the
 * GNU General Public License for more details.
 *
 * You should have received a copy of the GNU General Public License
 * along with this program.  If not, see <http://www.gnu.org/licenses/>.
 *
 */
#include <../../../../../include/generated/autoconf.h>

#ifdef CONFIG_ARCH_HISI_BVT_AMP
#include "hi3559av100-demb-amp.dts"
#else
#include "hi3559av100-demb.dts"
#endif

&mmc0 {
	status = "disabled";
};

&ufs {
    status = "okay";
};

