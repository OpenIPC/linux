## arch/arm/mach-mstar/Kconfig
```kconfig
menuconfig ARCH_MSTAR
    bool "MStar ARM SoCs"

if ARCH_MSTAR
config ARCH_CEDRIC
    bool "SoC Cedric (ARCH_MULTI_V7)" if ARCH_MULTI_V7
    select SOC_BUS
    select ARM_GIC        
    select VFP
    select VFPv3

    help
      Support for Cedric SoC

config CEDRIC_MASTER0_ONLY_PATCH
    bool
    depends on ARCH_CEDRIC
    default y

config ARCH_CHICAGO
    bool "SoC Chicago (ARCH_MULTI_V7)" if ARCH_MULTI_V7
    select SOC_BUS       
    select VFP
    select VFPv3

    help
      Support for Chicago SoC

config ARCH_INFINITY
    bool "SoC iNfinity (ARCH_MULTI_V7)" if ARCH_MULTI_V7
    select SOC_BUS
    select ARM_GIC        
    select VFP
    select VFPv3
    select WIRELESS_EXT if WIRELESS && NET
    select WEXT_PRIV    if WIRELESS && NET
    select MULTIPLATFORM_XIP_CAPABLE
    help
      Support for iNfinity SoC

config ARCH_INFINITY3
    bool "SoC iNfinity3 (ARCH_MULTI_V7)" if ARCH_MULTI_V7
    select SOC_BUS
    select ARM_GIC        
    select VFP
    select VFPv3
    select WIRELESS_EXT if WIRELESS && NET
    select WEXT_PRIV    if WIRELESS && NET
    help
      Support for iNfinity3 SoC

comment "Options"
config MS_BUILTIN_DTB
    string "Builtin DTB"
    default ""

config MS_L2X0_PATCH
    bool "L2X0 patch"
    depends on CACHE_L2X0
    default y

config MS_KERNEL_TYPE
	string 
	default ""
	
config MS_ARMV7_XIP
    bool
    default y
	depends on XIP_KERNEL

config MSTAR_CHIP_NAME
    string
    default "infinity3" if ARCH_INFINITY3
    default "infinity" if ARCH_INFINITY
    default "chicago" if ARCH_CHICAGO

endif
```

## arch/arm/mach-nvt-ivot/Kconfig
```kconfig
menu "Novatek Video Processing Platform Common Features"
config NVT_INFO
	bool "NVT IVOT info for time measurement/memory hotplug...etc functions."
	depends on ARCH_NVT_IVOT_V7
	default y
	help
	  Support NVT multi-functions such as boot time measurement/memory hotplug...etc.
	  We provide a tool can be used to measure booting time.
	  e.g.
		$ cat /proc/nvt_info/bootts
		$ cat /proc/nvt_info/memperf

config NVT_CACHE_FLUSH_ALL_FOR_HDAL
	bool "Enable flush/clean all L2 cache operation for HDAL"
	depends on ARCH_NVT_IVOT_V7 && NVT_CACHE_FLUSH_ALL_L2_CACHE
	default y
	help
		Use flush/clean all of L2 cache instead of flush/clean range when flush/clean DRAM size over the order of L2 cache size.

config NVT_CACHE_FLUSH_ALL_THRESHOLD
	int "The threshold of flush all of L2 cache for HDAL"
	depends on NVT_CACHE_FLUSH_ALL_FOR_HDAL
	default 1
	help
		Set a threshold to judgment whether execute flush/clean all L2 cache instead of flush/clean range.
		The threshold is an order of L2 cache size. When flush/clean range over the threshold then All of L2 cache are flushed/cleaned

config NVT_CACHE_FLUSH_ALL_L2_CACHE
	bool "Enable flush/clean all L2 cache operation"
	depends on ARCH_NVT_IVOT_V7
	depends on CACHE_L2X0
	default y
	help
		When flush/clean DRAM size over the order of L2 cache size use flush/clean all of L2 cache instead of flush/clean range.

config NVT_CACHE_FLUSH_ALL_L2_THRESHOLD
	int "The threshold of flush all L2 cache"
	depends on NVT_CACHE_FLUSH_ALL_L2_CACHE
	default 1
	help
		Set a threshold to judgment whether execute flush/clean all L2 cache instead of flush/clean range.
		The threshold is an order of L2 cache size.  When flush/clean range over the threshold then all of L2 cache are flushed/cleaned

config NVT_CACHE_INVALIDATE_ALL_FOR_HDAL
	bool "Enable invalidate all L2 cache operation"
	depends on ARCH_NVT_IVOT_V7 && NVT_CACHE_FLUSH_ALL_L2_CACHE
	default n
	help
		When invalidate DRAM size over L2 cache size use flush all cache instead of invalidate range.

config NVT_CACHE_INVALIDATE_ALL_THRESHOLD
	int "The threshold of invalidate all L2 cache"
	depends on NVT_CACHE_INVALIDATE_ALL_FOR_HDAL
	default 2
	help
		Set a threshold to judgment whether execute flush all L2 cache instead of invalidate range.
		The threshold is an order of L2 cache size. When flush range over the threshold then L2 cache are flushed and invalidated

endmenu
```

## arch/arm/mach-sstar/Kconfig
```kconfig
menuconfig ARCH_SSTAR
	bool "SStar ARM SoCs"

if ARCH_SSTAR

config SS_DUALOS
	bool "SStar Dual-OS"

choice
	prompt "Select types of SStar Dual-OS"
	depends on SS_DUALOS

	config LH_RTOS
		bool "Enable Hypervisor" if ARCH_MULTI_V7
		help
		  Enable LH + RTOS.

	config SS_AMP
		bool "Enable SStar AMP" if ARCH_MULTI_V7
		help
		  Enable SStar AMP.
endchoice

config SS_CLK_IGNORE_UNUSED
	bool "Ignore CLK unuse flow"
	default n

config CNTVOFF_INITED
	bool "cntvoff has inited"
	default n

config MODULES_AREA_SIZE
	hex "Modules area size"
	depends on MMU && THUMB2_KERNEL
	default 0x00800000
	help
	  Config memory use for modules install. Because ARM can only branch relatively within +/- 32MB.
	  If the difference between the lowest module address and the highest of .text is greater than
	  32MB, it's impossible to load modules they will fail to link.

config DISABLE_DUALOS_NODE
	bool "Disable Dual-OS node"
	depends on SS_DUALOS
	default n

comment "Options"
config SS_DTB_NAME
	string "Sstar DTB NAME"
	default ""
	depends on SS_BUILTIN_DTB

config SS_BUILTIN_DTB
	bool "Sstar Builtin DTB"
	default y

config MS_L2X0_PATCH
	bool "L2X0 patch"
	depends on CACHE_L2X0
	default y

config MS_KERNEL_TYPE
	string
	default ""

config MS_ARMV7_XIP
	bool
	default y
	depends on XIP_KERNEL

config SSTAR_CHIP_NAME
	string
	default $(SSTAR_CHIP_NAME)

config SSTAR_SHORT_NAME
	string "Short Name"
	default ""

config MP_IRQ_TRACE
	bool "MP_IRQ_TRACE"
	default n

config SS_GIC_SET_MULTI_CPUS
	bool "Set GIC affinity to multiple CPUs according to affinity_hint"
	depends on SMP
	default y

config SKIP_SQUASHFS_BAD_BLOCK
	bool "Skip squashfs bad block"
	depends on MTD
	default y

menu "Fast boot"
config SS_BUILTIN_UNFDT
	bool "FB_DTS: Builtin unflatted device tree"
	depends on SS_BUILTIN_DTB
	default n

config FB_DTS_SKIP_CRC
	bool "FB_DTS: Skip check DTB CRC "
	default n

config FB_DTS_SCAN_MEMORY_ONCE
	bool "FB_DTS: Only search once for memory node"
	default n

config FB_DTS_SKIP_ATAGS_TO_FDT
	bool "FB_DTS: Search ATAG_INITRD2 and ATAG_CMDLINE from atags instead of early_atags_to_fdt"
	default n

config DISABLE_CLK_DEBUGFS_SUPPORT
	bool "Do not create the debugfs clk directory"
	default y

config DEFERRED_INIICALLS
	bool "Support deferred initcalls"
	default y

config DEFERRED_INIICALLS_SLAB_SYSFS
	bool "defer slab_sysfs_init"
	depends on DEFERRED_INIICALLS
	default n

config DEFERRED_INIICALLS_PARAM_SYSFS
	bool "defer param_sysfs_init"
	depends on DEFERRED_INIICALLS
	default n

config DEFERRED_INIICALLS_PPERF_SYSFS
	bool "defer perf_event_sysfs_init"
	depends on DEFERRED_INIICALLS
	default n

config DEFERRED_INIICALLS_MORE_SYSFS
	bool "defer irq_sysfs_init, init_clocksource_sysfs,clockevents_init_sysfs"
	depends on DEFERRED_INIICALLS
	default n

config DEFERRED_CREATE_DTS_SYSNODE
	bool "defer of_core_init"
	depends on DEFERRED_INIICALLS
	default n

config DEFERRED_LINUX_ADAPTOR_INIT
	bool "defer linux_adaptor_init"
	depends on (DEFERRED_INIICALLS && SS_RTK_MI_ADAPTOR)
	default n

config DEFERRED_CRYPTIO_WQ_INIT
	bool "defer crypto_wq_init"
	depends on DEFERRED_INIICALLS
	default n

config DEFERRED_RTC_HCTOSYS
	bool "defer rtc_hctosys"
	depends on DEFERRED_INIICALLS
	default n

config CRYPTO_MANAGER_NO_TESTS_THREAD
	bool "Do not create cryto test thread"
	depends on CRYPTO_MANAGER_DISABLE_TESTS
	default n

config WAIT_TASK_INACTIVE_SPEED_UP
	bool "WAIT_TASK_INACTIVE speed up"
	depends on SMP
	default y
endmenu

menu "Light memory footprint"
config SS_EMAC_RX_DESC_NUM_CUSTOMIZED
	bool "Customized the number of EMAC Rx descriptors"
	depends on MS_EMAC
	default n

config SS_EMAC_RX_DESC_NUM
	hex "EMAC Rx descriptor number"
	depends on SS_EMAC_RX_DESC_NUM_CUSTOMIZED
	default 0x40
	help
	  more EMAC Rx descriptors can avoid Rx packets loss during CPU busy,
	  however it consumes more memory usage also.
	  0x40 is the minimal value recommended, it should not be less than 0x40.

config SLUB_SYSFS_DISABLE
	bool "Disable slab sysfs"
	depends on SLUB
	default n

config KERNEL_PARAM_SYSFS_DISABLE
	bool "Disable kernel built-in parameters sysfs"
	default n

config DTS_SYSFS_DISABLE
	bool "Disable device tree sysfs"
	default n
endmenu

config MP_DEBUG_TOOL_MEMORY_USAGE_MONITOR
	bool "To monitor the order and migratetype of buddy system pages, and the page_alloc time cose"
	default n

config MP_DEBUG_TOOL_MEMORY_USAGE_TRACE
	bool "Tools to trace all page allocation, we can used it to analysis mem leak, or trace migration failed pages"
	default n

if MP_DEBUG_TOOL_MEMORY_USAGE_TRACE
choice
	prompt "MAX_STACK_COUNT"
	default MAX_STACK_COUNT_2048
config MAX_STACK_COUNT_1024
	bool "1024 count"
config MAX_STACK_COUNT_2048
	bool "2048 count"
config MAX_STACK_COUNT_4096
	bool "4096 count"
config MAX_STACK_COUNT_6144
	bool "6144 count"
config MAX_STACK_COUNT_8192
	bool "8192 count"
endchoice

endif

config SS_PM_POWER_SAVING_SCHEME
	bool "Enable power saving scheme when entring PM suspend."
	default n

if SS_PM_POWER_SAVING_SCHEME

config SS_PM_POWER_SAVING_DEBUG_MODE
    bool "Debug STR power saving mode"
	default n
    help
      Help to debug in power saving mode by not disable critical powers.

choice
    prompt "Select power saving scheme when going suspend"
    default SS_PM_NORMAL

config SS_PM_USB_SUSPEND_MODE
    bool "USB suspend mode"
    help
      When system enter USB suspend mode, all clock will be gating and waiting for
      USB wakeup interrupt.

config SS_PM_VAD_LOOP_MODE
    bool "VAD loop mode"
    help
      When system enter VAD loop mode, the voice data through ADC and
      Bach engine then write voice data to IMI. SW only need to allocate
      one buffer and Bach engine will use ring buffer mode to store audio data.

config SS_PM_VAD_INT_MODE
    bool "VAD interrupt mode"
    help
      When system enter VAD INT mode, the audio data will not
      be stored until the interrupt is received. This mode will
      gating all clk except for 12M_CORE_v_live.

config SS_PM_NORMAL
    bool "Low power mode"
    help
      CPU enters WFI mode. When the interrupt is activated then cpu wakes up. This mode will keep xtal.

config SS_PM_AOV
    bool "For AOV scenario"
    help
      For AOV scenario.

endchoice

endif

source "arch/arm/mach-sstar/$(SSTAR_CHIP_NAME)/Kconfig"

endif
```

## arch/arm/mach-sstar/infinity2m/Kconfig
```kconfig
config ARCH_INFINITY2M
    bool "SoC iNfinity2m (ARCH_MULTI_V7)" if ARCH_MULTI_V7
    select SOC_BUS
    select ARM_GIC
    select VFP
    select VFPv3
    select WIRELESS_EXT if WIRELESS && NET
    select WEXT_PRIV    if WIRELESS && NET
    help
      Support for iNfinity2m SoC

config INFINITY2M_FPGA
    bool "iNfinity2m FPGA environment" if ARCH_INFINITY2M
    depends on ARCH_INFINITY2M
    help
      Support for iNfinity2m FPGA environment
```

## arch/arm/mach-sstar/infinity6e/Kconfig
```kconfig
config ARCH_INFINITY6E
    bool "SoC iNfinity6E (ARCH_MULTI_V7)" if ARCH_MULTI_V7
    select SOC_BUS
    select ARM_GIC
    select VFP
    select VFPv3
    select WIRELESS_EXT if WIRELESS && NET
    select WEXT_PRIV    if WIRELESS && NET
    help
      Support for iNfinity6E SoC

config SS_PROFILING_TIME
    bool "Record timestamp in sram"
    default y

config SS_MIU_ARBITRATION
    bool "SigmaStar MIU arbitration"
    default y

config SS_LOWPWR_STR
    bool "SigmaStar STR (Suspend-to-RAM) in low-power state"
    default y
	depends on PM_SLEEP
    help
      Support STR (Suspend-to-RAM) in low-power state.
      In that state, chip top is kept alive and most engines' clock are gated.
      Also, part of ananlog blocks are powered off to saving more power.

config SS_USB_LOWPWR_SUSPEND
    bool "Support USB suspend to low power STR, and wake up by USB resume"
    default y if USB_DWC3_GADGET
	depends on SS_LOWPWR_STR
    help
      Support USB suspend to low-power mode STR (Suspend-to-RAM).
      In that state, system can wake up in detecting USB resume signal.
```

## arch/arm/mach-sstar/mercury6/Kconfig
```kconfig
config ARCH_MERCURY6
    bool "SoC mercury6 (ARCH_MULTI_V7)" if ARCH_MULTI_V7
    select SOC_BUS
    select ARM_GIC_V3
    select CNTVOFF_INITED
    select VFP
    select VFPv3
    select WIRELESS_EXT if WIRELESS && NET
    select WEXT_PRIV    if WIRELESS && NET
    help
      Support for MERCURY6 SoC

config ARCH_MERCURY6_CA7
    bool "SoC mercury6 (ARCH_MULTI_V7)" if ARCH_MULTI_V7
    select SOC_BUS
    select ARM_GIC
    select CNTVOFF_INITED
    select VFP
    select VFPv3
    select WIRELESS_EXT if WIRELESS && NET
    select WEXT_PRIV    if WIRELESS && NET
    help
      Support for MERCURY6 SoC

config SS_MIU_ARBITRATION
    bool "SigmaStar MIU arbitration"
    default y
```

## arch/arm/mach-sstar/mercury6p/Kconfig
```kconfig
config ARCH_MERCURY6P
    bool "SoC mercury6p (ARCH_MULTI_V7)" if ARCH_MULTI_V7
    select SOC_BUS
    select ARM_GIC_V3
    select CNTVOFF_INITED
    select VFP
    select VFPv3
    select WIRELESS_EXT if WIRELESS && NET
    select WEXT_PRIV    if WIRELESS && NET
    help
      Support for MERCURY6P SoC

config SS_MIU_ARBITRATION
    bool "SigmaStar MIU arbitration"
    default y

config SELECT_MIU0_BUS_BASE
    bool "Select MIU0 bus base address"
    depends on ARCH_SSTAR
    default y

choice
    prompt "CPU view of physical memory start address"
    depends on SELECT_MIU0_BUS_BASE
    default MIU0_AT_20000000

config MIU0_AT_20000000
    bool "0x20000000"
    help
      The MIU0 base address is 0x20000000

config MIU0_AT_1000000000
    bool "0x1000000000"
    select ARM_LPAE
    select ARCH_DMA_ADDR_T_64BIT
    help
      The MIU0 base address is 0x1000000000

endchoice

config MIU0_BUS_BASE
    hex
    default 0x1000000000 if MIU0_AT_1000000000
    default 0x20000000

config MIU0_DMA_PFN_OFFSET
    bool "Enable to use dma_pfn_offset to make DMA APIs (dev != NULL) to use 0x20000000-based dma_addr_t (for test and debug purposes only)"
    depends on MIU0_AT_1000000000
    default n
```

## arch/arm/mach-xm510/Kconfig
```kconfig
menu "xm510 board feature"

config MACH_XM510
	bool "Support xm510 platform"
	select CPU_V7
	select PL330
	help
	  Includes support for the hisilion xm510 platform.

	  This includes specific configurations for the module and
	  its peripherals.

config DEFAULT_BUSCLK
	int "DEFAULT_BUSCLK"
	default "50000000"
	help
	  Default AHB clock rate

endmenu
```
