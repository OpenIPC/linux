/*
* infinity2m-scc010a-s01a-padmux.dts - Sigmastar
*
* Copyright (C) 2018 Sigmastar Technology Corp.
*
* Author: Joe.Su <joe.su@sigmastar.com.tw>
*
* This software is licensed under the terms of the GNU General Public
* License version 2, as published by the Free Software Foundation, and
* may be copied, distributed, and modified under those terms.
*
* This program is distributed in the hope that it will be useful,
* but WITHOUT ANY WARRANTY; without even the implied warranty of
* MERCHANTABILITY or FITNESS FOR A PARTICULAR PURPOSE.  See the
* GNU General Public License for more details.
*
*/

#include <../../../../drivers/sstar/include/infinity6e/padmux.h>
#include <../../../../drivers/sstar/include/mdrv_puse.h>

/ {
    soc {
         padmux {
            compatible = "sstar-padmux";
            schematic =
                //<PAD_GPIO0  >,
                //<PAD_GPIO1          PINMUX_FOR_GPIO_MODE        MDRV_PUSE_I2C1_DEV_RESET >,
                //<PAD_GPIO2          PINMUX_FOR_I2C1_MODE_1      MDRV_PUSE_I2C1_SCL >,
                //<PAD_GPIO3          PINMUX_FOR_I2C1_MODE_1      MDRV_PUSE_I2C1_SDA >,
                //<PAD_GPIO4          PINMUX_FOR_EJ_MODE_3        MDRV_PUSE_EJ_TCK >,
                //<PAD_GPIO5          PINMUX_FOR_EJ_MODE_3        MDRV_PUSE_EJ_TMS >,
                //<PAD_GPIO6          PINMUX_FOR_EJ_MODE_3        MDRV_PUSE_EJ_TDO >,
                //<PAD_GPIO7          PINMUX_FOR_EJ_MODE_3        MDRV_PUSE_EJ_TDI >,
                //<PAD_GPIO8  >,
                //<PAD_GPIO9  >,
                //<PAD_GPIO10  >,
                //<PAD_GPIO11         PINMUX_FOR_GPIO_MODE        MDRV_PUSE_I2CSW_SCL>,
                //<PAD_GPIO12         PINMUX_FOR_GPIO_MODE        MDRV_PUSE_I2CSW_SDA>,
                //<PAD_GPIO13         PINMUX_FOR_GPIO_MODE        MDRV_PUSE_I2C1_DEV_IRQ >,
                //<PAD_GPIO14  >,

                //<PAD_GPIO0              PINMUX_FOR_PWM0_MODE_2          MDRV_PUSE_PWM0>, //Reserved for sensor I2C
                //<PAD_GPIO1              PINMUX_FOR_PWM1_MODE_2          MDRV_PUSE_PWM1>, //Reserved for sensor I2C
                <PAD_GPIO9              PINMUX_FOR_GPIO_MODE            MDRV_PUSE_PWM1>, //Reserved for sensor reset
                <PAD_I2S0_BCK           PINMUX_FOR_PWM4_MODE_5          MDRV_PUSE_PWM4>,
                <PAD_I2S0_WCK           PINMUX_FOR_PWM5_MODE_5          MDRV_PUSE_PWM5>,
                <PAD_I2S0_DI            PINMUX_FOR_PWM6_MODE_5          MDRV_PUSE_PWM6>,
                <PAD_I2S0_DO            PINMUX_FOR_PWM7_MODE_5          MDRV_PUSE_PWM7>,
                <PAD_PM_GPIO0           PINMUX_FOR_PWM8_MODE_8          MDRV_PUSE_PWM8>,
                
                <PAD_SD0_GPIO0           PINMUX_FOR_GPIO_MODE            MDRV_PUSE_SDIO0_PWR>,
                <PAD_SD0_CLK             PINMUX_FOR_SD0_MODE             MDRV_PUSE_SDIO0_CLK>,
                <PAD_SD0_CMD             PINMUX_FOR_SD0_MODE             MDRV_PUSE_SDIO0_CMD>,
                <PAD_SD0_D0              PINMUX_FOR_SD0_MODE             MDRV_PUSE_SDIO0_D0>,
                <PAD_SD0_D1              PINMUX_FOR_SD0_MODE             MDRV_PUSE_SDIO0_D1>,
                <PAD_SD0_D2              PINMUX_FOR_SD0_MODE             MDRV_PUSE_SDIO0_D2>,
                <PAD_SD0_D3              PINMUX_FOR_SD0_MODE             MDRV_PUSE_SDIO0_D3>,
                <PAD_SD0_CDZ             PINMUX_FOR_SD0_CDZ_MODE         MDRV_PUSE_SDIO0_CDZ>,

                <PAD_SD1_GPIO0           PINMUX_FOR_GPIO_MODE            MDRV_PUSE_SDIO1_PWR>,
		//QFN
#if 0
                <PAD_I2S0_WCK            PINMUX_FOR_SD1_MODE_2           MDRV_PUSE_SDIO1_CLK>,
                <PAD_I2S0_DI             PINMUX_FOR_SD1_MODE_2           MDRV_PUSE_SDIO1_CMD>,
                <PAD_I2S0_BCK            PINMUX_FOR_SD1_MODE_2           MDRV_PUSE_SDIO1_D0>,
                <PAD_I2S0_MCLK           PINMUX_FOR_SD1_MODE_2           MDRV_PUSE_SDIO1_D1>,
                <PAD_I2C0_SCL            PINMUX_FOR_SD1_MODE_2           MDRV_PUSE_SDIO1_D2>,
                <PAD_I2S0_DO             PINMUX_FOR_SD1_MODE_2           MDRV_PUSE_SDIO1_D3>,
                <PAD_I2C0_SDA            PINMUX_FOR_SD1_CDZ_MODE_2       MDRV_PUSE_SDIO1_CDZ>,
#endif
				
				#if 0
				//for TTL 16bit mode 1
				<PAD_SR1_IO02			 PINMUX_FOR_TTL16_MODE_1 		 MDRV_PUSE_TTL_DOUT15>,
				<PAD_SR1_IO03			 PINMUX_FOR_TTL16_MODE_1 		 MDRV_PUSE_TTL_DOUT14>,
				<PAD_SR1_IO04			 PINMUX_FOR_TTL16_MODE_1 		 MDRV_PUSE_TTL_DOUT13>,
				<PAD_SR1_IO05			 PINMUX_FOR_TTL16_MODE_1 		 MDRV_PUSE_TTL_DOUT12>,
				<PAD_SR1_IO06			 PINMUX_FOR_TTL16_MODE_1 		 MDRV_PUSE_TTL_DOUT11>,
				<PAD_SR1_IO07			 PINMUX_FOR_TTL16_MODE_1 		 MDRV_PUSE_TTL_DOUT10>,
				<PAD_SR1_IO08			 PINMUX_FOR_TTL16_MODE_1 		 MDRV_PUSE_TTL_DOUT09>,
				<PAD_SR1_IO09			 PINMUX_FOR_TTL16_MODE_1 		 MDRV_PUSE_TTL_DOUT08>,
				<PAD_SR1_IO10			 PINMUX_FOR_TTL16_MODE_1 		 MDRV_PUSE_TTL_DOUT07>,
				<PAD_SR1_IO11			 PINMUX_FOR_TTL16_MODE_1 		 MDRV_PUSE_TTL_DOUT06>,
				<PAD_SR1_IO14			 PINMUX_FOR_TTL16_MODE_1 		 MDRV_PUSE_TTL_DOUT05>,
				<PAD_SR1_IO15			 PINMUX_FOR_TTL16_MODE_1 		 MDRV_PUSE_TTL_DOUT04>,
				<PAD_SR1_IO16			 PINMUX_FOR_TTL16_MODE_1 		 MDRV_PUSE_TTL_DOUT03>,
				<PAD_SR1_IO17			 PINMUX_FOR_TTL16_MODE_1 		 MDRV_PUSE_TTL_DOUT02>,
				<PAD_SR1_IO18			 PINMUX_FOR_TTL16_MODE_1 		 MDRV_PUSE_TTL_DOUT01>,
				<PAD_SR1_IO19			 PINMUX_FOR_TTL16_MODE_1 		 MDRV_PUSE_TTL_DOUT00>,
				<PAD_GPIO12			 	 PINMUX_FOR_TTL16_MODE_1 		 MDRV_PUSE_TTL_VSYNC>,
				<PAD_GPIO13			 	 PINMUX_FOR_TTL16_MODE_1 		 MDRV_PUSE_TTL_HSYNC>,
				<PAD_GPIO14			 	 PINMUX_FOR_TTL16_MODE_1 		 MDRV_PUSE_TTL_CLK>,
				<PAD_GPIO15		 		 PINMUX_FOR_TTL16_MODE_1 		 MDRV_PUSE_TTL_DE>,
				#endif
				#if 1
				//for TTL 16bit mode 4
				<PAD_I2S0_MCLK			 PINMUX_FOR_TTL16_MODE_4 		 MDRV_PUSE_TTL_DOUT15>,
				<PAD_I2S0_BCK			 PINMUX_FOR_TTL16_MODE_4 		 MDRV_PUSE_TTL_DOUT14>,
				<PAD_I2S0_WCK			 PINMUX_FOR_TTL16_MODE_4 		 MDRV_PUSE_TTL_DOUT13>,
				<PAD_I2S0_DI			 PINMUX_FOR_TTL16_MODE_4 		 MDRV_PUSE_TTL_DOUT12>,
				<PAD_I2S0_DO			 PINMUX_FOR_TTL16_MODE_4 		 MDRV_PUSE_TTL_DOUT11>,
				<PAD_I2C0_SCL			 PINMUX_FOR_TTL16_MODE_4 		 MDRV_PUSE_TTL_DOUT10>,
				<PAD_I2C0_SDA			 PINMUX_FOR_TTL16_MODE_4 		 MDRV_PUSE_TTL_DOUT09>,
				<PAD_ETH_LED0			 PINMUX_FOR_TTL16_MODE_4 		 MDRV_PUSE_TTL_DOUT08>,
				<PAD_ETH_LED1			 PINMUX_FOR_TTL16_MODE_4 		 MDRV_PUSE_TTL_DOUT07>,
				<PAD_FUART_RX			 PINMUX_FOR_TTL16_MODE_4 		 MDRV_PUSE_TTL_DOUT06>,
				<PAD_FUART_TX			 PINMUX_FOR_TTL16_MODE_4 		 MDRV_PUSE_TTL_DOUT05>,
				<PAD_FUART_CTS			 PINMUX_FOR_TTL16_MODE_4 		 MDRV_PUSE_TTL_DOUT04>,
				<PAD_FUART_RTS			 PINMUX_FOR_TTL16_MODE_4 		 MDRV_PUSE_TTL_DOUT03>,
				<PAD_GPIO0			 	PINMUX_FOR_TTL16_MODE_4 		 MDRV_PUSE_TTL_DOUT02>,
				<PAD_GPIO1			 	PINMUX_FOR_TTL16_MODE_4 		 MDRV_PUSE_TTL_DOUT01>,
				<PAD_GPIO8			 	 PINMUX_FOR_TTL16_MODE_4 		 MDRV_PUSE_TTL_DOUT00>,
				<PAD_GPIO12			 	 PINMUX_FOR_TTL16_MODE_4 		 MDRV_PUSE_TTL_VSYNC>,
				<PAD_GPIO13			 	 PINMUX_FOR_TTL16_MODE_4 		 MDRV_PUSE_TTL_HSYNC>,
				<PAD_GPIO14			 	 PINMUX_FOR_TTL16_MODE_4 		 MDRV_PUSE_TTL_CLK>,
				<PAD_GPIO15		 		 PINMUX_FOR_TTL16_MODE_4 		 MDRV_PUSE_TTL_DE>,
				
				#endif
				
				
//                <PAD_ETH_LED0            PINMUX_FOR_LED0_MODE_1          MDRV_PUSE_EMAC0_LED>,
//                <PAD_ETH_LED1            PINMUX_FOR_LED1_MODE_2          MDRV_PUSE_EMAC1_LED>,
                //<PAD_FUART_RX  >,
                //<PAD_FUART_TX       PINMUX_FOR_GPIO_MODE        MDRV_PUSE_UTMI_POWER>,
                //<PAD_FUART_CTS       PINMUX_FOR_GPIO_MODE       MDRV_PUSE_CPUFREQ_VID0>,
                //<PAD_FUART_RTS           PINMUX_FOR_GPIO_MODE            MDRV_PUSE_FUART_RTS>,
                //<PAD_TTL0            PINMUX_FOR_TTL_MODE_1      MDRV_PUSE_TTL_DOUT00 >,
                //<PAD_TTL0         PINMUX_FOR_SDIO_MODE_1      MDRV_PUSE_SDIO0_PWR >,
                <GPIO_NR                 PINMUX_FOR_UNKNOWN_MODE         MDRV_PUSE_NA>;
            status = "ok"; // ok or disable
            //status = "disable";
        };

    };

};
