/*
 * AK3918EV300 (and its AK3916/AK3919 packages) as OpenIPC boots it: the
 * EV330 board of ak3918ev330-demb, with the bootargs, memory, ISP pool,
 * MIPI/DVP and RMII pads and UART0 it sets up, on the AnyCloud39EV300
 * silicon that came before the EV330.
 */

#include "ak3918ev330-demb.dts"
#include "anycloud_ak3918ev300.dtsi"

/ {
	model = "AK3918EV300 (OpenIPC)";
	compatible = "anyka,ak3918ev300";
};

/*
 * Every board in the Cloud39EV300 SDK runs the SD slot 1-bit on pads 31-33
 * (mci1_plat_data .bus_width = MCI_BUS_WIDTH_1), and so does Anyka's own
 * U-Boot for it. The EVB's D1-D3 on pads 34, 80 and 81 are not SD data on
 * EV300 boards: 4-bit reads fail with -EILSEQ on every block
 * (OpenIPC/firmware#2639).
 */
&mci0_pins {
	anyka,pins = <31 32 33>;
	anyka,function = <1>;
	anyka,pull = <0x00000010>;
};

&mmc0 {
	bus-width = <1>;
};

/*
 * The MIPI pads need no mux on EV300. The EV330 groups this board inherits
 * (pins 70-75, functions 3 and 2) write 0x01F80000 into SHAREPIN_CON1
 * (sysctrl 0x78), and with those bits set the ISP never sees a frame. The
 * stock EV300 kernel's MIPI pin group writes nothing, and 0x78 reads 0 while
 * it streams (OpenIPC/firmware#2639, TECKIN TC100 with a JX-F23). So EV300
 * keeps the DVP pads as they are and only the D-PHY is switched to MIPI.
 */
&isp {
	pinctrl-names = "default";
	/delete-property/ pinctrl-1;
	/delete-property/ pinctrl-2;
};
