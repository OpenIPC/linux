/*
 * Cloud39EV2 as OpenIPC boots it. The vendor bootargs in the SoC dtsi point
 * root= and init= at the Anyka rootfs layout; these are the defaults for
 * OpenIPC's NOR layout, used whenever U-Boot passes no command line of its
 * own. U-Boot's bootargs, when present, still replace them.
 */

#include "ak3918en080_v200.dts"

/ {
	chosen {
		bootargs = "console=ttySAK0,115200n8 root=/dev/mtdblock3 rootfstype=squashfs init=/init mem=64M memsize=64M mtdparts=spi0.0:256k(boot),64k(env),2048k(kernel),5120k(rootfs),-(rootfs_data)";
	};
};

/*
 * EV200 has the same Synopsys GMAC as EV300/EV330: its own vendor firmware
 * drives it with the SDK's synopGMAC driver. The pad mux for its RMII pins
 * is not in this tree's EV200 pinctrl table, so the pads stay as U-Boot set
 * them, and there is no PHY reset line: both are board wiring.
 */
&ethernet {
	status = "okay";
};

/*
 * The SDK board's key is on GPIO 47; cameras wire theirs elsewhere, and a
 * button is board wiring, so the generic board declares none.
 */
&gpiokeys {
	status = "disabled";
};
