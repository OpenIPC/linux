/*
 * The AnyCloud39AV100 SDK's EVB_CBDM_AK3918AV100N board: the 64 MB AK3918AV100N/P
 * and KM01N, as OpenIPC boots it.
 *
 * The bootargs are the defaults for OpenIPC's NOR layout, used whenever
 * U-Boot passes no command line of its own; U-Boot's bootargs, when present,
 * still replace them. The NOR sits on SPI0 under ak_spiflash, so mtdparts=
 * names spi0.0. The SoC dtsi's ION reservation stays: the SDK's ISP and
 * encoder modules allocate from it.
 */

#include "EVB_CBDM_AK3918AV100N_V1.0.0.dts"

/ {
	chosen {
		bootargs = "console=ttySAK0,115200n8 root=/dev/mtdblock3 rootfstype=squashfs init=/init mem=64M memsize=64M mtdparts=spi0.0:256k(boot),64k(env),2048k(kernel),5120k(rootfs),-(rootfs_data)";
	};
};
