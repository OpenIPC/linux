/*
 * The 128 MB parts, AK3918EV331 and its AK3916/AK3919 packages: the EV300/
 * EV330 board with the memory Anyka's anycloud_ak39ev331.dtsi gives them.
 */

#include "ak3918ev300-demb.dts"

/ {
	compatible = "anyka,ak3918ev331";

	chosen {
		bootargs = "console=ttySAK0,115200n8 root=/dev/mtdblock3 rootfstype=squashfs init=/init mem=128M memsize=128M mtdparts=spi0.0:256k(boot),64k(env),2048k(kernel),5120k(rootfs),-(rootfs_data)";
	};

	memory {
		reg = <0x80000000 0x08000000>;
	};
};
