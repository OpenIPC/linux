/*
 * Copyright (c) 2014 MundoReader S.L.
 * Author: Matthias Brugger <matthias.bgg@gmail.com>
 *
 * This program is free software; you can redistribute it and/or modify
 * it under the terms of the GNU General Public License as published by
 * the Free Software Foundation; either version 2 of the License, or
 * (at your option) any later version.
 *
 * This program is distributed in the hope that it will be useful,
 * but WITHOUT ANY WARRANTY; without even the implied warranty of
 * MERCHANTABILITY or FITNESS FOR A PARTICULAR PURPOSE.  See the
 * GNU General Public License for more details.
 */

/dts-v1/;
#include "chicago.dtsi"

/ {
	model = "CHICAGO XXXXX Board";
	compatible = "mstar,chicago";
	

	chosen {
		bootargs = "console=ttyS0,115200n8r androidboot.console=ttyS0 root=/dev/ram rootwait";
		linux,initrd-start = <0x25000000>;
		linux,initrd-end =   <0x25040000>;
	};

	memory {
		reg = <0x20000000 0x07000000>;
	};
};
