/*
 * AK3918AV130 dev board dts
 *
 * Copyright (C) 2020 Anyka(Guangzhou) Microelectronics Technology Co., Ltd.
 *
 * This program is free software; you can redistribute it and/or modify
 * it under the terms of the GNU General Public License as published by
 * the Free Software Foundation; either version 2 of the License, or
 * (at your option) any later version.
 *
 * This program is distributed in the hope that it will be useful,
 * but WITHOUT ANY WARRANTY; without even the implied warranty of
 * MERCHANTABILITY or FITNESS FOR A PARTICULAR PURPOSE.  See the
 * GNU General Public License for more details.
 */

/dts-v1/;
#include "anycloud_ak3918av130.dtsi"
#include "EVB_CBDM_AK3918AV130L_V1.0.0.dtsi"


/ {
    compatible = "anyka,ak3918av130";
    model = "EVB_CBDM_AK3918AV130_V1.0.0 board";
    version = "V1.0.00";
};
