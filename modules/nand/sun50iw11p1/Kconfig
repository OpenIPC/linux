## modules/nand/sun50iw11p1/Kconfig
```kconfig
choice
	prompt "choice spinand or rawnand"
	depends on (SUNXI_NAND)

config SUNXI_RAWNAND
	tristate "sunxi raw nand driver"

config	SUNXI_SPINAND
	tristate "sunxi spi nand driver"

endchoice
```

## sound/soc/ambarella/Kconfig
```kconfig
config SND_AMBARELLA_SOC
	tristate "SoC Audio for the Ambarella chips"
	depends on PLAT_AMBARELLA && SND_SOC
	select SND_SOC_GENERIC_DMAENGINE_PCM
	help
	  Say Y or M if you want to add support for codecs attached to
	  the AMBARELLA I2S interface. You will also need
	  to select the audio interfaces to support below.

config SND_AMBARELLA_SOC_I2S
	tristate

menuconfig SND_AMBARELLA_BOARD
	tristate "Ambarella Board Type"
	depends on SND_AMBARELLA_SOC
	help
	  Say Y or M to select specific ambarella board.

if SND_AMBARELLA_BOARD

config AMBA_BOARD
	tristate "Ambarella General Board"
	depends on SND_AMBARELLA_SOC
	select SND_AMBARELLA_SOC_I2S
	select SND_SOC_AMBARELLA_DUMMY
	help
	  Say Y if you want to use ALSA driver on Ambarella General Board.

endif

menuconfig SND_AMBARELLA_CODEC
	tristate "Select Codec for Ambarella Platform"
	depends on SND_AMBARELLA_SOC
	help
	  Say Y or M to select specific Codec for Ambarella Platform.

if SND_AMBARELLA_CODEC

config SND_SOC_AK4642_AMB
	tristate "AK4642 for Ambarella Platform"
	help
		Support AK4642 for Ambarella Platform.

config SND_SOC_AK4951_AMB
	tristate "AK4951 for Ambarella Platform"
	help
		Support AK4951 for Ambarella Platform.

config SND_SOC_AK4954_AMB
	tristate "AK4954 for Ambarella Platform"
	help
		Support AK4951 for Ambarella Platform.

config SND_SOC_AK7719_DSP
	tristate "AK7719_DSP for Ambarella Platform"
	depends on SND_AMBARELLA_SOC && (SND_SOC_AK4954_AMB || SND_SOC_AK4951_AMB)
	help
	  Say Y if you want to add AK7719 DSP support for
	  SoC audio on Ambarella Board.
	  and the AK7719_DSP should be modprobed before AK4954/AK4951.

config SND_SOC_AK7755
	tristate "AK7755 for Ambarella Platform"
	help
		Support AK7755 for Ambarella Platform.

config SND_SOC_TLV320ADC3xxx
	tristate "TLV320ADC3xxx for Ambarella Platform"
	help
		Support TLV320ADC3xxx for Ambarella Platform.

config SND_SOC_ES8388
	tristate "ES8388 for Ambarella Platform"
	help
		Support ES8388 Audio Codec for Ambarella Platform.

config SND_SOC_ES8374
	tristate "ES8374 for Ambarella Platform"
	help
		ES8374 Audio Codec for Ambarella Platform.

config SND_SOC_WM8974_AMB
	tristate "WM8974 for Ambarella Platform"
	help
		Support WM8974 Audio Codec for Ambarella Platform.

config SND_SOC_WM8940_AMB
	tristate "WM8940 for Ambarella Platform"
	help
		Support WM8940 Audio Codec for Ambarella Platform

config SND_SOC_ZL380TW
	tristate "ZL380XX for Ambarella Platform"
	help
		Support ZL380XX Audio Codec for Ambarella Platform

config SND_SOC_RT5670
	tristate "RT5670 for Ambarella Platform"
	help
		Support RT5670 Audio Codec for Ambarella Platform

config SND_SOC_AMBARELLA_DUMMY
	tristate "Dummy Codec for Ambarella Platform"
	help
		Support Dummy Codec for Ambarella Platform

endif
```

## sound/soc/davinci/Kconfig
```kconfig
config SND_DAVINCI_SOC
	tristate "SoC Audio for the TI DAVINCI chip"
	depends on ARCH_DAVINCI
	help
	  Say Y or M if you want to add support for codecs attached to
	  the DAVINCI AC97 or I2S interface. You will also need
	  to select the audio interfaces to support below.

config SND_DAVINCI_SOC_I2S
	tristate

config SND_DAVINCI_SOC_MCASP
	tristate

config SND_DAVINCI_SOC_VCIF
	tristate

config SND_DAVINCI_SOC_EVM
	tristate "SoC Audio support for DaVinci DM6446, DM355 or DM365 EVM"
	depends on SND_DAVINCI_SOC
	depends on MACH_DAVINCI_EVM || MACH_DAVINCI_DM355_EVM || MACH_DAVINCI_DM365_EVM
	select SND_DAVINCI_SOC_I2S
	select SND_SOC_TLV320AIC3X
	help
	  Say Y if you want to add support for SoC audio on TI
	  DaVinci DM6446, DM355 or DM365 EVM platforms.

choice
	prompt "DM365 codec select"
	depends on SND_DAVINCI_SOC_EVM
	depends on MACH_DAVINCI_DM365_EVM

config SND_DM365_AIC3X_CODEC
	bool "Audio Codec - AIC3101"
	help
	  Say Y if you want to add support for AIC3101 audio codec

config SND_DM365_VOICE_CODEC
	bool "Voice Codec - CQ93VC"
	select MFD_DAVINCI_VOICECODEC
	select SND_DAVINCI_SOC_VCIF
	select SND_SOC_CQ0093VC
	help
	  Say Y if you want to add support for SoC On-chip voice codec
endchoice

choice
 	prompt "Voice Codec Sampling Frequency"
 	depends on SND_DM365_VOICE_CODEC
 	default SND_DM365_VOICE_CODEC_16KHZ
config SND_DM365_VOICE_CODEC_8KHZ
 	bool "Fs=8kHz"
config SND_DM365_VOICE_CODEC_16KHZ
 	bool "Fs=16kHz"
 
endchoice
 
config SND_DM365_SHOWFREQ
 	bool "Show clocks at Linux startup (Debug feature)"
 	depends on SND_DM365_VOICE_CODEC
 	help
 	  Select this item if you want to see very useful clock info at Linux startup.
           This info printout show PLL1 and PLL2 controller configuration. You can see VoiceCodec, ARMcore, HDVICP, DDR clocks etc.
           It is useful for first startups. If you're tired of looking at this listing then simply unmark this config item.


config  SND_DM6467_SOC_EVM
	tristate "SoC Audio support for DaVinci DM6467 EVM"
	depends on SND_DAVINCI_SOC && MACH_DAVINCI_DM6467_EVM
	select SND_DAVINCI_SOC_MCASP
	select SND_SOC_TLV320AIC3X
	select SND_SOC_SPDIF

	help
	  Say Y if you want to add support for SoC audio on TI

config SND_DAVINCI_SOC_SFFSDR
	tristate "SoC Audio support for SFFSDR"
	depends on SND_DAVINCI_SOC && MACH_SFFSDR
	select SND_DAVINCI_SOC_I2S
	select SND_SOC_PCM3008
	select SFFSDR_FPGA
	help
	  Say Y if you want to add support for SoC audio on
	  Lyrtech SFFSDR board.

config  SND_DA830_SOC_EVM
	tristate "SoC Audio support for DA830/OMAP-L137 EVM"
	depends on SND_DAVINCI_SOC && MACH_DAVINCI_DA830_EVM
	select SND_DAVINCI_SOC_MCASP
	select SND_SOC_TLV320AIC3X

	help
	  Say Y if you want to add support for SoC audio on TI
	  DA830/OMAP-L137 EVM

config  SND_DA850_SOC_EVM
	tristate "SoC Audio support for DA850/OMAP-L138 EVM"
	depends on SND_DAVINCI_SOC && MACH_DAVINCI_DA850_EVM
	select SND_DAVINCI_SOC_MCASP
	select SND_SOC_TLV320AIC3X
	help
	  Say Y if you want to add support for SoC audio on TI
	  DA850/OMAP-L138 EVM
```

## sound/soc/dwc/Kconfig
```kconfig
config SND_FULLHAN_SOC
	tristate "SoC Audio for the FULLHAN System-on-Chip"
	help
	  Say Y or M if you want to add support for codecs attached to
	  the ATMEL SSC interface. You will also need
	  to select the audio interfaces to support below.

config SND_FULLHAN_SOC_SSC
	tristate
	depends on SND_FULLHAN_SOC
	help
	  Say Y or M if you want to add support for codecs the
	  ATMEL SSC interface. You will also needs to select the individual
	  machine drivers to support below.

config SND_FULLHAN_SOC_SAM9G20_WM8731
	tristate "SoC Audio support for WM8731-based At91sam9g20 evaluation board"
	depends on ATMEL_SSC && ARCH_AT91SAM9G20 && SND_ATMEL_SOC && \
                   AT91_PROGRAMMABLE_CLOCKS
	select SND_FULLHAN_SOC_SSC
	select SND_SOC_WM8731
	help
	  Say Y if you want to add support for SoC audio on WM8731-based
	  AT91sam9g20 evaluation board.

config SND_FULLHAN_SOC_PLAYPAQ
        tristate "SoC Audio support for PlayPaq with WM8510"
        depends on SND_ATMEL_SOC && BOARD_PLAYPAQ && AT91_PROGRAMMABLE_CLOCKS
        select SND_ATMEL_SOC_SSC
        select SND_SOC_WM8510
        help
          Say Y or M here if you want to add support for SoC audio
          on the LRS PlayPaq.
config SND_FH_SOC_I2S
	tristate
	
	
config SND_FULLHAN_SOC_PLAYPAQ_SLAVE
        bool "Run CODEC on PlayPaq in slave mode"
        depends on SND_FULLHAN_SOC_PLAYPAQ
        default n
        help
          Say Y if you want to run with the AT32 SSC generating the BCLK
          and FRAME signals on the PlayPaq.  Unless you want to play
          with the AT32 as the SSC master, you probably want to say N here,
          as this will give you better sound quality.

config SND_FULLHAN_SOC_FH
	tristate "SoC Audio support for fullhan-81 board"
	select SND_FULLHAN_SOC_SSC
	select SND_SOC_FSH0LS029AA
	select SND_FH_SOC_I2S
	help
	  Say Y here to support sound on fh81 board.
```

## sound/soc/ingenic/ecodec/Kconfig
```kconfig
config SND_SOC_WM8594
	depends on I2C
        tristate

config SND_SOC_AK4458
	depends on I2C
        tristate

config SND_SOC_AK5558
	depends on I2C
        tristate
```

## sound/soc/novatek/Kconfig
```kconfig
config SND_SOC_NVT
	tristate "NOVATEK Audio SoundCard support"
	help
	 This option enables NOVATEK SoundCard support on NVT platform.
config SND_SOC_XMOS
	tristate "XMOS Audio SoundCard support"
	help
		This option enables XMOS SoundCard support on NVT platform.
```

## sound/soc/sunxi/sunxi-aio/Kconfig
```kconfig
#
# embedded vision engine device configuration
#
config SUNXI_MPP_AIO
	tristate "AIO debugfs driver for mpp"
	default y
	depends on (ARCH_SUN8IW16 || ARCH_SUN8IW19) && SUNXI_MPP
	---help---
	This is the driver for allwinner platform audio input/output debugfs module.
	To compile this driver as a built-in module.
```

## sound/sunxi-rpaf/component/Kconfig
```kconfig
#
# Allwinner Built-in DSP Misc Driver.
#
config SND_SUNXI_MISC_HIFI_DSP
	tristate "Allwinner HiFi Component Driver"
	depends on SND_SUNXI_HIFI
	help
		allwinner built-in dsp component driver.
```

## sound/sunxi-rpaf/soc/Kconfig
```kconfig
#
# SoC audio configuration
#
menuconfig SND_SOC
	tristate "ALSA for SoC Sunxi Audio Support"
	select SND_PCM
	select REGMAP_I2C if I2C
	---help---

	  If you want ASoC support, you should say Y here and also to the
	  specific driver for your SoC platform below.

	  ASoC provides power efficient ALSA support for embedded battery powered
	  SoC based systems like PDA, Phones and Personal Media Players.

	  This ASoC audio support can also be built as a module.  If so, the module
	  will be called snd-soc-core.

if SND_SOC
config SND_SOC_GENERIC_DMAENGINE_PCM
	tristate "ALSA for SoC Audio DMA support"
	select SND_DMAENGINE_PCM

config SND_SOC_COMPRESS
	bool
	select SND_COMPRESS_OFFLOAD

config SND_SOC_TOPOLOGY
	bool

# Supported codecs
source "sound/sunxi-rpaf/soc/codecs/Kconfig"

# All the supported SoCs
source "sound/sunxi-rpaf/soc/sunxi/Kconfig"
endif # SND_SOC

menuconfig SND_SOC_SUNXI_RPAF
	tristate "ALSA for SoC Sunxi HiFi Support"
	select SND_PCM
	select SND_JACK
	select REGMAP_I2C if I2C
	---help---

	  If you want ASoC support, you should say Y here and also to the
	  specific driver for your SoC platform below.
	  
	  ASoC provides power efficient ALSA support for embedded battery powered
	  SoC based systems like PDA, Phones and Personal Media Players.

	  This ASoC audio support can also be built as a module.  If so, the module
	  will be called snd-soc-core.

if SND_SOC_SUNXI_RPAF

config SND_SOC_GENERIC_DMAENGINE_PCM
	tristate
	select SND_DMAENGINE_PCM

config SND_SOC_COMPRESS
	bool
	select SND_COMPRESS_OFFLOAD

config SND_SOC_TOPOLOGY
	bool

# All the supported SoCs
source "sound/sunxi-rpaf/soc/sunxi/hifi-dsp/Kconfig"
endif	# SND_SOC_SUNXI_RPAF
```

## sound/sunxi-rpaf/soc/codecs/Kconfig
```kconfig
# Helper to resolve issues with configs that have SPI enabled but I2C
# modular, meaning we can't build the codec driver in with I2C support.
# We use an ordered list of conditional defaults to pick the appropriate
# setting - SPI can't be modular so that case doesn't need to be covered.
menu "CODEC drivers"

config SND_SOC_DMIC
	tristate

config SND_SOC_AC108
        tristate "Sunxi AC108 Codec"
        depends on I2C
        default n
        help
          AC108 now used as external codec, Connect Through I2S.
          Say Y or M if you want to add support external audio codec.

config SND_SOC_AC107
        tristate "Sunxi AC107 Codec"
        depends on I2C
        default n
        help
          AC107 now used as external codec, Connect Through I2S.
          Say Y or M if you want to add support external audio codec.

config SND_SOC_TAS5805M
        tristate "Ti TAS5805M Audio Amplifier"
        depends on I2C
        default n
        help
	  Enable support for Texas Instruments TAS5805M audio amplifier;

endmenu
```

## sound/sunxi-rpaf/soc/sunxi/Kconfig
```kconfig
# Digital Audio(I2S/PCM/TDM)
config SND_SUNXI_SOC_DAUDIO
	tristate

# SPDIF Audio Interface
config SND_SUNXI_SOC_SPDIF
	tristate

# SUNXI Platform DMA
config SND_SUNXI_SOC
	tristate

# Daudio Machine Select
config SND_SUNXI_DAUDIO
	tristate "Allwinner Digital Audio Support"
	select SND_SUNXI_SOC
	select SND_SOC_GENERIC_DMAENGINE_PCM
	select SND_SUNXI_SOC_DAUDIO
	select REGMAP_MMIO
	depends on ARCH_SUN50IW11
	help
		Select Y or M to add support for I2S/PCM/TDM Module in the
		Allwinner SoCs.

# SPDIF Machine Select
config SND_SUNXI_SPDIF
	tristate "Allwinner SPDIF Support"
	select SND_SUNXI_SOC
	select SND_SOC_GENERIC_DMAENGINE_PCM
	select SND_SUNXI_SOC_SPDIF
	select REGMAP_MMIO
	depends on ARCH_SUN50IW11
	help
		Select Y or M to add support SPDIF Module in Allwinner
		SoCs.

 # SUNXI SPDIF RX Select
 config SND_SUNXI_SPDIF_RX_IEC61937
	tristate "Allwinner SPDIF RX IEC61937 Support"
	depends on SND_SUNXI_SPDIF
	help
		Select Y or M to add support SPDIF RX IEC-61937 in Allwinner SoCs.

config SUNXI_AUDIO_DEBUG
	bool "Allwinner Audio Debug Support"
	default n
	depends on SND_SUNXI_SOC
	help
		Select Y to enable debug information of allwinner audio driver
		If you not sure, Just not select it.

config SND_SUNXI_DAUDIO_DEBUG
	bool "Allwinner DAUDIO Debug"
	default n
	depends on SUNXI_AUDIO_DEBUG && SND_SUNXI_SOC_DAUDIO
	help
		Say Y if you want to debug daudio driver.

config SND_SUNXI_SPDIF_DEBUG
	bool "Allwinner SPDIF Debug"
	default n
	depends on SUNXI_AUDIO_DEBUG && SND_SUNXI_SOC_SPDIF
	help
		Say Y if you want to debug spdif driver.
```

## sound/sunxi-rpaf/soc/sunxi/hifi-dsp/Kconfig
```kconfig
# CPU DAI module
config SND_SUN50IW11_SOC_HIFI_CPUDAI
	tristate

# Digital Audio(I2S/PCM/TDM)
config SND_SUNXI_SOC_HIFI_DAUDIO
	tristate

# DMIC Audio Interface
config SND_SUNXI_SOC_HIFI_DMIC
	tristate

# SUNXI Codec Embedded
config SND_SUN50IW11_SOC_HIFI_CODEC
	tristate

config SND_SUNXI_SOC_HIFI_CODEC
	tristate

# SUNXI Platform HIFI
config SND_SUNXI_SOC_HIFI
	tristate

config SND_SUNXI_HIFI
	bool
	default y if RPMSG && SND_SUNXI_RPAF

# Card Machine Select
config SND_SUN50IW11_HIFI_CODEC
	tristate "Allwinner Audio Codec HiFi Support"
	select SND_SUNXI_SOC_HIFI
	select SND_SOC_GENERIC_DMAENGINE_PCM
	select SND_SUNXI_SOC_HIFI_CODEC
	select SND_SUN50IW11_SOC_HIFI_CODEC
	select SND_SUN50IW11_SOC_HIFI_CPUDAI
	depends on SND_SUNXI_HIFI && ARCH_SUN50IW11
	help
		Select Y or M to add support for the Codec embedded in the Allwinner
		SUN50IW11 and affiliated SoCs.

# Daudio Machine Select
config SND_SUNXI_HIFI_DAUDIO
	tristate "Allwinner Digital HiFi Support"
	select SND_SUNXI_SOC_HIFI
	select SND_SOC_GENERIC_DMAENGINE_PCM
	select SND_SUNXI_SOC_HIFI_DAUDIO
	depends on SND_SUNXI_HIFI && ARCH_SUN50IW11
	help
		Select Y or M to add support for I2S/PCM/TDM Module in the
		Allwinner SoCs.

# DMIC Machine Select
config SND_SUNXI_HIFI_DMIC
	tristate "Allwinner DMIC Support"
	select SND_SUNXI_SOC_HIFI
	select SND_SOC_GENERIC_DMAENGINE_PCM
	select SND_SUNXI_SOC_HIFI_DMIC
	select SND_SOC_DMIC
	depends on SND_SUNXI_HIFI && ARCH_SUN50IW11
	help
		Select Y or M to add support DMIC Module in Allwinner
		SoCs.

config SUNXI_AUDIO_HIFI_DEBUG
	bool "Allwinner Audio HiFi Debug Support"
	default n
	depends on SND_SUNXI_SOC_HIFI
	help
		Select Y to enable debug information of allwinner audio driver
		If you not sure, Just not select it.

config SND_SUNXI_HIFI_CODEC_DEBUG
	bool "Allwinner HiFi Audio Codec Debug"
    default n
	depends on SUNXI_AUDIO_HIFI_DEBUG && SND_SUNXI_SOC_HIFI_CODEC
	help
		Say Y if you want to debug codec HiFi driver.

config SND_SUNXI_HIFI_DAUDIO_DEBUG
	bool "Allwinner HiFi DAUDIO Debug"
	default n
	depends on SUNXI_AUDIO_HIFI_DEBUG && SND_SUNXI_SOC_HIFI_DAUDIO
	help
		Say Y if you want to debug daudio hifi driver.

config SND_SUNXI_HIFI_DMIC_DEBUG
	bool "Allwinner HiFi DMIC Debug"
    default n
	depends on SUNXI_AUDIO_HIFI_DEBUG && SND_SUNXI_SOC_HIFI_DMIC
	help
		Say Y if you want to debug dmic driver.
```
